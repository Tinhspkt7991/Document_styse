AUTOSAR XML (schema 4-2-2)
# COPYRIGHT
# Copyright(c) 2015-2016 Renesas Electronics Corporation
package /Renesas/BswModuleImplementation
  bsw implementation Port_Impl: programming-language=C, ar-release-version=4.2.2, vendor-specific-module-def=Port
  bsw module description Port
