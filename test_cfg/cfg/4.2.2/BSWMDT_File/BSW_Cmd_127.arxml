AUTOSAR XML (schema 4-2-2)
# COPYRIGHT
# Copyright(c) 2016-2018 Renesas Electronics Corporation
package /Renesas/BswModuleImplementation
  bsw implementation Port_Impl: programming-language=C, sw-version=1.1.7, vendor-id=59, ar-release-version=4.0.0, behavior=BswInternalBehavior_0, vendor-specific-module-def=Port
    code-descriptors:
      code File
        artifact-descriptors:
          short-label=Autosar::include::Port.h, category=SWHDR
          short-label=Autosar::include::Port_Dbg.h, category=SWHDR
          short-label=Autosar::include::Port_PBTypes.h, category=SWHDR
          short-label=Autosar::include::Port_Ram.h, category=SWHDR
          short-label=Autosar::include::Port_Types.h, category=SWHDR
          short-label=Autosar::include::Port_Version.h, category=SWHDR
          short-label=Autosar::src::Port.c, category=SWSRC
          short-label=Autosar::src::Port_Ram.c, category=SWSRC
          short-label=Autosar::src::Port_Version.c, category=SWSRC
    resource consumption ResourceConsumption
package /Renesas/BswModuleDescription
  bsw module description Port: module-id=124
