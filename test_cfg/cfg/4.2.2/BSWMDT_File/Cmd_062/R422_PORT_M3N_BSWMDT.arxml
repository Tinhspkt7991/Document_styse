AUTOSAR XML (schema 4-0-3)
# COPYRIGHT
# Copyright(c) 2013-2014 Renesas Electronics Corporation
package /Renesas/EcucDefs_Port
  bsw implementation Port_Impl: programming-language=C, sw-version=1.1.4, vendor-id=59, ar-release-version=4.2.2, behavior=BswInternalBehavior_0, vendor-api-infix=Renesas, vendor-specific-module-def=Port
  bsw module description Port: module-id=124
    bsw internal behavior BswInternalBehavior_0
      exclusive area SET_PIN_MODE_PROTECTION
