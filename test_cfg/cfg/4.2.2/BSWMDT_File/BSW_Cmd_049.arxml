AUTOSAR XML (schema 4-2-2)
# COPYRIGHT
# Copyright(c) 2016 Renesas Electronics Corporation
package /Renesas/EcucDefs_ABC
  bsw implementation ABC_Impl: programming-language=C, sw-version=1.0.0, vendor-id=59, ar-release-version=4.2.2, vendor-api-infix=Renesas, vendor-specific-module-def=ABC
  bsw module description ABC: module-id=120
