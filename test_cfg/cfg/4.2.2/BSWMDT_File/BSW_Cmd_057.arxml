AUTOSAR XML (schema 4-2-2)
# COPYRIGHT
# Copyright(c) 2015-2016 Renesas Electronics Corporation
package /Renesas/BswModuleImplementation
  bsw implementation Port_Impl: programming-language=C, sw-version=1.0.0, vendor-id=59, vendor-api-infix=Renesas, vendor-specific-module-def=Port
  bsw module description Port: module-id=120
