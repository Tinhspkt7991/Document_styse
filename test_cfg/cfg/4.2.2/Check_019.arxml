AUTOSAR XML (schema 4-2-2)
package /ActiveEcuC
  module config Port: implementation-config-variant=VARIANT-POST-BUILD, module-description=Port_Impl
    PortConfigSet
      PortContainer: PortNumberOfPortPins=1
        PortPin:
          PortPinDirection = NOT_USED
          PortPinDirectionChangeable = false
          PortPinId = 1
          PortPinInitialMode = NOT_USED
          PortPinLevelValue = NOT_USED
          PortPinMode = NOT_USED
          PortPinModeChangeable = false
      PortFilterGroupConfig
    PortGeneral:
      PortDevErrorDetect = false
      PortSetPinDirectionApi = true
      PortSetPinDefaultDirectionApi = true
      PortSetPinModeApi = true
      PortSetPinDefaultModeApi = true
      PortVersionInfoApi = true
      PortVersionCheckExternalModules = true
      PortDeviceName = RCar_M3N
      PortCriticalSectionProtection = true
      PortMaxMode = 13
      PortSetToDioAltModeApi = false
      PortConfigurationRegisterCheckApi = RFSO_0
      PortWriteVerifyCheck = RFSO_2
      PortExclusiveControl = true
      PortExclusiveTimeout = 20
      PortExclusiveSelection0 = MFISLCKR0
      PortExclusiveSelection1 = MFISLCKR1
      PortFUSEMonitoringApi = RFSO_1
      PortFUSEMONExpectedValue = 20
    PortDemEventParameterRefs
