AUTOSAR XML (schema 4-2-2)
package /ActiveEcuC
  module config Port: implementation-config-variant=VARIANT-POST-BUILD, module-description=Port_Impl
    PortConfigSet
      PortContainer: PortNumberOfPortPins=1
        PortPin:
          PortPinDirection = NOT_USED
          PortPinDirectionChangeable = false
          PortPinId = 1
          PortPinInitialMode = NOT_USED
          PortPinLevelValue = NOT_USED
          PortPinMode = NOT_USED
          PortPinModeChangeable = false
      PortFilterGroupConfig
      PortGroup1
        PortPin28:
          PortPinDirectionChangeable = false
          PortPinDioAltModeChangeable = false
          PortPinModeChangeable = false
          PortPinPolaritySelect = PORT__POSITIVE_LOGIC
          PortPinOutDataSelect = PORT__OUTDT
          PortPinLevelValue = PORT__LEVEL_LOW
          PortPinSensitiveInterrupt = PORT__LEVEL_SENSITIVE
          PortPinDetectionInterrupt = PORT__ONE_EDGE
          PortPinInitialMode = DIOIO
          PortPinDirection = PORT__IN
          PortPinPullOption = PULL__DISABLE_PUEN2_BIT0
          PortPinPullControl = PULL__UP_PUD2_BIT0
        PortPin14:
          PortPinDirectionChangeable = false
          PortPinDioAltModeChangeable = false
          PortPinModeChangeable = false
          PortPinPolaritySelect = PORT__POSITIVE_LOGIC
          PortPinOutDataSelect = PORT__OUTDT
          PortPinLevelValue = PORT__LEVEL_LOW
          PortPinSensitiveInterrupt = PORT__LEVEL_SENSITIVE
          PortPinDetectionInterrupt = PORT__ONE_EDGE
          PortPinInitialMode = DIOIO
          PortPinDirection = PORT__IN
          PortPinPullOption = PULL__DISABLE_PUEN1_BIT26
          PortPinPullControl = PULL__DOWN_PUD1_BIT26
        PortPin15:
          PortPinDirectionChangeable = false
          PortPinDioAltModeChangeable = false
          PortPinModeChangeable = false
          PortPinPolaritySelect = PORT__POSITIVE_LOGIC
          PortPinOutDataSelect = PORT__OUTDT
          PortPinLevelValue = PORT__LEVEL_LOW
          PortPinSensitiveInterrupt = PORT__LEVEL_SENSITIVE
          PortPinDetectionInterrupt = PORT__ONE_EDGE
          PortPinInitialMode = DIOIO
          PortPinDirection = PORT__IN
          PortPinPullOption = PULL__DISABLE_PUEN1_BIT27
          PortPinPullControl = PULL__DOWN_PUD1_BIT27
        PortPin16:
          PortPinDirectionChangeable = false
          PortPinDioAltModeChangeable = false
          PortPinModeChangeable = false
          PortPinPolaritySelect = PORT__POSITIVE_LOGIC
          PortPinOutDataSelect = PORT__OUTDT
          PortPinLevelValue = PORT__LEVEL_LOW
          PortPinSensitiveInterrupt = PORT__LEVEL_SENSITIVE
          PortPinDetectionInterrupt = PORT__ONE_EDGE
          PortPinInitialMode = DIOIO
          PortPinDirection = PORT__IN
          PortPinPullOption = PULL__DISABLE_PUEN1_BIT28
          PortPinPullControl = PULL__DOWN_PUD1_BIT28
        PortPin17:
          PortPinDirectionChangeable = false
          PortPinDioAltModeChangeable = false
          PortPinModeChangeable = false
          PortPinPolaritySelect = PORT__POSITIVE_LOGIC
          PortPinOutDataSelect = PORT__OUTDT
          PortPinLevelValue = PORT__LEVEL_LOW
          PortPinSensitiveInterrupt = PORT__LEVEL_SENSITIVE
          PortPinDetectionInterrupt = PORT__ONE_EDGE
          PortPinInitialMode = DIOIO
          PortPinDirection = PORT__IN
          PortPinPullOption = PULL__DISABLE_PUEN1_BIT29
          PortPinPullControl = PULL__DOWN_PUD1_BIT29
        PortPin18:
          PortPinDirectionChangeable = false
          PortPinDioAltModeChangeable = false
          PortPinModeChangeable = false
          PortPinPolaritySelect = PORT__POSITIVE_LOGIC
          PortPinOutDataSelect = PORT__OUTDT
          PortPinLevelValue = PORT__LEVEL_LOW
          PortPinSensitiveInterrupt = PORT__LEVEL_SENSITIVE
          PortPinDetectionInterrupt = PORT__ONE_EDGE
          PortPinInitialMode = DIOIO
          PortPinDirection = PORT__IN
          PortPinPullOption = PULL__DISABLE_PUEN1_BIT30
          PortPinPullControl = PULL__DOWN_PUD1_BIT30
        PortPin19:
          PortPinDirectionChangeable = false
          PortPinDioAltModeChangeable = false
          PortPinModeChangeable = false
          PortPinPolaritySelect = PORT__POSITIVE_LOGIC
          PortPinOutDataSelect = PORT__OUTDT
          PortPinLevelValue = PORT__LEVEL_LOW
          PortPinSensitiveInterrupt = PORT__LEVEL_SENSITIVE
          PortPinDetectionInterrupt = PORT__ONE_EDGE
          PortPinInitialMode = DIOIO
          PortPinDirection = PORT__IN
          PortPinPullOption = PULL__DISABLE_PUEN1_BIT31
          PortPinPullControl = PULL__DOWN_PUD1_BIT31
        PortPin20:
          PortPinDirectionChangeable = false
          PortPinDioAltModeChangeable = false
          PortPinModeChangeable = false
          PortPinPolaritySelect = PORT__POSITIVE_LOGIC
          PortPinOutDataSelect = PORT__OUTDT
          PortPinLevelValue = PORT__LEVEL_LOW
          PortPinSensitiveInterrupt = PORT__LEVEL_SENSITIVE
          PortPinDetectionInterrupt = PORT__ONE_EDGE
          PortPinInitialMode = DIOIO
          PortPinDirection = PORT__IN
          PortPinPullOption = PULL__ENABLE_PUEN2_BIT1
          PortPinPullControl = PULL__UP_PUD2_BIT1
        PortPin21:
          PortPinDirectionChangeable = false
          PortPinDioAltModeChangeable = false
          PortPinModeChangeable = false
          PortPinPolaritySelect = PORT__POSITIVE_LOGIC
          PortPinOutDataSelect = PORT__OUTDT
          PortPinLevelValue = PORT__LEVEL_LOW
          PortPinSensitiveInterrupt = PORT__LEVEL_SENSITIVE
          PortPinDetectionInterrupt = PORT__ONE_EDGE
          PortPinInitialMode = DIOIO
          PortPinDirection = PORT__IN
          PortPinPullOption = PULL__ENABLE_PUEN2_BIT2
          PortPinPullControl = PULL__UP_PUD2_BIT2
        PortPin22:
          PortPinDirectionChangeable = false
          PortPinDioAltModeChangeable = false
          PortPinModeChangeable = false
          PortPinPolaritySelect = PORT__POSITIVE_LOGIC
          PortPinOutDataSelect = PORT__OUTDT
          PortPinLevelValue = PORT__LEVEL_LOW
          PortPinSensitiveInterrupt = PORT__LEVEL_SENSITIVE
          PortPinDetectionInterrupt = PORT__ONE_EDGE
          PortPinInitialMode = DIOIO
          PortPinDirection = PORT__IN
          PortPinPullOption = PULL__DISABLE_PUEN2_BIT3
          PortPinPullControl = PULL__DOWN_PUD2_BIT3
        PortPin23:
          PortPinDirectionChangeable = false
          PortPinDioAltModeChangeable = false
          PortPinModeChangeable = false
          PortPinPolaritySelect = PORT__POSITIVE_LOGIC
          PortPinOutDataSelect = PORT__OUTDT
          PortPinLevelValue = PORT__LEVEL_LOW
          PortPinSensitiveInterrupt = PORT__LEVEL_SENSITIVE
          PortPinDetectionInterrupt = PORT__ONE_EDGE
          PortPinInitialMode = DIOIO
          PortPinDirection = PORT__IN
          PortPinPullOption = PULL__DISABLE_PUEN2_BIT4
          PortPinPullControl = PULL__DOWN_PUD2_BIT4
        PortPin24:
          PortPinDirectionChangeable = false
          PortPinDioAltModeChangeable = false
          PortPinModeChangeable = false
          PortPinPolaritySelect = PORT__POSITIVE_LOGIC
          PortPinOutDataSelect = PORT__OUTDT
          PortPinLevelValue = PORT__LEVEL_LOW
          PortPinSensitiveInterrupt = PORT__LEVEL_SENSITIVE
          PortPinDetectionInterrupt = PORT__ONE_EDGE
          PortPinInitialMode = DIOIO
          PortPinDirection = PORT__IN
          PortPinPullOption = PULL__ENABLE_PUEN2_BIT5
          PortPinPullControl = PULL__UP_PUD2_BIT5
        PortPin25:
          PortPinDirectionChangeable = false
          PortPinDioAltModeChangeable = false
          PortPinModeChangeable = false
          PortPinPolaritySelect = PORT__POSITIVE_LOGIC
          PortPinOutDataSelect = PORT__OUTDT
          PortPinLevelValue = PORT__LEVEL_LOW
          PortPinSensitiveInterrupt = PORT__LEVEL_SENSITIVE
          PortPinDetectionInterrupt = PORT__ONE_EDGE
          PortPinInitialMode = DIOIO
          PortPinDirection = PORT__IN
          PortPinPullOption = PULL__ENABLE_PUEN2_BIT6
          PortPinPullControl = PULL__UP_PUD2_BIT6
        PortPin26:
          PortPinDirectionChangeable = false
          PortPinDioAltModeChangeable = false
          PortPinModeChangeable = false
          PortPinPolaritySelect = PORT__POSITIVE_LOGIC
          PortPinOutDataSelect = PORT__OUTDT
          PortPinLevelValue = PORT__LEVEL_LOW
          PortPinSensitiveInterrupt = PORT__LEVEL_SENSITIVE
          PortPinDetectionInterrupt = PORT__ONE_EDGE
          PortPinInitialMode = DIOIO
          PortPinDirection = PORT__IN
          PortPinPullOption = PULL__ENABLE_PUEN2_BIT7
          PortPinPullControl = PULL__UP_PUD2_BIT7
        PortPin27:
          PortPinDirectionChangeable = false
          PortPinDioAltModeChangeable = false
          PortPinModeChangeable = false
          PortPinPolaritySelect = PORT__POSITIVE_LOGIC
          PortPinOutDataSelect = PORT__OUTDT
          PortPinLevelValue = PORT__LEVEL_LOW
          PortPinSensitiveInterrupt = PORT__LEVEL_SENSITIVE
          PortPinDetectionInterrupt = PORT__ONE_EDGE
          PortPinInitialMode = DIOIO
          PortPinDirection = PORT__IN
          PortPinPullOption = PULL__ENABLE_PUEN2_BIT8
          PortPinPullControl = PULL__UP_PUD2_BIT8
    PortGeneral:
      PortDevErrorDetect = true
      PortSetPinDirectionApi = true
      PortSetPinDefaultDirectionApi = true
      PortSetPinModeApi = true
      PortSetPinDefaultModeApi = true
      PortVersionInfoApi = true
      PortVersionCheckExternalModules = true
      PortDeviceName = RCar_M3N
      PortCriticalSectionProtection = true
      PortMaxMode = 13
      PortSetToDioAltModeApi = true
      PortConfigurationRegisterCheckApi = RFSO_0
      PortWriteVerifyCheck = RFSO_2
      PortExclusiveControl = true
      PortExclusiveTimeout = 66407
      PortExclusiveSelection0 = MFISLCKR0
      PortExclusiveSelection1 = MFISLCKR1
      PortFUSEMonitoringApi = RFSO_1
      PortFUSEMONExpectedValue = 20
    PortDemEventParameterRefs:
      PORT_E_WRITE_VERIFY_FAILURE = DemEventParameter1
      PORT_E_GET_CONTROL_FAILURE = DemEventParameter0
      PORT_E_CONFIGURATION_CHECK_TRANSIENT_FAILURE = DemEventParameter2
      PORT_E_CONFIGURATION_CHECK_PERMANENT_FAILURE = DemEventParameter3
      PORT_E_FUSE_MONITORING_FAILURE = DemEventParameter4
