AUTOSAR XML (schema 4-2-2)
package /ActiveEcuC
  module config Port: implementation-config-variant=VARIANT-PRE-COMPILE, module-description=Port_Impl
    PortConfigSet
      PortContainer: PortNumberOfPortPins=1
        PortPin:
          PortPinDirection = NOT_USED
          PortPinDirectionChangeable = false
          PortPinId = 1
          PortPinInitialMode = NOT_USED
          PortPinLevelValue = NOT_USED
          PortPinMode = NOT_USED
          PortPinModeChangeable = false
      PortFilterGroupConfig
    PortGeneral:
      PortDevErrorDetect = false
      PortSetPinDirectionApi = true
      PortSetPinDefaultDirectionApi = true
      PortSetPinModeApi = true
      PortSetPinDefaultModeApi = true
      PortVersionInfoApi = true
      PortVersionCheckExternalModules = true
      PortDeviceName = RCar_M3N
      PortCriticalSectionProtection = true
      PortMaxMode = 13
      PortSetToDioAltModeApi = false
      PortConfigurationRegisterCheckApi = DISABLED
      PortWriteVerifyCheck = DISABLED
      PortExclusiveControl = false
      PortExclusiveTimeout = 20
      PortExclusiveSelection0 = MFISLCKR0
      PortExclusiveSelection1 = MFISLCKR1
      PortFUSEMonitoringApi = DISABLED
      PortFUSEMONExpectedValue = 20
    PortDemEventParameterRefs:
      PORT_E_WRITE_VERIFY_FAILURE = WRONGPATH
      PORT_E_GET_CONTROL_FAILURE = WRONGPATH
      PORT_E_CONFIGURATION_CHECK_TRANSIENT_FAILURE = WRONGPATH
      PORT_E_CONFIGURATION_CHECK_PERMANENT_FAILURE = WRONGPATH
      PORT_E_FUSE_MONITORING_FAILURE = WRONGPATH
