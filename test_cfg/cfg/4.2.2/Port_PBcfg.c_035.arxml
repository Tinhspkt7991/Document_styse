AUTOSAR XML (schema 4-2-2)
package /ActiveEcuC
  module config Port: implementation-config-variant=VARIANT-PRE-COMPILE, module-description=Port_Impl
    PortConfigSet
      PortContainer: PortNumberOfPortPins=1
        PortPin:
          PortPinDirection = NOT_USED
          PortPinDirectionChangeable = false
          PortPinId = 1
          PortPinInitialMode = NOT_USED
          PortPinLevelValue = NOT_USED
          PortPinMode = NOT_USED
          PortPinModeChangeable = false
      PortFilterGroupConfig
        PortChatteringFilterGroup0:
          PortFilterClockFrequency = S3D4PHI_DIV_BY_66000
          PortChatteringFilterInput{0..3} = false
        PortChatteringFilterGroup1:
          PortFilterClockFrequency = S3D4PHI_DIV_BY_66000
          PortChatteringFilterInput{0..3} = false
        PortChatteringFilterGroup2:
          PortFilterClockFrequency = S3D4PHI_DIV_BY_66000
          PortChatteringFilterInput{0..3} = false
        PortChatteringFilterGroup3:
          PortFilterClockFrequency = S3D4PHI_DIV_BY_66000
          PortChatteringFilterInput{0..3} = false
        PortChatteringFilterGroup4:
          PortFilterClockFrequency = S3D4PHI_DIV_BY_66000
          PortChatteringFilterInput{0..3} = false
        PortChatteringFilterGroup5:
          PortFilterClockFrequency = S3D4PHI_DIV_BY_66000
          PortChatteringFilterInput{0..3} = false
        PortChatteringFilterGroup6:
          PortFilterClockFrequency = S3D4PHI_DIV_BY_66000
          PortChatteringFilterInput{0..3} = false
        PortChatteringFilterGroup7:
          PortFilterClockFrequency = S3D4PHI_DIV_BY_66000
          PortChatteringFilterInput{0..3} = false
      PortGroup6
        PortPin0:
          PortPinDirectionChangeable = false
          PortPinDioAltModeChangeable = false
          PortPinModeChangeable = false
          PortPinPolaritySelect = PORT_PIN_NEGATIVE_LOGIC
          PortPinOutDataSelect = PORT_PIN_OUTDTH_OUTDTL
          PortPinLevelValue = PORT_PIN_LEVEL_HIGH
          PortPinSensitiveInterrupt = PORT_PIN_EDGE_SENSITIVE
          PortPinDetectionInterrupt = PORT_PIN_BOTH_EDGE
          PortPinInitialMode = SSI_SCK01239
          PortPinDirection = PORT_PIN_IN
          PortPinPullOption = PULL_ENABLE_PUEN5_BIT7
          PortPinPullControl = PULL_UP_PUD5_BIT7
        PortPin1:
          PortPinDirectionChangeable = false
          PortPinDioAltModeChangeable = false
          PortPinModeChangeable = false
          PortPinPolaritySelect = PORT_PIN_NEGATIVE_LOGIC
          PortPinOutDataSelect = PORT_PIN_OUTDTH_OUTDTL
          PortPinLevelValue = PORT_PIN_LEVEL_HIGH
          PortPinSensitiveInterrupt = PORT_PIN_EDGE_SENSITIVE
          PortPinDetectionInterrupt = PORT_PIN_BOTH_EDGE
          PortPinInitialMode = SSI_WS01239
          PortPinDirection = PORT_PIN_IN
          PortPinPullOption = PULL_ENABLE_PUEN5_BIT8
          PortPinPullControl = PULL_UP_PUD5_BIT8
        PortPin2:
          PortPinDirectionChangeable = false
          PortPinDioAltModeChangeable = false
          PortPinModeChangeable = false
          PortPinPolaritySelect = PORT_PIN_NEGATIVE_LOGIC
          PortPinOutDataSelect = PORT_PIN_OUTDTH_OUTDTL
          PortPinLevelValue = PORT_PIN_LEVEL_HIGH
          PortPinSensitiveInterrupt = PORT_PIN_EDGE_SENSITIVE
          PortPinDetectionInterrupt = PORT_PIN_BOTH_EDGE
          PortPinInitialMode = SSI_SDATA0
          PortPinDirection = PORT_PIN_IN
          PortPinPullOption = PULL_ENABLE_PUEN5_BIT9
          PortPinPullControl = PULL_UP_PUD5_BIT9
        PortPin3:
          PortPinDirectionChangeable = false
          PortPinDioAltModeChangeable = false
          PortPinModeChangeable = false
          PortPinPolaritySelect = PORT_PIN_NEGATIVE_LOGIC
          PortPinOutDataSelect = PORT_PIN_OUTDTH_OUTDTL
          PortPinLevelValue = PORT_PIN_LEVEL_HIGH
          PortPinSensitiveInterrupt = PORT_PIN_EDGE_SENSITIVE
          PortPinDetectionInterrupt = PORT_PIN_BOTH_EDGE
          PortPinInitialMode = SSI_SDATA1_A
          PortPinDirection = PORT_PIN_IN
          PortPinPullOption = PULL_ENABLE_PUEN5_BIT10
          PortPinPullControl = PULL_UP_PUD5_BIT10
        PortPin4:
          PortPinDirectionChangeable = false
          PortPinDioAltModeChangeable = false
          PortPinModeChangeable = false
          PortPinPolaritySelect = PORT_PIN_NEGATIVE_LOGIC
          PortPinOutDataSelect = PORT_PIN_OUTDTH_OUTDTL
          PortPinLevelValue = PORT_PIN_LEVEL_HIGH
          PortPinSensitiveInterrupt = PORT_PIN_EDGE_SENSITIVE
          PortPinDetectionInterrupt = PORT_PIN_BOTH_EDGE
          PortPinInitialMode = SSI_SDATA2_A
          PortPinDirection = PORT_PIN_IN
          PortPinPullOption = PULL_ENABLE_PUEN5_BIT11
          PortPinPullControl = PULL_UP_PUD5_BIT11
        PortPin5:
          PortPinDirectionChangeable = false
          PortPinDioAltModeChangeable = false
          PortPinModeChangeable = false
          PortPinPolaritySelect = PORT_PIN_NEGATIVE_LOGIC
          PortPinOutDataSelect = PORT_PIN_OUTDTH_OUTDTL
          PortPinLevelValue = PORT_PIN_LEVEL_HIGH
          PortPinSensitiveInterrupt = PORT_PIN_EDGE_SENSITIVE
          PortPinDetectionInterrupt = PORT_PIN_BOTH_EDGE
          PortPinInitialMode = INTERRUPT
          PortPinDirection = PORT_PIN_IN
          PortPinPullOption = PULL_ENABLE_PUEN5_BIT12
          PortPinPullControl = PULL_UP_PUD5_BIT12
        PortPin6:
          PortPinDirectionChangeable = false
          PortPinDioAltModeChangeable = false
          PortPinModeChangeable = false
          PortPinPolaritySelect = PORT_PIN_NEGATIVE_LOGIC
          PortPinOutDataSelect = PORT_PIN_OUTDTH_OUTDTL
          PortPinLevelValue = PORT_PIN_LEVEL_HIGH
          PortPinSensitiveInterrupt = PORT_PIN_EDGE_SENSITIVE
          PortPinDetectionInterrupt = PORT_PIN_BOTH_EDGE
          PortPinInitialMode = INTERRUPT
          PortPinDirection = PORT_PIN_IN
          PortPinPullOption = PULL_ENABLE_PUEN5_BIT13
          PortPinPullControl = PULL_UP_PUD5_BIT13
        PortPin7:
          PortPinDirectionChangeable = false
          PortPinDioAltModeChangeable = false
          PortPinModeChangeable = false
          PortPinPolaritySelect = PORT_PIN_NEGATIVE_LOGIC
          PortPinOutDataSelect = PORT_PIN_OUTDTH_OUTDTL
          PortPinLevelValue = PORT_PIN_LEVEL_HIGH
          PortPinSensitiveInterrupt = PORT_PIN_EDGE_SENSITIVE
          PortPinDetectionInterrupt = PORT_PIN_BOTH_EDGE
          PortPinInitialMode = INTERRUPT
          PortPinDirection = PORT_PIN_IN
          PortPinPullOption = PULL_ENABLE_PUEN5_BIT14
          PortPinPullControl = PULL_UP_PUD5_BIT14
        PortPin8:
          PortPinDirectionChangeable = false
          PortPinDioAltModeChangeable = false
          PortPinModeChangeable = false
          PortPinPolaritySelect = PORT_PIN_NEGATIVE_LOGIC
          PortPinOutDataSelect = PORT_PIN_OUTDTH_OUTDTL
          PortPinLevelValue = PORT_PIN_LEVEL_HIGH
          PortPinSensitiveInterrupt = PORT_PIN_EDGE_SENSITIVE
          PortPinDetectionInterrupt = PORT_PIN_BOTH_EDGE
          PortPinInitialMode = INTERRUPT
          PortPinDirection = PORT_PIN_IN
          PortPinPullOption = PULL_ENABLE_PUEN5_BIT15
          PortPinPullControl = PULL_UP_PUD5_BIT15
        PortPin9:
          PortPinDirectionChangeable = false
          PortPinDioAltModeChangeable = false
          PortPinModeChangeable = false
          PortPinPolaritySelect = PORT_PIN_NEGATIVE_LOGIC
          PortPinOutDataSelect = PORT_PIN_OUTDTH_OUTDTL
          PortPinLevelValue = PORT_PIN_LEVEL_HIGH
          PortPinSensitiveInterrupt = PORT_PIN_EDGE_SENSITIVE
          PortPinDetectionInterrupt = PORT_PIN_BOTH_EDGE
          PortPinInitialMode = INTERRUPT
          PortPinDirection = PORT_PIN_IN
          PortPinPullOption = PULL_ENABLE_PUEN5_BIT16
          PortPinPullControl = PULL_UP_PUD5_BIT16
        PortPin10:
          PortPinDirectionChangeable = false
          PortPinDioAltModeChangeable = false
          PortPinModeChangeable = false
          PortPinPolaritySelect = PORT_PIN_POSITIVE_LOGIC
          PortPinOutDataSelect = PORT_PIN_OUTDT
          PortPinLevelValue = PORT_PIN_LEVEL_LOW
          PortPinSensitiveInterrupt = PORT_PIN_LEVEL_SENSITIVE
          PortPinDetectionInterrupt = PORT_PIN_ONE_EDGE
          PortPinInitialMode = DIO
          PortPinDirection = PORT_PIN_OUT
          PortPinPullOption = PULL_DISABLE_PUEN5_BIT17
          PortPinPullControl = PULL_DOWN_PUD5_BIT17
        PortPin11:
          PortPinDirectionChangeable = false
          PortPinDioAltModeChangeable = false
          PortPinModeChangeable = false
          PortPinPolaritySelect = PORT_PIN_POSITIVE_LOGIC
          PortPinOutDataSelect = PORT_PIN_OUTDT
          PortPinLevelValue = PORT_PIN_LEVEL_LOW
          PortPinSensitiveInterrupt = PORT_PIN_LEVEL_SENSITIVE
          PortPinDetectionInterrupt = PORT_PIN_ONE_EDGE
          PortPinInitialMode = DIO
          PortPinDirection = PORT_PIN_OUT
          PortPinPullOption = PULL_DISABLE_PUEN5_BIT18
          PortPinPullControl = PULL_DOWN_PUD5_BIT18
        PortPin12:
          PortPinDirectionChangeable = false
          PortPinDioAltModeChangeable = false
          PortPinModeChangeable = false
          PortPinPolaritySelect = PORT_PIN_POSITIVE_LOGIC
          PortPinOutDataSelect = PORT_PIN_OUTDT
          PortPinLevelValue = PORT_PIN_LEVEL_LOW
          PortPinSensitiveInterrupt = PORT_PIN_LEVEL_SENSITIVE
          PortPinDetectionInterrupt = PORT_PIN_ONE_EDGE
          PortPinInitialMode = DIO
          PortPinDirection = PORT_PIN_OUT
          PortPinPullOption = PULL_DISABLE_PUEN5_BIT19
          PortPinPullControl = PULL_DOWN_PUD5_BIT19
        PortPin13:
          PortPinDirectionChangeable = false
          PortPinDioAltModeChangeable = false
          PortPinModeChangeable = false
          PortPinPolaritySelect = PORT_PIN_POSITIVE_LOGIC
          PortPinOutDataSelect = PORT_PIN_OUTDT
          PortPinLevelValue = PORT_PIN_LEVEL_LOW
          PortPinSensitiveInterrupt = PORT_PIN_LEVEL_SENSITIVE
          PortPinDetectionInterrupt = PORT_PIN_ONE_EDGE
          PortPinInitialMode = DIO
          PortPinDirection = PORT_PIN_OUT
          PortPinPullOption = PULL_DISABLE_PUEN5_BIT20
          PortPinPullControl = PULL_DOWN_PUD5_BIT20
        PortPin14:
          PortPinDirectionChangeable = false
          PortPinDioAltModeChangeable = false
          PortPinModeChangeable = false
          PortPinPolaritySelect = PORT_PIN_POSITIVE_LOGIC
          PortPinOutDataSelect = PORT_PIN_OUTDT
          PortPinLevelValue = PORT_PIN_LEVEL_LOW
          PortPinSensitiveInterrupt = PORT_PIN_LEVEL_SENSITIVE
          PortPinDetectionInterrupt = PORT_PIN_ONE_EDGE
          PortPinInitialMode = DIO
          PortPinDirection = PORT_PIN_OUT
          PortPinPullOption = PULL_DISABLE_PUEN5_BIT21
          PortPinPullControl = PULL_DOWN_PUD5_BIT21
        PortPin15:
          PortPinDirectionChangeable = false
          PortPinDioAltModeChangeable = false
          PortPinModeChangeable = false
          PortPinPolaritySelect = PORT_PIN_POSITIVE_LOGIC
          PortPinOutDataSelect = PORT_PIN_OUTDT
          PortPinLevelValue = PORT_PIN_LEVEL_LOW
          PortPinSensitiveInterrupt = PORT_PIN_LEVEL_SENSITIVE
          PortPinDetectionInterrupt = PORT_PIN_ONE_EDGE
          PortPinInitialMode = DIO
          PortPinDirection = PORT_PIN_OUT
          PortPinPullOption = PULL_DISABLE_PUEN5_BIT2
          PortPinPullControl = PULL_DOWN_PUD5_BIT22
        PortPin16:
          PortPinDirectionChangeable = false
          PortPinDioAltModeChangeable = false
          PortPinModeChangeable = false
          PortPinPolaritySelect = PORT_PIN_POSITIVE_LOGIC
          PortPinOutDataSelect = PORT_PIN_OUTDT
          PortPinLevelValue = PORT_PIN_LEVEL_LOW
          PortPinSensitiveInterrupt = PORT_PIN_LEVEL_SENSITIVE
          PortPinDetectionInterrupt = PORT_PIN_ONE_EDGE
          PortPinInitialMode = DIO
          PortPinDirection = PORT_PIN_OUT
          PortPinPullOption = PULL_DISABLE_PUEN5_BIT23
          PortPinPullControl = PULL_DOWN_PUD5_BIT23
        PortPin17:
          PortPinDirectionChangeable = false
          PortPinDioAltModeChangeable = false
          PortPinModeChangeable = false
          PortPinPolaritySelect = PORT_PIN_POSITIVE_LOGIC
          PortPinOutDataSelect = PORT_PIN_OUTDT
          PortPinLevelValue = PORT_PIN_LEVEL_LOW
          PortPinSensitiveInterrupt = PORT_PIN_LEVEL_SENSITIVE
          PortPinDetectionInterrupt = PORT_PIN_ONE_EDGE
          PortPinInitialMode = DIO
          PortPinDirection = PORT_PIN_OUT
          PortPinPullOption = PULL_DISABLE_PUEN5_BIT24
          PortPinPullControl = PULL_DOWN_PUD5_BIT24
        PortPin18:
          PortPinDirectionChangeable = false
          PortPinDioAltModeChangeable = false
          PortPinModeChangeable = false
          PortPinPolaritySelect = PORT_PIN_POSITIVE_LOGIC
          PortPinOutDataSelect = PORT_PIN_OUTDT
          PortPinLevelValue = PORT_PIN_LEVEL_LOW
          PortPinSensitiveInterrupt = PORT_PIN_LEVEL_SENSITIVE
          PortPinDetectionInterrupt = PORT_PIN_ONE_EDGE
          PortPinInitialMode = DIO
          PortPinDirection = PORT_PIN_OUT
          PortPinPullOption = PULL_DISABLE_PUEN5_BIT25
          PortPinPullControl = PULL_DOWN_PUD5_BIT25
        PortPin19:
          PortPinDirectionChangeable = false
          PortPinDioAltModeChangeable = false
          PortPinModeChangeable = false
          PortPinPolaritySelect = PORT_PIN_POSITIVE_LOGIC
          PortPinOutDataSelect = PORT_PIN_OUTDT
          PortPinLevelValue = PORT_PIN_LEVEL_LOW
          PortPinSensitiveInterrupt = PORT_PIN_LEVEL_SENSITIVE
          PortPinDetectionInterrupt = PORT_PIN_ONE_EDGE
          PortPinInitialMode = DIO
          PortPinDirection = PORT_PIN_OUT
          PortPinPullOption = PULL_DISABLE_PUEN5_BIT26
          PortPinPullControl = PULL_DOWN_PUD5_BIT26
        PortPin20:
          PortPinDirectionChangeable = false
          PortPinDioAltModeChangeable = false
          PortPinModeChangeable = false
          PortPinPolaritySelect = PORT_PIN_POSITIVE_LOGIC
          PortPinOutDataSelect = PORT_PIN_OUTDT
          PortPinLevelValue = PORT_PIN_LEVEL_LOW
          PortPinSensitiveInterrupt = PORT_PIN_LEVEL_SENSITIVE
          PortPinDetectionInterrupt = PORT_PIN_ONE_EDGE
          PortPinInitialMode = DIO
          PortPinDirection = PORT_PIN_OUT
          PortPinPullOption = PULL_DISABLE_PUEN5_BIT27
          PortPinPullControl = PULL_DOWN_PUD5_BIT27
        PortPin21:
          PortPinDirectionChangeable = false
          PortPinDioAltModeChangeable = false
          PortPinModeChangeable = false
          PortPinPolaritySelect = PORT_PIN_POSITIVE_LOGIC
          PortPinOutDataSelect = PORT_PIN_OUTDT
          PortPinLevelValue = PORT_PIN_LEVEL_LOW
          PortPinSensitiveInterrupt = PORT_PIN_LEVEL_SENSITIVE
          PortPinDetectionInterrupt = PORT_PIN_ONE_EDGE
          PortPinInitialMode = DIO
          PortPinDirection = PORT_PIN_OUT
          PortPinPullOption = PULL_DISABLE_PUEN5_BIT28
          PortPinPullControl = PULL_DOWN_PUD5_BIT28
        PortPin22:
          PortPinDirectionChangeable = false
          PortPinDioAltModeChangeable = false
          PortPinModeChangeable = false
          PortPinPolaritySelect = PORT_PIN_POSITIVE_LOGIC
          PortPinOutDataSelect = PORT_PIN_OUTDT
          PortPinLevelValue = PORT_PIN_LEVEL_LOW
          PortPinSensitiveInterrupt = PORT_PIN_LEVEL_SENSITIVE
          PortPinDetectionInterrupt = PORT_PIN_ONE_EDGE
          PortPinInitialMode = DIO
          PortPinDirection = PORT_PIN_OUT
          PortPinPullOption = PULL_DISABLE_PUEN5_BIT29
          PortPinPullControl = PULL_DOWN_PUD5_BIT29
        PortPin23:
          PortPinDirectionChangeable = false
          PortPinDioAltModeChangeable = false
          PortPinModeChangeable = false
          PortPinPolaritySelect = PORT_PIN_POSITIVE_LOGIC
          PortPinOutDataSelect = PORT_PIN_OUTDT
          PortPinLevelValue = PORT_PIN_LEVEL_LOW
          PortPinSensitiveInterrupt = PORT_PIN_LEVEL_SENSITIVE
          PortPinDetectionInterrupt = PORT_PIN_ONE_EDGE
          PortPinInitialMode = DIO
          PortPinDirection = PORT_PIN_OUT
          PortPinPullOption = PULL_DISABLE_PUEN5_BIT30
          PortPinPullControl = PULL_DOWN_PUD5_BIT30
        PortPin24:
          PortPinDirectionChangeable = false
          PortPinDioAltModeChangeable = false
          PortPinModeChangeable = false
          PortPinPolaritySelect = PORT_PIN_POSITIVE_LOGIC
          PortPinOutDataSelect = PORT_PIN_OUTDT
          PortPinLevelValue = PORT_PIN_LEVEL_LOW
          PortPinSensitiveInterrupt = PORT_PIN_LEVEL_SENSITIVE
          PortPinDetectionInterrupt = PORT_PIN_ONE_EDGE
          PortPinInitialMode = DIO
          PortPinDirection = PORT_PIN_OUT
          PortPinPullOption = PULL_DISABLE_PUEN5_BIT31
          PortPinPullControl = PULL_DOWN_PUD5_BIT31
        PortPin25:
          PortPinDirectionChangeable = false
          PortPinDioAltModeChangeable = false
          PortPinModeChangeable = false
          PortPinPolaritySelect = PORT_PIN_POSITIVE_LOGIC
          PortPinOutDataSelect = PORT_PIN_OUTDT
          PortPinLevelValue = PORT_PIN_LEVEL_LOW
          PortPinSensitiveInterrupt = PORT_PIN_LEVEL_SENSITIVE
          PortPinDetectionInterrupt = PORT_PIN_ONE_EDGE
          PortPinInitialMode = DIO
          PortPinDirection = PORT_PIN_OUT
          PortPinPullOption = PULL_DISABLE_PUEN6_BIT0
          PortPinPullControl = PULL_DOWN_PUD6_BIT0
        PortPin26:
          PortPinDirectionChangeable = false
          PortPinDioAltModeChangeable = false
          PortPinModeChangeable = false
          PortPinPolaritySelect = PORT_PIN_POSITIVE_LOGIC
          PortPinOutDataSelect = PORT_PIN_OUTDT
          PortPinLevelValue = PORT_PIN_LEVEL_LOW
          PortPinSensitiveInterrupt = PORT_PIN_LEVEL_SENSITIVE
          PortPinDetectionInterrupt = PORT_PIN_ONE_EDGE
          PortPinInitialMode = DIO
          PortPinDirection = PORT_PIN_OUT
          PortPinPullOption = PULL_DISABLE_PUEN6_BIT1
          PortPinPullControl = PULL_DOWN_PUD6_BIT1
        PortPin27:
          PortPinDirectionChangeable = false
          PortPinDioAltModeChangeable = false
          PortPinModeChangeable = false
          PortPinPolaritySelect = PORT_PIN_POSITIVE_LOGIC
          PortPinOutDataSelect = PORT_PIN_OUTDT
          PortPinLevelValue = PORT_PIN_LEVEL_LOW
          PortPinSensitiveInterrupt = PORT_PIN_LEVEL_SENSITIVE
          PortPinDetectionInterrupt = PORT_PIN_ONE_EDGE
          PortPinInitialMode = DIO
          PortPinDirection = PORT_PIN_OUT
          PortPinPullOption = PULL_DISABLE_PUEN6_BIT2
          PortPinPullControl = PULL_DOWN_PUD6_BIT2
        PortPin28:
          PortPinDirectionChangeable = false
          PortPinDioAltModeChangeable = false
          PortPinModeChangeable = false
          PortPinPolaritySelect = PORT_PIN_POSITIVE_LOGIC
          PortPinOutDataSelect = PORT_PIN_OUTDT
          PortPinLevelValue = PORT_PIN_LEVEL_LOW
          PortPinSensitiveInterrupt = PORT_PIN_LEVEL_SENSITIVE
          PortPinDetectionInterrupt = PORT_PIN_ONE_EDGE
          PortPinInitialMode = DIO
          PortPinDirection = PORT_PIN_OUT
          PortPinPullOption = PULL_DISABLE_PUEN6_BIT3
          PortPinPullControl = PULL_DOWN_PUD6_BIT3
        PortPin31:
          PortPinDirectionChangeable = false
          PortPinDioAltModeChangeable = false
          PortPinModeChangeable = false
          PortPinPolaritySelect = PORT_PIN_POSITIVE_LOGIC
          PortPinOutDataSelect = PORT_PIN_OUTDT
          PortPinLevelValue = PORT_PIN_LEVEL_LOW
          PortPinSensitiveInterrupt = PORT_PIN_LEVEL_SENSITIVE
          PortPinDetectionInterrupt = PORT_PIN_ONE_EDGE
          PortPinInitialMode = DIO
          PortPinDirection = PORT_PIN_OUT
          PortPinPullOption = PULL_DISABLE_PUEN6_BIT6
          PortPinPullControl = PULL_DOWN_PUD6_BIT6
        PortPin29:
          PortPinDirectionChangeable = false
          PortPinDioAltModeChangeable = false
          PortPinModeChangeable = false
          PortPinPolaritySelect = PORT_PIN_POSITIVE_LOGIC
          PortPinOutDataSelect = PORT_PIN_OUTDT
          PortPinLevelValue = PORT_PIN_LEVEL_LOW
          PortPinSensitiveInterrupt = PORT_PIN_LEVEL_SENSITIVE
          PortPinDetectionInterrupt = PORT_PIN_ONE_EDGE
          PortPinInitialMode = DIO
          PortPinDirection = PORT_PIN_OUT
          PortPinPullOption = PULL_DISABLE_PUEN6_BIT4
          PortPinPullControl = PULL_DOWN_PUD6_BIT4
        PortPin30:
          PortPinDirectionChangeable = false
          PortPinDioAltModeChangeable = false
          PortPinModeChangeable = false
          PortPinPolaritySelect = PORT_PIN_POSITIVE_LOGIC
          PortPinOutDataSelect = PORT_PIN_OUTDT
          PortPinLevelValue = PORT_PIN_LEVEL_LOW
          PortPinSensitiveInterrupt = PORT_PIN_LEVEL_SENSITIVE
          PortPinDetectionInterrupt = PORT_PIN_ONE_EDGE
          PortPinInitialMode = DIO
          PortPinDirection = PORT_PIN_OUT
          PortPinPullOption = PULL_DISABLE_PUEN6_BIT5
          PortPinPullControl = PULL_DOWN_PUD6_BIT5
      PortGroup7
      PortGroup{0..5}
    PortGeneral:
      PortDevErrorDetect = true
      PortSetPinDirectionApi = true
      PortSetPinDefaultDirectionApi = true
      PortSetPinModeApi = true
      PortSetPinDefaultModeApi = true
      PortVersionInfoApi = true
      PortVersionCheckExternalModules = true
      PortDeviceName = RCar_M3N
      PortCriticalSectionProtection = true
      PortMaxMode = 13
      PortSetToDioAltModeApi = true
      PortConfigurationRegisterCheckApi = RFSO_0
      PortWriteVerifyCheck = RFSO_1
      PortExclusiveControl = false
      PortExclusiveTimeout = 20
      PortExclusiveSelection0 = MFISLCKR0
      PortExclusiveSelection1 = MFISLCKR1
      PortFUSEMonitoringApi = DISABLED
      PortFUSEMONExpectedValue = 20
    PortDemEventParameterRefs:
      PORT_E_WRITE_VERIFY_FAILURE = DemEventParameter1
      PORT_E_GET_CONTROL_FAILURE = DemEventParameter0
      PORT_E_CONFIGURATION_CHECK_TRANSIENT_FAILURE = DemEventParameter2
      PORT_E_CONFIGURATION_CHECK_PERMANENT_FAILURE = DemEventParameter3
      PORT_E_FUSE_MONITORING_FAILURE = DemEventParameter4
