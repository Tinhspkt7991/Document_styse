AUTOSAR XML (schema 4-2-2)
package /ActiveEcuC
  module config Port: implementation-config-variant=VARIANT-PRE-COMPILE, module-description=Port_Impl
    PortConfigSet
      PortContainer: PortNumberOfPortPins=1
        PortPin:
          PortPinDirection = NOT_USED
          PortPinDirectionChangeable = false
          PortPinId = 1
          PortPinInitialMode = NOT_USED
          PortPinLevelValue = NOT_USED
          PortPinMode = NOT_USED
          PortPinModeChangeable = false
      PortFilterGroupConfig
    PortGeneral:
      PortDevErrorDetect = 
      PortSetPinDirectionApi = 
      PortSetPinDefaultDirectionApi = 
      PortSetPinModeApi = 
      PortSetPinDefaultModeApi = 
      PortVersionInfoApi = 
      PortVersionCheckExternalModules = 
      PortDeviceName = RCar_M3N
      PortCriticalSectionProtection = 
      PortMaxMode = 
      PortSetToDioAltModeApi = 
      PortConfigurationRegisterCheckApi = 
      PortDeviceRevision = (unset)
      PortWriteVerifyCheck = 
      PortExclusiveControl = 
      PortExclusiveTimeout = (unset)
      PortExclusiveSelection0 = (unset)
      PortExclusiveSelection1 = (unset)
    PortDemEventParameterRefs:
      PORT_E_WRITE_VERIFY_FAILURE = DemEventParameter1
      PORT_E_GET_CONTROL_FAILURE = DemEventParameter0
      PORT_E_CONFIGURATION_CHECK_TRANSIENT_FAILURE = DemEventParameter2
      PORT_E_CONFIGURATION_CHECK_PERMANENT_FAILURE = DemEventParameter3
      PORT_E_FUSE_MONITORING_FAILURE = DemEventParameter4
