AUTOSAR XML (schema 4-2-2)
package /ActiveEcuC
  module config Port: implementation-config-variant=VARIANT-POST-BUILD, module-description=Port_Impl
    PortConfigSet
      PortContainer: PortNumberOfPortPins=1
        PortPin:
          PortPinDirection = NOT_USED
          PortPinDirectionChangeable = false
          PortPinId = 1
          PortPinInitialMode = NOT_USED
          PortPinLevelValue = NOT_USED
          PortPinMode = NOT_USED
          PortPinModeChangeable = false
      PortFilterGroupConfig
        PortChatteringFilterGroup0:
          PortFilterClockFrequency = S3D4PHI_DIV_BY_66000
          PortChatteringFilterInput{0..3} = false
        PortChatteringFilterGroup1:
          PortFilterClockFrequency = S3D4PHI_DIV_BY_66000
          PortChatteringFilterInput{0..3} = false
        PortChatteringFilterGroup2:
          PortFilterClockFrequency = S3D4PHI_DIV_BY_66000
          PortChatteringFilterInput{0..3} = false
        PortChatteringFilterGroup3:
          PortFilterClockFrequency = S3D4PHI_DIV_BY_66000
          PortChatteringFilterInput{0..3} = false
        PortChatteringFilterGroup4:
          PortFilterClockFrequency = S3D4PHI_DIV_BY_66000
          PortChatteringFilterInput{0..3} = false
        PortChatteringFilterGroup5:
          PortFilterClockFrequency = S3D4PHI_DIV_BY_66000
          PortChatteringFilterInput{0..3} = false
        PortChatteringFilterGroup6:
          PortFilterClockFrequency = S3D4PHI_DIV_BY_66000
          PortChatteringFilterInput{0..3} = false
        PortChatteringFilterGroup7:
          PortFilterClockFrequency = S3D4PHI_DIV_BY_66000
          PortChatteringFilterInput{0..3} = false
      PortGroup0
        PortPin0:
          PortPinDirectionChangeable = false
          PortPinDioAltModeChangeable = false
          PortPinModeChangeable = false
          PortPinPolaritySelect = PORT_PIN_POSITIVE_LOGIC
          PortPinOutDataSelect = PORT_PIN_OUTDT
          PortPinLevelValue = PORT_PIN_LEVEL_LOW
          PortPinSensitiveInterrupt = PORT_PIN_LEVEL_SENSITIVE
          PortPinDetectionInterrupt = PORT_PIN_ONE_EDGE
          PortPinInitialMode = DIO
          PortPinDirection = PORT_PIN_IN
          PortPinPullOption = PULL_DISABLE_PUEN2_BIT10
          PortPinPullControl = PULL_DOWN_PUD2_BIT10
        PortPin1:
          PortPinDirectionChangeable = false
          PortPinDioAltModeChangeable = false
          PortPinModeChangeable = false
          PortPinPolaritySelect = PORT_PIN_POSITIVE_LOGIC
          PortPinOutDataSelect = PORT_PIN_OUTDT
          PortPinLevelValue = PORT_PIN_LEVEL_LOW
          PortPinSensitiveInterrupt = PORT_PIN_LEVEL_SENSITIVE
          PortPinDetectionInterrupt = PORT_PIN_ONE_EDGE
          PortPinInitialMode = DIO
          PortPinDirection = PORT_PIN_IN
          PortPinPullOption = PULL_DISABLE_PUEN2_BIT11
          PortPinPullControl = PULL_DOWN_PUD2_BIT11
        PortPin2:
          PortPinDirectionChangeable = false
          PortPinDioAltModeChangeable = false
          PortPinModeChangeable = false
          PortPinPolaritySelect = PORT_PIN_POSITIVE_LOGIC
          PortPinOutDataSelect = PORT_PIN_OUTDT
          PortPinLevelValue = PORT_PIN_LEVEL_LOW
          PortPinSensitiveInterrupt = PORT_PIN_LEVEL_SENSITIVE
          PortPinDetectionInterrupt = PORT_PIN_ONE_EDGE
          PortPinInitialMode = DIO
          PortPinDirection = PORT_PIN_IN
          PortPinPullOption = PULL_DISABLE_PUEN2_BIT12
          PortPinPullControl = PULL_DOWN_PUD2_BIT12
        PortPin3:
          PortPinDirectionChangeable = false
          PortPinDioAltModeChangeable = false
          PortPinModeChangeable = false
          PortPinPolaritySelect = PORT_PIN_POSITIVE_LOGIC
          PortPinOutDataSelect = PORT_PIN_OUTDT
          PortPinLevelValue = PORT_PIN_LEVEL_LOW
          PortPinSensitiveInterrupt = PORT_PIN_LEVEL_SENSITIVE
          PortPinDetectionInterrupt = PORT_PIN_ONE_EDGE
          PortPinInitialMode = DIO
          PortPinDirection = PORT_PIN_IN
          PortPinPullOption = PULL_DISABLE_PUEN2_BIT13
          PortPinPullControl = PULL_DOWN_PUD2_BIT13
        PortPin4:
          PortPinDirectionChangeable = false
          PortPinDioAltModeChangeable = false
          PortPinModeChangeable = false
          PortPinPolaritySelect = PORT_PIN_POSITIVE_LOGIC
          PortPinOutDataSelect = PORT_PIN_OUTDT
          PortPinLevelValue = PORT_PIN_LEVEL_LOW
          PortPinSensitiveInterrupt = PORT_PIN_LEVEL_SENSITIVE
          PortPinDetectionInterrupt = PORT_PIN_ONE_EDGE
          PortPinInitialMode = DIO
          PortPinDirection = PORT_PIN_IN
          PortPinPullOption = PULL_DISABLE_PUEN2_BIT14
          PortPinPullControl = PULL_DOWN_PUD2_BIT14
        PortPin5:
          PortPinDirectionChangeable = false
          PortPinDioAltModeChangeable = false
          PortPinModeChangeable = false
          PortPinPolaritySelect = PORT_PIN_POSITIVE_LOGIC
          PortPinOutDataSelect = PORT_PIN_OUTDT
          PortPinLevelValue = PORT_PIN_LEVEL_LOW
          PortPinSensitiveInterrupt = PORT_PIN_LEVEL_SENSITIVE
          PortPinDetectionInterrupt = PORT_PIN_ONE_EDGE
          PortPinInitialMode = DIO
          PortPinDirection = PORT_PIN_IN
          PortPinPullOption = PULL_DISABLE_PUEN2_BIT15
          PortPinPullControl = PULL_DOWN_PUD2_BIT15
        PortPin6:
          PortPinDirectionChangeable = false
          PortPinDioAltModeChangeable = false
          PortPinModeChangeable = false
          PortPinPolaritySelect = PORT_PIN_POSITIVE_LOGIC
          PortPinOutDataSelect = PORT_PIN_OUTDT
          PortPinLevelValue = PORT_PIN_LEVEL_LOW
          PortPinSensitiveInterrupt = PORT_PIN_LEVEL_SENSITIVE
          PortPinDetectionInterrupt = PORT_PIN_ONE_EDGE
          PortPinInitialMode = DIO
          PortPinDirection = PORT_PIN_IN
          PortPinPullOption = PULL_DISABLE_PUEN2_BIT16
          PortPinPullControl = PULL_DOWN_PUD2_BIT16
        PortPin7:
          PortPinDirectionChangeable = false
          PortPinDioAltModeChangeable = false
          PortPinModeChangeable = false
          PortPinPolaritySelect = PORT_PIN_POSITIVE_LOGIC
          PortPinOutDataSelect = PORT_PIN_OUTDT
          PortPinLevelValue = PORT_PIN_LEVEL_LOW
          PortPinSensitiveInterrupt = PORT_PIN_LEVEL_SENSITIVE
          PortPinDetectionInterrupt = PORT_PIN_ONE_EDGE
          PortPinInitialMode = DIO
          PortPinDirection = PORT_PIN_IN
          PortPinPullOption = PULL_DISABLE_PUEN2_BIT17
          PortPinPullControl = PULL_DOWN_PUD2_BIT17
        PortPin8:
          PortPinDirectionChangeable = false
          PortPinDioAltModeChangeable = false
          PortPinModeChangeable = false
          PortPinPolaritySelect = PORT_PIN_POSITIVE_LOGIC
          PortPinOutDataSelect = PORT_PIN_OUTDT
          PortPinLevelValue = PORT_PIN_LEVEL_LOW
          PortPinSensitiveInterrupt = PORT_PIN_LEVEL_SENSITIVE
          PortPinDetectionInterrupt = PORT_PIN_ONE_EDGE
          PortPinInitialMode = DIO
          PortPinDirection = PORT_PIN_IN
          PortPinPullOption = PULL_DISABLE_PUEN2_BIT18
          PortPinPullControl = PULL_DOWN_PUD2_BIT18
        PortPin9:
          PortPinDirectionChangeable = false
          PortPinDioAltModeChangeable = false
          PortPinModeChangeable = false
          PortPinPolaritySelect = PORT_PIN_POSITIVE_LOGIC
          PortPinOutDataSelect = PORT_PIN_OUTDT
          PortPinLevelValue = PORT_PIN_LEVEL_LOW
          PortPinSensitiveInterrupt = PORT_PIN_LEVEL_SENSITIVE
          PortPinDetectionInterrupt = PORT_PIN_ONE_EDGE
          PortPinInitialMode = DIO
          PortPinDirection = PORT_PIN_IN
          PortPinPullOption = PULL_DISABLE_PUEN2_BIT19
          PortPinPullControl = PULL_DOWN_PUD2_BIT19
        PortPin10:
          PortPinDirectionChangeable = false
          PortPinDioAltModeChangeable = false
          PortPinModeChangeable = false
          PortPinPolaritySelect = PORT_PIN_POSITIVE_LOGIC
          PortPinOutDataSelect = PORT_PIN_OUTDT
          PortPinLevelValue = PORT_PIN_LEVEL_LOW
          PortPinSensitiveInterrupt = PORT_PIN_LEVEL_SENSITIVE
          PortPinDetectionInterrupt = PORT_PIN_ONE_EDGE
          PortPinInitialMode = DIO
          PortPinDirection = PORT_PIN_IN
          PortPinPullOption = PULL_DISABLE_PUEN2_BIT20
          PortPinPullControl = PULL_DOWN_PUD2_BIT20
        PortPin11:
          PortPinDirectionChangeable = false
          PortPinDioAltModeChangeable = false
          PortPinModeChangeable = false
          PortPinPolaritySelect = PORT_PIN_POSITIVE_LOGIC
          PortPinOutDataSelect = PORT_PIN_OUTDT
          PortPinLevelValue = PORT_PIN_LEVEL_LOW
          PortPinSensitiveInterrupt = PORT_PIN_LEVEL_SENSITIVE
          PortPinDetectionInterrupt = PORT_PIN_ONE_EDGE
          PortPinInitialMode = DIO
          PortPinDirection = PORT_PIN_IN
          PortPinPullOption = PULL_DISABLE_PUEN2_BIT21
          PortPinPullControl = PULL_DOWN_PUD2_BIT21
        PortPin12:
          PortPinDirectionChangeable = false
          PortPinDioAltModeChangeable = false
          PortPinModeChangeable = false
          PortPinPolaritySelect = PORT_PIN_POSITIVE_LOGIC
          PortPinOutDataSelect = PORT_PIN_OUTDT
          PortPinLevelValue = PORT_PIN_LEVEL_LOW
          PortPinSensitiveInterrupt = PORT_PIN_LEVEL_SENSITIVE
          PortPinDetectionInterrupt = PORT_PIN_ONE_EDGE
          PortPinInitialMode = DIO
          PortPinDirection = PORT_PIN_IN
          PortPinPullOption = PULL_DISABLE_PUEN2_BIT22
          PortPinPullControl = PULL_DOWN_PUD2_BIT22
        PortPin13:
          PortPinDirectionChangeable = false
          PortPinDioAltModeChangeable = false
          PortPinModeChangeable = false
          PortPinPolaritySelect = PORT_PIN_POSITIVE_LOGIC
          PortPinOutDataSelect = PORT_PIN_OUTDT
          PortPinLevelValue = PORT_PIN_LEVEL_LOW
          PortPinSensitiveInterrupt = PORT_PIN_LEVEL_SENSITIVE
          PortPinDetectionInterrupt = PORT_PIN_ONE_EDGE
          PortPinInitialMode = DIO
          PortPinDirection = PORT_PIN_IN
          PortPinPullOption = PULL_DISABLE_PUEN2_BIT23
          PortPinPullControl = PULL_DOWN_PUD2_BIT23
        PortPin14:
          PortPinDirectionChangeable = false
          PortPinDioAltModeChangeable = false
          PortPinModeChangeable = false
          PortPinPolaritySelect = PORT_PIN_POSITIVE_LOGIC
          PortPinOutDataSelect = PORT_PIN_OUTDT
          PortPinLevelValue = PORT_PIN_LEVEL_LOW
          PortPinSensitiveInterrupt = PORT_PIN_LEVEL_SENSITIVE
          PortPinDetectionInterrupt = PORT_PIN_ONE_EDGE
          PortPinInitialMode = DIO
          PortPinDirection = PORT_PIN_IN
          PortPinPullOption = PULL_ENABLE_PUEN2_BIT24
          PortPinPullControl = PULL_UP_PUD2_BIT24
        PortPin15:
          PortPinDirectionChangeable = false
          PortPinDioAltModeChangeable = false
          PortPinModeChangeable = false
          PortPinPolaritySelect = PORT_PIN_POSITIVE_LOGIC
          PortPinOutDataSelect = PORT_PIN_OUTDT
          PortPinLevelValue = PORT_PIN_LEVEL_LOW
          PortPinSensitiveInterrupt = PORT_PIN_LEVEL_SENSITIVE
          PortPinDetectionInterrupt = PORT_PIN_ONE_EDGE
          PortPinInitialMode = DIO
          PortPinDirection = PORT_PIN_IN
          PortPinPullOption = PULL_ENABLE_PUEN2_BIT25
          PortPinPullControl = PULL_UP_PUD2_BIT25
      PortGroup1
        PortPin28:
          PortPinDirectionChangeable = false
          PortPinDioAltModeChangeable = false
          PortPinModeChangeable = false
          PortPinPolaritySelect = PORT_PIN_POSITIVE_LOGIC
          PortPinOutDataSelect = PORT_PIN_OUTDT
          PortPinLevelValue = PORT_PIN_LEVEL_LOW
          PortPinSensitiveInterrupt = PORT_PIN_LEVEL_SENSITIVE
          PortPinDetectionInterrupt = PORT_PIN_ONE_EDGE
          PortPinInitialMode = DIO
          PortPinDirection = PORT_PIN_IN
          PortPinPullOption = PULL_DISABLE_PUEN2_BIT0
          PortPinPullControl = PULL_UP_PUD2_BIT0
        PortPin0:
          PortPinDirectionChangeable = false
          PortPinDioAltModeChangeable = false
          PortPinModeChangeable = false
          PortPinPolaritySelect = PORT_PIN_POSITIVE_LOGIC
          PortPinOutDataSelect = PORT_PIN_OUTDT
          PortPinLevelValue = PORT_PIN_LEVEL_LOW
          PortPinSensitiveInterrupt = PORT_PIN_LEVEL_SENSITIVE
          PortPinDetectionInterrupt = PORT_PIN_ONE_EDGE
          PortPinInitialMode = DIO
          PortPinDirection = PORT_PIN_IN
          PortPinPullOption = PULL_DISABLE_PUEN1_BIT12
          PortPinPullControl = PULL_DOWN_PUD1_BIT12
        PortPin1:
          PortPinDirectionChangeable = false
          PortPinDioAltModeChangeable = false
          PortPinModeChangeable = false
          PortPinPolaritySelect = PORT_PIN_POSITIVE_LOGIC
          PortPinOutDataSelect = PORT_PIN_OUTDT
          PortPinLevelValue = PORT_PIN_LEVEL_LOW
          PortPinSensitiveInterrupt = PORT_PIN_LEVEL_SENSITIVE
          PortPinDetectionInterrupt = PORT_PIN_ONE_EDGE
          PortPinInitialMode = DIO
          PortPinDirection = PORT_PIN_IN
          PortPinPullOption = PULL_DISABLE_PUEN1_BIT13
          PortPinPullControl = PULL_DOWN_PUD1_BIT13
        PortPin2:
          PortPinDirectionChangeable = false
          PortPinDioAltModeChangeable = false
          PortPinModeChangeable = false
          PortPinPolaritySelect = PORT_PIN_POSITIVE_LOGIC
          PortPinOutDataSelect = PORT_PIN_OUTDT
          PortPinLevelValue = PORT_PIN_LEVEL_LOW
          PortPinSensitiveInterrupt = PORT_PIN_LEVEL_SENSITIVE
          PortPinDetectionInterrupt = PORT_PIN_ONE_EDGE
          PortPinInitialMode = DIO
          PortPinDirection = PORT_PIN_IN
          PortPinPullOption = PULL_ENABLE_PUEN1_BIT14
          PortPinPullControl = PULL_DOWN_PUD1_BIT14
        PortPin3:
          PortPinDirectionChangeable = false
          PortPinDioAltModeChangeable = false
          PortPinModeChangeable = false
          PortPinPolaritySelect = PORT_PIN_POSITIVE_LOGIC
          PortPinOutDataSelect = PORT_PIN_OUTDT
          PortPinLevelValue = PORT_PIN_LEVEL_LOW
          PortPinSensitiveInterrupt = PORT_PIN_LEVEL_SENSITIVE
          PortPinDetectionInterrupt = PORT_PIN_ONE_EDGE
          PortPinInitialMode = DIO
          PortPinDirection = PORT_PIN_IN
          PortPinPullOption = PULL_DISABLE_PUEN1_BIT15
          PortPinPullControl = PULL_DOWN_PUD1_BIT15
        PortPin4:
          PortPinDirectionChangeable = false
          PortPinDioAltModeChangeable = false
          PortPinModeChangeable = false
          PortPinPolaritySelect = PORT_PIN_POSITIVE_LOGIC
          PortPinOutDataSelect = PORT_PIN_OUTDT
          PortPinLevelValue = PORT_PIN_LEVEL_LOW
          PortPinSensitiveInterrupt = PORT_PIN_LEVEL_SENSITIVE
          PortPinDetectionInterrupt = PORT_PIN_ONE_EDGE
          PortPinInitialMode = DIO
          PortPinDirection = PORT_PIN_IN
          PortPinPullOption = PULL_DISABLE_PUEN1_BIT16
          PortPinPullControl = PULL_DOWN_PUD1_BIT16
        PortPin5:
          PortPinDirectionChangeable = false
          PortPinDioAltModeChangeable = false
          PortPinModeChangeable = false
          PortPinPolaritySelect = PORT_PIN_POSITIVE_LOGIC
          PortPinOutDataSelect = PORT_PIN_OUTDT
          PortPinLevelValue = PORT_PIN_LEVEL_LOW
          PortPinSensitiveInterrupt = PORT_PIN_LEVEL_SENSITIVE
          PortPinDetectionInterrupt = PORT_PIN_ONE_EDGE
          PortPinInitialMode = DIO
          PortPinDirection = PORT_PIN_IN
          PortPinPullOption = PULL_DISABLE_PUEN1_BIT17
          PortPinPullControl = PULL_DOWN_PUD1_BIT17
        PortPin6:
          PortPinDirectionChangeable = false
          PortPinDioAltModeChangeable = false
          PortPinModeChangeable = false
          PortPinPolaritySelect = PORT_PIN_POSITIVE_LOGIC
          PortPinOutDataSelect = PORT_PIN_OUTDT
          PortPinLevelValue = PORT_PIN_LEVEL_LOW
          PortPinSensitiveInterrupt = PORT_PIN_LEVEL_SENSITIVE
          PortPinDetectionInterrupt = PORT_PIN_ONE_EDGE
          PortPinInitialMode = DIO
          PortPinDirection = PORT_PIN_IN
          PortPinPullOption = PULL_DISABLE_PUEN1_BIT18
          PortPinPullControl = PULL_DOWN_PUD1_BIT18
        PortPin7:
          PortPinDirectionChangeable = false
          PortPinDioAltModeChangeable = false
          PortPinModeChangeable = false
          PortPinPolaritySelect = PORT_PIN_POSITIVE_LOGIC
          PortPinOutDataSelect = PORT_PIN_OUTDT
          PortPinLevelValue = PORT_PIN_LEVEL_LOW
          PortPinSensitiveInterrupt = PORT_PIN_LEVEL_SENSITIVE
          PortPinDetectionInterrupt = PORT_PIN_ONE_EDGE
          PortPinInitialMode = DIO
          PortPinDirection = PORT_PIN_IN
          PortPinPullOption = PULL_DISABLE_PUEN1_BIT19
          PortPinPullControl = PULL_DOWN_PUD1_BIT19
        PortPin8:
          PortPinDirectionChangeable = false
          PortPinDioAltModeChangeable = false
          PortPinModeChangeable = false
          PortPinPolaritySelect = PORT_PIN_POSITIVE_LOGIC
          PortPinOutDataSelect = PORT_PIN_OUTDT
          PortPinLevelValue = PORT_PIN_LEVEL_LOW
          PortPinSensitiveInterrupt = PORT_PIN_LEVEL_SENSITIVE
          PortPinDetectionInterrupt = PORT_PIN_ONE_EDGE
          PortPinInitialMode = DIO
          PortPinDirection = PORT_PIN_IN
          PortPinPullOption = PULL_ENABLE_PUEN1_BIT20
          PortPinPullControl = PULL_UP_PUD1_BIT20
        PortPin9:
          PortPinDirectionChangeable = false
          PortPinDioAltModeChangeable = false
          PortPinModeChangeable = false
          PortPinPolaritySelect = PORT_PIN_POSITIVE_LOGIC
          PortPinOutDataSelect = PORT_PIN_OUTDT
          PortPinLevelValue = PORT_PIN_LEVEL_LOW
          PortPinSensitiveInterrupt = PORT_PIN_LEVEL_SENSITIVE
          PortPinDetectionInterrupt = PORT_PIN_ONE_EDGE
          PortPinInitialMode = DIO
          PortPinDirection = PORT_PIN_IN
          PortPinPullOption = PULL_ENABLE_PUEN1_BIT21
          PortPinPullControl = PULL_UP_PUD1_BIT21
        PortPin10:
          PortPinDirectionChangeable = false
          PortPinDioAltModeChangeable = false
          PortPinModeChangeable = false
          PortPinPolaritySelect = PORT_PIN_POSITIVE_LOGIC
          PortPinOutDataSelect = PORT_PIN_OUTDT
          PortPinLevelValue = PORT_PIN_LEVEL_LOW
          PortPinSensitiveInterrupt = PORT_PIN_LEVEL_SENSITIVE
          PortPinDetectionInterrupt = PORT_PIN_ONE_EDGE
          PortPinInitialMode = DIO
          PortPinDirection = PORT_PIN_IN
          PortPinPullOption = PULL_DISABLE_PUEN1_BIT22
          PortPinPullControl = PULL_DOWN_PUD1_BIT22
        PortPin11:
          PortPinDirectionChangeable = false
          PortPinDioAltModeChangeable = false
          PortPinModeChangeable = false
          PortPinPolaritySelect = PORT_PIN_POSITIVE_LOGIC
          PortPinOutDataSelect = PORT_PIN_OUTDT
          PortPinLevelValue = PORT_PIN_LEVEL_LOW
          PortPinSensitiveInterrupt = PORT_PIN_LEVEL_SENSITIVE
          PortPinDetectionInterrupt = PORT_PIN_ONE_EDGE
          PortPinInitialMode = DIO
          PortPinDirection = PORT_PIN_IN
          PortPinPullOption = PULL_ENABLE_PUEN1_BIT23
          PortPinPullControl = PULL_DOWN_PUD1_BIT23
        PortPin12:
          PortPinDirectionChangeable = false
          PortPinDioAltModeChangeable = false
          PortPinModeChangeable = false
          PortPinPolaritySelect = PORT_PIN_POSITIVE_LOGIC
          PortPinOutDataSelect = PORT_PIN_OUTDT
          PortPinLevelValue = PORT_PIN_LEVEL_LOW
          PortPinSensitiveInterrupt = PORT_PIN_LEVEL_SENSITIVE
          PortPinDetectionInterrupt = PORT_PIN_ONE_EDGE
          PortPinInitialMode = DIO
          PortPinDirection = PORT_PIN_IN
          PortPinPullOption = PULL_DISABLE_PUEN1_BIT24
          PortPinPullControl = PULL_DOWN_PUD1_BIT24
        PortPin13:
          PortPinDirectionChangeable = false
          PortPinDioAltModeChangeable = false
          PortPinModeChangeable = false
          PortPinPolaritySelect = PORT_PIN_POSITIVE_LOGIC
          PortPinOutDataSelect = PORT_PIN_OUTDT
          PortPinLevelValue = PORT_PIN_LEVEL_LOW
          PortPinSensitiveInterrupt = PORT_PIN_LEVEL_SENSITIVE
          PortPinDetectionInterrupt = PORT_PIN_ONE_EDGE
          PortPinInitialMode = DIO
          PortPinDirection = PORT_PIN_IN
          PortPinPullOption = PULL_DISABLE_PUEN1_BIT25
          PortPinPullControl = PULL_DOWN_PUD1_BIT25
        PortPin14:
          PortPinDirectionChangeable = false
          PortPinDioAltModeChangeable = false
          PortPinModeChangeable = false
          PortPinPolaritySelect = PORT_PIN_POSITIVE_LOGIC
          PortPinOutDataSelect = PORT_PIN_OUTDT
          PortPinLevelValue = PORT_PIN_LEVEL_LOW
          PortPinSensitiveInterrupt = PORT_PIN_LEVEL_SENSITIVE
          PortPinDetectionInterrupt = PORT_PIN_ONE_EDGE
          PortPinInitialMode = DIO
          PortPinDirection = PORT_PIN_IN
          PortPinPullOption = PULL_DISABLE_PUEN1_BIT26
          PortPinPullControl = PULL_DOWN_PUD1_BIT26
        PortPin15:
          PortPinDirectionChangeable = false
          PortPinDioAltModeChangeable = false
          PortPinModeChangeable = false
          PortPinPolaritySelect = PORT_PIN_POSITIVE_LOGIC
          PortPinOutDataSelect = PORT_PIN_OUTDT
          PortPinLevelValue = PORT_PIN_LEVEL_LOW
          PortPinSensitiveInterrupt = PORT_PIN_LEVEL_SENSITIVE
          PortPinDetectionInterrupt = PORT_PIN_ONE_EDGE
          PortPinInitialMode = DIO
          PortPinDirection = PORT_PIN_IN
          PortPinPullOption = PULL_DISABLE_PUEN1_BIT27
          PortPinPullControl = PULL_DOWN_PUD1_BIT27
        PortPin16:
          PortPinDirectionChangeable = false
          PortPinDioAltModeChangeable = false
          PortPinModeChangeable = false
          PortPinPolaritySelect = PORT_PIN_POSITIVE_LOGIC
          PortPinOutDataSelect = PORT_PIN_OUTDT
          PortPinLevelValue = PORT_PIN_LEVEL_LOW
          PortPinSensitiveInterrupt = PORT_PIN_LEVEL_SENSITIVE
          PortPinDetectionInterrupt = PORT_PIN_ONE_EDGE
          PortPinInitialMode = DIO
          PortPinDirection = PORT_PIN_IN
          PortPinPullOption = PULL_DISABLE_PUEN1_BIT28
          PortPinPullControl = PULL_DOWN_PUD1_BIT28
        PortPin17:
          PortPinDirectionChangeable = false
          PortPinDioAltModeChangeable = false
          PortPinModeChangeable = false
          PortPinPolaritySelect = PORT_PIN_POSITIVE_LOGIC
          PortPinOutDataSelect = PORT_PIN_OUTDT
          PortPinLevelValue = PORT_PIN_LEVEL_LOW
          PortPinSensitiveInterrupt = PORT_PIN_LEVEL_SENSITIVE
          PortPinDetectionInterrupt = PORT_PIN_ONE_EDGE
          PortPinInitialMode = DIO
          PortPinDirection = PORT_PIN_IN
          PortPinPullOption = PULL_DISABLE_PUEN1_BIT29
          PortPinPullControl = PULL_DOWN_PUD1_BIT29
        PortPin18:
          PortPinDirectionChangeable = false
          PortPinDioAltModeChangeable = false
          PortPinModeChangeable = false
          PortPinPolaritySelect = PORT_PIN_POSITIVE_LOGIC
          PortPinOutDataSelect = PORT_PIN_OUTDT
          PortPinLevelValue = PORT_PIN_LEVEL_LOW
          PortPinSensitiveInterrupt = PORT_PIN_LEVEL_SENSITIVE
          PortPinDetectionInterrupt = PORT_PIN_ONE_EDGE
          PortPinInitialMode = DIO
          PortPinDirection = PORT_PIN_IN
          PortPinPullOption = PULL_DISABLE_PUEN1_BIT30
          PortPinPullControl = PULL_DOWN_PUD1_BIT30
        PortPin19:
          PortPinDirectionChangeable = false
          PortPinDioAltModeChangeable = false
          PortPinModeChangeable = false
          PortPinPolaritySelect = PORT_PIN_POSITIVE_LOGIC
          PortPinOutDataSelect = PORT_PIN_OUTDT
          PortPinLevelValue = PORT_PIN_LEVEL_LOW
          PortPinSensitiveInterrupt = PORT_PIN_LEVEL_SENSITIVE
          PortPinDetectionInterrupt = PORT_PIN_ONE_EDGE
          PortPinInitialMode = DIO
          PortPinDirection = PORT_PIN_IN
          PortPinPullOption = PULL_DISABLE_PUEN1_BIT31
          PortPinPullControl = PULL_DOWN_PUD1_BIT31
        PortPin20:
          PortPinDirectionChangeable = false
          PortPinDioAltModeChangeable = false
          PortPinModeChangeable = false
          PortPinPolaritySelect = PORT_PIN_POSITIVE_LOGIC
          PortPinOutDataSelect = PORT_PIN_OUTDT
          PortPinLevelValue = PORT_PIN_LEVEL_LOW
          PortPinSensitiveInterrupt = PORT_PIN_LEVEL_SENSITIVE
          PortPinDetectionInterrupt = PORT_PIN_ONE_EDGE
          PortPinInitialMode = DIO
          PortPinDirection = PORT_PIN_IN
          PortPinPullOption = PULL_ENABLE_PUEN2_BIT1
          PortPinPullControl = PULL_UP_PUD2_BIT1
        PortPin21:
          PortPinDirectionChangeable = false
          PortPinDioAltModeChangeable = false
          PortPinModeChangeable = false
          PortPinPolaritySelect = PORT_PIN_POSITIVE_LOGIC
          PortPinOutDataSelect = PORT_PIN_OUTDT
          PortPinLevelValue = PORT_PIN_LEVEL_LOW
          PortPinSensitiveInterrupt = PORT_PIN_LEVEL_SENSITIVE
          PortPinDetectionInterrupt = PORT_PIN_ONE_EDGE
          PortPinInitialMode = DIO
          PortPinDirection = PORT_PIN_IN
          PortPinPullOption = PULL_ENABLE_PUEN2_BIT2
          PortPinPullControl = PULL_UP_PUD2_BIT2
        PortPin22:
          PortPinDirectionChangeable = false
          PortPinDioAltModeChangeable = false
          PortPinModeChangeable = false
          PortPinPolaritySelect = PORT_PIN_POSITIVE_LOGIC
          PortPinOutDataSelect = PORT_PIN_OUTDT
          PortPinLevelValue = PORT_PIN_LEVEL_LOW
          PortPinSensitiveInterrupt = PORT_PIN_LEVEL_SENSITIVE
          PortPinDetectionInterrupt = PORT_PIN_ONE_EDGE
          PortPinInitialMode = DIO
          PortPinDirection = PORT_PIN_IN
          PortPinPullOption = PULL_DISABLE_PUEN2_BIT3
          PortPinPullControl = PULL_DOWN_PUD2_BIT3
        PortPin23:
          PortPinDirectionChangeable = false
          PortPinDioAltModeChangeable = false
          PortPinModeChangeable = false
          PortPinPolaritySelect = PORT_PIN_POSITIVE_LOGIC
          PortPinOutDataSelect = PORT_PIN_OUTDT
          PortPinLevelValue = PORT_PIN_LEVEL_LOW
          PortPinSensitiveInterrupt = PORT_PIN_LEVEL_SENSITIVE
          PortPinDetectionInterrupt = PORT_PIN_ONE_EDGE
          PortPinInitialMode = DIO
          PortPinDirection = PORT_PIN_IN
          PortPinPullOption = PULL_DISABLE_PUEN2_BIT4
          PortPinPullControl = PULL_DOWN_PUD2_BIT4
        PortPin24:
          PortPinDirectionChangeable = false
          PortPinDioAltModeChangeable = false
          PortPinModeChangeable = false
          PortPinPolaritySelect = PORT_PIN_POSITIVE_LOGIC
          PortPinOutDataSelect = PORT_PIN_OUTDT
          PortPinLevelValue = PORT_PIN_LEVEL_LOW
          PortPinSensitiveInterrupt = PORT_PIN_LEVEL_SENSITIVE
          PortPinDetectionInterrupt = PORT_PIN_ONE_EDGE
          PortPinInitialMode = DIO
          PortPinDirection = PORT_PIN_IN
          PortPinPullOption = PULL_ENABLE_PUEN2_BIT5
          PortPinPullControl = PULL_UP_PUD2_BIT5
        PortPin25:
          PortPinDirectionChangeable = false
          PortPinDioAltModeChangeable = false
          PortPinModeChangeable = false
          PortPinPolaritySelect = PORT_PIN_POSITIVE_LOGIC
          PortPinOutDataSelect = PORT_PIN_OUTDT
          PortPinLevelValue = PORT_PIN_LEVEL_LOW
          PortPinSensitiveInterrupt = PORT_PIN_LEVEL_SENSITIVE
          PortPinDetectionInterrupt = PORT_PIN_ONE_EDGE
          PortPinInitialMode = DIO
          PortPinDirection = PORT_PIN_IN
          PortPinPullOption = PULL_ENABLE_PUEN2_BIT6
          PortPinPullControl = PULL_UP_PUD2_BIT6
        PortPin26:
          PortPinDirectionChangeable = false
          PortPinDioAltModeChangeable = false
          PortPinModeChangeable = false
          PortPinPolaritySelect = PORT_PIN_POSITIVE_LOGIC
          PortPinOutDataSelect = PORT_PIN_OUTDT
          PortPinLevelValue = PORT_PIN_LEVEL_LOW
          PortPinSensitiveInterrupt = PORT_PIN_LEVEL_SENSITIVE
          PortPinDetectionInterrupt = PORT_PIN_ONE_EDGE
          PortPinInitialMode = DIO
          PortPinDirection = PORT_PIN_IN
          PortPinPullOption = PULL_ENABLE_PUEN2_BIT7
          PortPinPullControl = PULL_UP_PUD2_BIT7
        PortPin27:
          PortPinDirectionChangeable = false
          PortPinDioAltModeChangeable = false
          PortPinModeChangeable = false
          PortPinPolaritySelect = PORT_PIN_POSITIVE_LOGIC
          PortPinOutDataSelect = PORT_PIN_OUTDT
          PortPinLevelValue = PORT_PIN_LEVEL_LOW
          PortPinSensitiveInterrupt = PORT_PIN_LEVEL_SENSITIVE
          PortPinDetectionInterrupt = PORT_PIN_ONE_EDGE
          PortPinInitialMode = DIO
          PortPinDirection = PORT_PIN_IN
          PortPinPullOption = PULL_ENABLE_PUEN2_BIT8
          PortPinPullControl = PULL_UP_PUD2_BIT8
      PortGroup2
        PortPin0:
          PortPinDirectionChangeable = false
          PortPinDioAltModeChangeable = false
          PortPinModeChangeable = false
          PortPinPolaritySelect = PORT_PIN_POSITIVE_LOGIC
          PortPinOutDataSelect = PORT_PIN_OUTDT
          PortPinLevelValue = PORT_PIN_LEVEL_LOW
          PortPinSensitiveInterrupt = PORT_PIN_LEVEL_SENSITIVE
          PortPinDetectionInterrupt = PORT_PIN_ONE_EDGE
          PortPinInitialMode = DIO
          PortPinDirection = PORT_PIN_IN
          PortPinPullOption = PULL_ENABLE_PUEN1_BIT3
          PortPinPullControl = PULL_UP_PUD1_BIT3
        PortPin1:
          PortPinDirectionChangeable = false
          PortPinDioAltModeChangeable = false
          PortPinModeChangeable = false
          PortPinPolaritySelect = PORT_PIN_POSITIVE_LOGIC
          PortPinOutDataSelect = PORT_PIN_OUTDT
          PortPinLevelValue = PORT_PIN_LEVEL_LOW
          PortPinSensitiveInterrupt = PORT_PIN_LEVEL_SENSITIVE
          PortPinDetectionInterrupt = PORT_PIN_ONE_EDGE
          PortPinInitialMode = DIO
          PortPinDirection = PORT_PIN_IN
          PortPinPullOption = PULL_ENABLE_PUEN1_BIT4
          PortPinPullControl = PULL_UP_PUD1_BIT4
        PortPin2:
          PortPinDirectionChangeable = false
          PortPinDioAltModeChangeable = false
          PortPinModeChangeable = false
          PortPinPolaritySelect = PORT_PIN_POSITIVE_LOGIC
          PortPinOutDataSelect = PORT_PIN_OUTDT
          PortPinLevelValue = PORT_PIN_LEVEL_LOW
          PortPinSensitiveInterrupt = PORT_PIN_LEVEL_SENSITIVE
          PortPinDetectionInterrupt = PORT_PIN_ONE_EDGE
          PortPinInitialMode = DIO
          PortPinDirection = PORT_PIN_IN
          PortPinPullOption = PULL_ENABLE_PUEN1_BIT5
          PortPinPullControl = PULL_UP_PUD1_BIT5
        PortPin3:
          PortPinDirectionChangeable = false
          PortPinDioAltModeChangeable = false
          PortPinModeChangeable = false
          PortPinPolaritySelect = PORT_PIN_POSITIVE_LOGIC
          PortPinOutDataSelect = PORT_PIN_OUTDT
          PortPinLevelValue = PORT_PIN_LEVEL_LOW
          PortPinSensitiveInterrupt = PORT_PIN_LEVEL_SENSITIVE
          PortPinDetectionInterrupt = PORT_PIN_ONE_EDGE
          PortPinInitialMode = DIO
          PortPinDirection = PORT_PIN_IN
          PortPinPullOption = PULL_ENABLE_PUEN1_BIT6
          PortPinPullControl = PULL_UP_PUD1_BIT6
        PortPin4:
          PortPinDirectionChangeable = false
          PortPinDioAltModeChangeable = false
          PortPinModeChangeable = false
          PortPinPolaritySelect = PORT_PIN_POSITIVE_LOGIC
          PortPinOutDataSelect = PORT_PIN_OUTDT
          PortPinLevelValue = PORT_PIN_LEVEL_LOW
          PortPinSensitiveInterrupt = PORT_PIN_LEVEL_SENSITIVE
          PortPinDetectionInterrupt = PORT_PIN_ONE_EDGE
          PortPinInitialMode = DIO
          PortPinDirection = PORT_PIN_IN
          PortPinPullOption = PULL_ENABLE_PUEN1_BIT7
          PortPinPullControl = PULL_UP_PUD1_BIT7
        PortPin5:
          PortPinDirectionChangeable = false
          PortPinDioAltModeChangeable = false
          PortPinModeChangeable = false
          PortPinPolaritySelect = PORT_PIN_POSITIVE_LOGIC
          PortPinOutDataSelect = PORT_PIN_OUTDT
          PortPinLevelValue = PORT_PIN_LEVEL_LOW
          PortPinSensitiveInterrupt = PORT_PIN_LEVEL_SENSITIVE
          PortPinDetectionInterrupt = PORT_PIN_ONE_EDGE
          PortPinInitialMode = DIO
          PortPinDirection = PORT_PIN_IN
          PortPinPullOption = PULL_ENABLE_PUEN1_BIT8
          PortPinPullControl = PULL_UP_PUD1_BIT8
        PortPin6:
          PortPinDirectionChangeable = false
          PortPinDioAltModeChangeable = false
          PortPinModeChangeable = false
          PortPinPolaritySelect = PORT_PIN_POSITIVE_LOGIC
          PortPinOutDataSelect = PORT_PIN_OUTDT
          PortPinLevelValue = PORT_PIN_LEVEL_LOW
          PortPinSensitiveInterrupt = PORT_PIN_LEVEL_SENSITIVE
          PortPinDetectionInterrupt = PORT_PIN_ONE_EDGE
          PortPinInitialMode = DIO
          PortPinDirection = PORT_PIN_IN
          PortPinPullOption = PULL_ENABLE_PUEN1_BIT9
          PortPinPullControl = PULL_UP_PUD1_BIT9
        PortPin7:
          PortPinDirectionChangeable = false
          PortPinDioAltModeChangeable = false
          PortPinModeChangeable = false
          PortPinPolaritySelect = PORT_PIN_POSITIVE_LOGIC
          PortPinOutDataSelect = PORT_PIN_OUTDT
          PortPinLevelValue = PORT_PIN_LEVEL_LOW
          PortPinSensitiveInterrupt = PORT_PIN_LEVEL_SENSITIVE
          PortPinDetectionInterrupt = PORT_PIN_ONE_EDGE
          PortPinInitialMode = DIO
          PortPinDirection = PORT_PIN_IN
          PortPinPullOption = PULL_ENABLE_PUEN1_BIT10
          PortPinPullControl = PULL_UP_PUD1_BIT10
        PortPin8:
          PortPinDirectionChangeable = false
          PortPinDioAltModeChangeable = false
          PortPinModeChangeable = false
          PortPinPolaritySelect = PORT_PIN_POSITIVE_LOGIC
          PortPinOutDataSelect = PORT_PIN_OUTDT
          PortPinLevelValue = PORT_PIN_LEVEL_LOW
          PortPinSensitiveInterrupt = PORT_PIN_LEVEL_SENSITIVE
          PortPinDetectionInterrupt = PORT_PIN_ONE_EDGE
          PortPinInitialMode = DIO
          PortPinDirection = PORT_PIN_IN
          PortPinPullOption = PULL_ENABLE_PUEN1_BIT11
          PortPinPullControl = PULL_UP_PUD1_BIT11
        PortPin9:
          PortPinDirectionChangeable = false
          PortPinDioAltModeChangeable = false
          PortPinModeChangeable = false
          PortPinPolaritySelect = PORT_PIN_POSITIVE_LOGIC
          PortPinOutDataSelect = PORT_PIN_OUTDT
          PortPinLevelValue = PORT_PIN_LEVEL_LOW
          PortPinSensitiveInterrupt = PORT_PIN_LEVEL_SENSITIVE
          PortPinDetectionInterrupt = PORT_PIN_ONE_EDGE
          PortPinInitialMode = DIO
          PortPinDirection = PORT_PIN_IN
          PortPinPullOption = PULL_DISABLE_PUEN0_BIT29
          PortPinPullControl = PULL_DOWN_PUD0_BIT29
        PortPin10:
          PortPinDirectionChangeable = false
          PortPinDioAltModeChangeable = false
          PortPinModeChangeable = false
          PortPinPolaritySelect = PORT_PIN_POSITIVE_LOGIC
          PortPinOutDataSelect = PORT_PIN_OUTDT
          PortPinLevelValue = PORT_PIN_LEVEL_LOW
          PortPinSensitiveInterrupt = PORT_PIN_LEVEL_SENSITIVE
          PortPinDetectionInterrupt = PORT_PIN_ONE_EDGE
          PortPinInitialMode = DIO
          PortPinDirection = PORT_PIN_IN
          PortPinPullOption = PULL_ENABLE_PUEN0_BIT30
          PortPinPullControl = PULL_DOWN_PUD0_BIT30
        PortPin11:
          PortPinDirectionChangeable = false
          PortPinDioAltModeChangeable = false
          PortPinModeChangeable = false
          PortPinPolaritySelect = PORT_PIN_POSITIVE_LOGIC
          PortPinOutDataSelect = PORT_PIN_OUTDT
          PortPinLevelValue = PORT_PIN_LEVEL_LOW
          PortPinSensitiveInterrupt = PORT_PIN_LEVEL_SENSITIVE
          PortPinDetectionInterrupt = PORT_PIN_ONE_EDGE
          PortPinInitialMode = DIO
          PortPinDirection = PORT_PIN_IN
          PortPinPullOption = PULL_ENABLE_PUEN0_BIT31
          PortPinPullControl = PULL_DOWN_PUD0_BIT31
        PortPin12:
          PortPinDirectionChangeable = false
          PortPinDioAltModeChangeable = false
          PortPinModeChangeable = false
          PortPinPolaritySelect = PORT_PIN_POSITIVE_LOGIC
          PortPinOutDataSelect = PORT_PIN_OUTDT
          PortPinLevelValue = PORT_PIN_LEVEL_LOW
          PortPinSensitiveInterrupt = PORT_PIN_LEVEL_SENSITIVE
          PortPinDetectionInterrupt = PORT_PIN_ONE_EDGE
          PortPinInitialMode = DIO
          PortPinDirection = PORT_PIN_IN
          PortPinPullOption = PULL_ENABLE_PUEN1_BIT0
          PortPinPullControl = PULL_DOWN_PUD1_BIT0
        PortPin13:
          PortPinDirectionChangeable = false
          PortPinDioAltModeChangeable = false
          PortPinModeChangeable = false
          PortPinPolaritySelect = PORT_PIN_POSITIVE_LOGIC
          PortPinOutDataSelect = PORT_PIN_OUTDT
          PortPinLevelValue = PORT_PIN_LEVEL_LOW
          PortPinSensitiveInterrupt = PORT_PIN_LEVEL_SENSITIVE
          PortPinDetectionInterrupt = PORT_PIN_ONE_EDGE
          PortPinInitialMode = DIO
          PortPinDirection = PORT_PIN_IN
          PortPinPullOption = PULL_ENABLE_PUEN1_BIT1
          PortPinPullControl = PULL_UP_PUD1_BIT1
        PortPin14:
          PortPinDirectionChangeable = false
          PortPinDioAltModeChangeable = false
          PortPinModeChangeable = false
          PortPinPolaritySelect = PORT_PIN_POSITIVE_LOGIC
          PortPinOutDataSelect = PORT_PIN_OUTDT
          PortPinLevelValue = PORT_PIN_LEVEL_LOW
          PortPinSensitiveInterrupt = PORT_PIN_LEVEL_SENSITIVE
          PortPinDetectionInterrupt = PORT_PIN_ONE_EDGE
          PortPinInitialMode = DIO
          PortPinDirection = PORT_PIN_IN
          PortPinPullOption = PULL_ENABLE_PUEN1_BIT2
          PortPinPullControl = PULL_UP_PUD1_BIT2
      PortGroup3
        PortPin0:
          PortPinDirectionChangeable = false
          PortPinDioAltModeChangeable = false
          PortPinModeChangeable = false
          PortPinPolaritySelect = PORT_PIN_POSITIVE_LOGIC
          PortPinOutDataSelect = PORT_PIN_OUTDT
          PortPinLevelValue = PORT_PIN_LEVEL_LOW
          PortPinSensitiveInterrupt = PORT_PIN_LEVEL_SENSITIVE
          PortPinDetectionInterrupt = PORT_PIN_ONE_EDGE
          PortPinInitialMode = DIO
          PortPinDirection = PORT_PIN_IN
          PortPinPullOption = PULL_DISABLE_PUEN3_BIT10
          PortPinPullControl = PULL_DOWN_PUD3_BIT10
        PortPin1:
          PortPinDirectionChangeable = false
          PortPinDioAltModeChangeable = false
          PortPinModeChangeable = false
          PortPinPolaritySelect = PORT_PIN_POSITIVE_LOGIC
          PortPinOutDataSelect = PORT_PIN_OUTDT
          PortPinLevelValue = PORT_PIN_LEVEL_LOW
          PortPinSensitiveInterrupt = PORT_PIN_LEVEL_SENSITIVE
          PortPinDetectionInterrupt = PORT_PIN_ONE_EDGE
          PortPinInitialMode = DIO
          PortPinDirection = PORT_PIN_IN
          PortPinPullOption = PULL_DISABLE_PUEN3_BIT11
          PortPinPullControl = PULL_DOWN_PUD3_BIT11
        PortPin2:
          PortPinDirectionChangeable = false
          PortPinDioAltModeChangeable = false
          PortPinModeChangeable = false
          PortPinPolaritySelect = PORT_PIN_POSITIVE_LOGIC
          PortPinOutDataSelect = PORT_PIN_OUTDT
          PortPinLevelValue = PORT_PIN_LEVEL_LOW
          PortPinSensitiveInterrupt = PORT_PIN_LEVEL_SENSITIVE
          PortPinDetectionInterrupt = PORT_PIN_ONE_EDGE
          PortPinInitialMode = DIO
          PortPinDirection = PORT_PIN_IN
          PortPinPullOption = PULL_DISABLE_PUEN3_BIT12
          PortPinPullControl = PULL_DOWN_PUD3_BIT12
        PortPin3:
          PortPinDirectionChangeable = false
          PortPinDioAltModeChangeable = false
          PortPinModeChangeable = false
          PortPinPolaritySelect = PORT_PIN_POSITIVE_LOGIC
          PortPinOutDataSelect = PORT_PIN_OUTDT
          PortPinLevelValue = PORT_PIN_LEVEL_LOW
          PortPinSensitiveInterrupt = PORT_PIN_LEVEL_SENSITIVE
          PortPinDetectionInterrupt = PORT_PIN_ONE_EDGE
          PortPinInitialMode = DIO
          PortPinDirection = PORT_PIN_IN
          PortPinPullOption = PULL_DISABLE_PUEN3_BIT13
          PortPinPullControl = PULL_DOWN_PUD3_BIT13
        PortPin4:
          PortPinDirectionChangeable = false
          PortPinDioAltModeChangeable = false
          PortPinModeChangeable = false
          PortPinPolaritySelect = PORT_PIN_POSITIVE_LOGIC
          PortPinOutDataSelect = PORT_PIN_OUTDT
          PortPinLevelValue = PORT_PIN_LEVEL_LOW
          PortPinSensitiveInterrupt = PORT_PIN_LEVEL_SENSITIVE
          PortPinDetectionInterrupt = PORT_PIN_ONE_EDGE
          PortPinInitialMode = DIO
          PortPinDirection = PORT_PIN_IN
          PortPinPullOption = PULL_DISABLE_PUEN3_BIT14
          PortPinPullControl = PULL_DOWN_PUD3_BIT14
        PortPin5:
          PortPinDirectionChangeable = false
          PortPinDioAltModeChangeable = false
          PortPinModeChangeable = false
          PortPinPolaritySelect = PORT_PIN_POSITIVE_LOGIC
          PortPinOutDataSelect = PORT_PIN_OUTDT
          PortPinLevelValue = PORT_PIN_LEVEL_LOW
          PortPinSensitiveInterrupt = PORT_PIN_LEVEL_SENSITIVE
          PortPinDetectionInterrupt = PORT_PIN_ONE_EDGE
          PortPinInitialMode = DIO
          PortPinDirection = PORT_PIN_IN
          PortPinPullOption = PULL_DISABLE_PUEN3_BIT15
          PortPinPullControl = PULL_DOWN_PUD3_BIT15
        PortPin6:
          PortPinDirectionChangeable = false
          PortPinDioAltModeChangeable = false
          PortPinModeChangeable = false
          PortPinPolaritySelect = PORT_PIN_POSITIVE_LOGIC
          PortPinOutDataSelect = PORT_PIN_OUTDT
          PortPinLevelValue = PORT_PIN_LEVEL_LOW
          PortPinSensitiveInterrupt = PORT_PIN_LEVEL_SENSITIVE
          PortPinDetectionInterrupt = PORT_PIN_ONE_EDGE
          PortPinInitialMode = DIO
          PortPinDirection = PORT_PIN_IN
          PortPinPullOption = PULL_DISABLE_PUEN3_BIT16
          PortPinPullControl = PULL_DOWN_PUD3_BIT16
        PortPin7:
          PortPinDirectionChangeable = false
          PortPinDioAltModeChangeable = false
          PortPinModeChangeable = false
          PortPinPolaritySelect = PORT_PIN_POSITIVE_LOGIC
          PortPinOutDataSelect = PORT_PIN_OUTDT
          PortPinLevelValue = PORT_PIN_LEVEL_LOW
          PortPinSensitiveInterrupt = PORT_PIN_LEVEL_SENSITIVE
          PortPinDetectionInterrupt = PORT_PIN_ONE_EDGE
          PortPinInitialMode = DIO
          PortPinDirection = PORT_PIN_IN
          PortPinPullOption = PULL_DISABLE_PUEN3_BIT17
          PortPinPullControl = PULL_DOWN_PUD3_BIT17
        PortPin8:
          PortPinDirectionChangeable = false
          PortPinDioAltModeChangeable = false
          PortPinModeChangeable = false
          PortPinPolaritySelect = PORT_PIN_POSITIVE_LOGIC
          PortPinOutDataSelect = PORT_PIN_OUTDT
          PortPinLevelValue = PORT_PIN_LEVEL_LOW
          PortPinSensitiveInterrupt = PORT_PIN_LEVEL_SENSITIVE
          PortPinDetectionInterrupt = PORT_PIN_ONE_EDGE
          PortPinInitialMode = DIO
          PortPinDirection = PORT_PIN_IN
          PortPinPullOption = PULL_DISABLE_PUEN3_BIT18
          PortPinPullControl = PULL_DOWN_PUD3_BIT18
        PortPin9:
          PortPinDirectionChangeable = false
          PortPinDioAltModeChangeable = false
          PortPinModeChangeable = false
          PortPinPolaritySelect = PORT_PIN_POSITIVE_LOGIC
          PortPinOutDataSelect = PORT_PIN_OUTDT
          PortPinLevelValue = PORT_PIN_LEVEL_LOW
          PortPinSensitiveInterrupt = PORT_PIN_LEVEL_SENSITIVE
          PortPinDetectionInterrupt = PORT_PIN_ONE_EDGE
          PortPinInitialMode = DIO
          PortPinDirection = PORT_PIN_IN
          PortPinPullOption = PULL_DISABLE_PUEN3_BIT19
          PortPinPullControl = PULL_DOWN_PUD3_BIT19
        PortPin10:
          PortPinDirectionChangeable = false
          PortPinDioAltModeChangeable = false
          PortPinModeChangeable = false
          PortPinPolaritySelect = PORT_PIN_POSITIVE_LOGIC
          PortPinOutDataSelect = PORT_PIN_OUTDT
          PortPinLevelValue = PORT_PIN_LEVEL_LOW
          PortPinSensitiveInterrupt = PORT_PIN_LEVEL_SENSITIVE
          PortPinDetectionInterrupt = PORT_PIN_ONE_EDGE
          PortPinInitialMode = DIO
          PortPinDirection = PORT_PIN_IN
          PortPinPullOption = PULL_DISABLE_PUEN3_BIT20
          PortPinPullControl = PULL_DOWN_PUD3_BIT20
        PortPin11:
          PortPinDirectionChangeable = false
          PortPinDioAltModeChangeable = false
          PortPinModeChangeable = false
          PortPinPolaritySelect = PORT_PIN_POSITIVE_LOGIC
          PortPinOutDataSelect = PORT_PIN_OUTDT
          PortPinLevelValue = PORT_PIN_LEVEL_LOW
          PortPinSensitiveInterrupt = PORT_PIN_LEVEL_SENSITIVE
          PortPinDetectionInterrupt = PORT_PIN_ONE_EDGE
          PortPinInitialMode = DIO
          PortPinDirection = PORT_PIN_IN
          PortPinPullOption = PULL_DISABLE_PUEN3_BIT21
          PortPinPullControl = PULL_DOWN_PUD3_BIT21
        PortPin12:
          PortPinDirectionChangeable = false
          PortPinDioAltModeChangeable = false
          PortPinModeChangeable = false
          PortPinPolaritySelect = PORT_PIN_POSITIVE_LOGIC
          PortPinOutDataSelect = PORT_PIN_OUTDT
          PortPinLevelValue = PORT_PIN_LEVEL_LOW
          PortPinSensitiveInterrupt = PORT_PIN_LEVEL_SENSITIVE
          PortPinDetectionInterrupt = PORT_PIN_ONE_EDGE
          PortPinInitialMode = DIO
          PortPinDirection = PORT_PIN_IN
          PortPinPullOption = PULL_ENABLE_PUEN4_BIT8
          PortPinPullControl = PULL_UP_PUD4_BIT8
        PortPin13:
          PortPinDirectionChangeable = false
          PortPinDioAltModeChangeable = false
          PortPinModeChangeable = false
          PortPinPolaritySelect = PORT_PIN_POSITIVE_LOGIC
          PortPinOutDataSelect = PORT_PIN_OUTDT
          PortPinLevelValue = PORT_PIN_LEVEL_LOW
          PortPinSensitiveInterrupt = PORT_PIN_LEVEL_SENSITIVE
          PortPinDetectionInterrupt = PORT_PIN_ONE_EDGE
          PortPinInitialMode = DIO
          PortPinDirection = PORT_PIN_IN
          PortPinPullOption = PULL_ENABLE_PUEN4_BIT9
          PortPinPullControl = PULL_UP_PUD4_BIT9
        PortPin14:
          PortPinDirectionChangeable = false
          PortPinDioAltModeChangeable = false
          PortPinModeChangeable = false
          PortPinPolaritySelect = PORT_PIN_POSITIVE_LOGIC
          PortPinOutDataSelect = PORT_PIN_OUTDT
          PortPinLevelValue = PORT_PIN_LEVEL_LOW
          PortPinSensitiveInterrupt = PORT_PIN_LEVEL_SENSITIVE
          PortPinDetectionInterrupt = PORT_PIN_ONE_EDGE
          PortPinInitialMode = DIO
          PortPinDirection = PORT_PIN_IN
          PortPinPullOption = PULL_ENABLE_PUEN4_BIT10
          PortPinPullControl = PULL_UP_PUD4_BIT10
        PortPin15:
          PortPinDirectionChangeable = false
          PortPinDioAltModeChangeable = false
          PortPinModeChangeable = false
          PortPinPolaritySelect = PORT_PIN_POSITIVE_LOGIC
          PortPinOutDataSelect = PORT_PIN_OUTDT
          PortPinLevelValue = PORT_PIN_LEVEL_LOW
          PortPinSensitiveInterrupt = PORT_PIN_LEVEL_SENSITIVE
          PortPinDetectionInterrupt = PORT_PIN_ONE_EDGE
          PortPinInitialMode = DIO
          PortPinDirection = PORT_PIN_IN
          PortPinPullOption = PULL_ENABLE_PUEN4_BIT11
          PortPinPullControl = PULL_UP_PUD4_BIT11
      PortGroup4
        PortPin0:
          PortPinDirectionChangeable = false
          PortPinDioAltModeChangeable = false
          PortPinModeChangeable = false
          PortPinPolaritySelect = PORT_PIN_POSITIVE_LOGIC
          PortPinOutDataSelect = PORT_PIN_OUTDT
          PortPinLevelValue = PORT_PIN_LEVEL_LOW
          PortPinSensitiveInterrupt = PORT_PIN_LEVEL_SENSITIVE
          PortPinDetectionInterrupt = PORT_PIN_ONE_EDGE
          PortPinInitialMode = DIO
          PortPinDirection = PORT_PIN_IN
          PortPinPullOption = PULL_DISABLE_PUEN3_BIT22
          PortPinPullControl = PULL_DOWN_PUD3_BIT22
        PortPin1:
          PortPinDirectionChangeable = false
          PortPinDioAltModeChangeable = false
          PortPinModeChangeable = false
          PortPinPolaritySelect = PORT_PIN_POSITIVE_LOGIC
          PortPinOutDataSelect = PORT_PIN_OUTDT
          PortPinLevelValue = PORT_PIN_LEVEL_LOW
          PortPinSensitiveInterrupt = PORT_PIN_LEVEL_SENSITIVE
          PortPinDetectionInterrupt = PORT_PIN_ONE_EDGE
          PortPinInitialMode = DIO
          PortPinDirection = PORT_PIN_IN
          PortPinPullOption = PULL_DISABLE_PUEN3_BIT23
          PortPinPullControl = PULL_DOWN_PUD3_BIT23
        PortPin2:
          PortPinDirectionChangeable = false
          PortPinDioAltModeChangeable = false
          PortPinModeChangeable = false
          PortPinPolaritySelect = PORT_PIN_POSITIVE_LOGIC
          PortPinOutDataSelect = PORT_PIN_OUTDT
          PortPinLevelValue = PORT_PIN_LEVEL_LOW
          PortPinSensitiveInterrupt = PORT_PIN_LEVEL_SENSITIVE
          PortPinDetectionInterrupt = PORT_PIN_ONE_EDGE
          PortPinInitialMode = DIO
          PortPinDirection = PORT_PIN_IN
          PortPinPullOption = PULL_DISABLE_PUEN3_BIT24
          PortPinPullControl = PULL_DOWN_PUD3_BIT24
        PortPin3:
          PortPinDirectionChangeable = false
          PortPinDioAltModeChangeable = false
          PortPinModeChangeable = false
          PortPinPolaritySelect = PORT_PIN_POSITIVE_LOGIC
          PortPinOutDataSelect = PORT_PIN_OUTDT
          PortPinLevelValue = PORT_PIN_LEVEL_LOW
          PortPinSensitiveInterrupt = PORT_PIN_LEVEL_SENSITIVE
          PortPinDetectionInterrupt = PORT_PIN_ONE_EDGE
          PortPinInitialMode = DIO
          PortPinDirection = PORT_PIN_IN
          PortPinPullOption = PULL_DISABLE_PUEN3_BIT25
          PortPinPullControl = PULL_DOWN_PUD3_BIT25
        PortPin4:
          PortPinDirectionChangeable = false
          PortPinDioAltModeChangeable = false
          PortPinModeChangeable = false
          PortPinPolaritySelect = PORT_PIN_POSITIVE_LOGIC
          PortPinOutDataSelect = PORT_PIN_OUTDT
          PortPinLevelValue = PORT_PIN_LEVEL_LOW
          PortPinSensitiveInterrupt = PORT_PIN_LEVEL_SENSITIVE
          PortPinDetectionInterrupt = PORT_PIN_ONE_EDGE
          PortPinInitialMode = DIO
          PortPinDirection = PORT_PIN_IN
          PortPinPullOption = PULL_DISABLE_PUEN3_BIT26
          PortPinPullControl = PULL_DOWN_PUD3_BIT26
        PortPin5:
          PortPinDirectionChangeable = false
          PortPinDioAltModeChangeable = false
          PortPinModeChangeable = false
          PortPinPolaritySelect = PORT_PIN_POSITIVE_LOGIC
          PortPinOutDataSelect = PORT_PIN_OUTDT
          PortPinLevelValue = PORT_PIN_LEVEL_LOW
          PortPinSensitiveInterrupt = PORT_PIN_LEVEL_SENSITIVE
          PortPinDetectionInterrupt = PORT_PIN_ONE_EDGE
          PortPinInitialMode = DIO
          PortPinDirection = PORT_PIN_IN
          PortPinPullOption = PULL_DISABLE_PUEN3_BIT27
          PortPinPullControl = PULL_DOWN_PUD3_BIT27
        PortPin6:
          PortPinDirectionChangeable = false
          PortPinDioAltModeChangeable = false
          PortPinModeChangeable = false
          PortPinPolaritySelect = PORT_PIN_POSITIVE_LOGIC
          PortPinOutDataSelect = PORT_PIN_OUTDT
          PortPinLevelValue = PORT_PIN_LEVEL_LOW
          PortPinSensitiveInterrupt = PORT_PIN_LEVEL_SENSITIVE
          PortPinDetectionInterrupt = PORT_PIN_ONE_EDGE
          PortPinInitialMode = DIO
          PortPinDirection = PORT_PIN_IN
          PortPinPullOption = PULL_DISABLE_PUEN3_BIT28
          PortPinPullControl = PULL_DOWN_PUD3_BIT28
        PortPin7:
          PortPinDirectionChangeable = false
          PortPinDioAltModeChangeable = false
          PortPinModeChangeable = false
          PortPinPolaritySelect = PORT_PIN_POSITIVE_LOGIC
          PortPinOutDataSelect = PORT_PIN_OUTDT
          PortPinLevelValue = PORT_PIN_LEVEL_LOW
          PortPinSensitiveInterrupt = PORT_PIN_LEVEL_SENSITIVE
          PortPinDetectionInterrupt = PORT_PIN_ONE_EDGE
          PortPinInitialMode = DIO
          PortPinDirection = PORT_PIN_IN
          PortPinPullOption = PULL_DISABLE_PUEN3_BIT29
          PortPinPullControl = PULL_DOWN_PUD3_BIT29
        PortPin8:
          PortPinDirectionChangeable = false
          PortPinDioAltModeChangeable = false
          PortPinModeChangeable = false
          PortPinPolaritySelect = PORT_PIN_POSITIVE_LOGIC
          PortPinOutDataSelect = PORT_PIN_OUTDT
          PortPinLevelValue = PORT_PIN_LEVEL_LOW
          PortPinSensitiveInterrupt = PORT_PIN_LEVEL_SENSITIVE
          PortPinDetectionInterrupt = PORT_PIN_ONE_EDGE
          PortPinInitialMode = DIO
          PortPinDirection = PORT_PIN_IN
          PortPinPullOption = PULL_DISABLE_PUEN3_BIT30
          PortPinPullControl = PULL_DOWN_PUD3_BIT30
        PortPin9:
          PortPinDirectionChangeable = false
          PortPinDioAltModeChangeable = false
          PortPinModeChangeable = false
          PortPinPolaritySelect = PORT_PIN_POSITIVE_LOGIC
          PortPinOutDataSelect = PORT_PIN_OUTDT
          PortPinLevelValue = PORT_PIN_LEVEL_LOW
          PortPinSensitiveInterrupt = PORT_PIN_LEVEL_SENSITIVE
          PortPinDetectionInterrupt = PORT_PIN_ONE_EDGE
          PortPinInitialMode = DIO
          PortPinDirection = PORT_PIN_IN
          PortPinPullOption = PULL_DISABLE_PUEN3_BIT31
          PortPinPullControl = PULL_DOWN_PUD3_BIT31
        PortPin10:
          PortPinDirectionChangeable = false
          PortPinDioAltModeChangeable = false
          PortPinModeChangeable = false
          PortPinPolaritySelect = PORT_PIN_POSITIVE_LOGIC
          PortPinOutDataSelect = PORT_PIN_OUTDT
          PortPinLevelValue = PORT_PIN_LEVEL_LOW
          PortPinSensitiveInterrupt = PORT_PIN_LEVEL_SENSITIVE
          PortPinDetectionInterrupt = PORT_PIN_ONE_EDGE
          PortPinInitialMode = DIO
          PortPinDirection = PORT_PIN_IN
          PortPinPullOption = PULL_DISABLE_PUEN4_BIT0
          PortPinPullControl = PULL_DOWN_PUD4_BIT0
        PortPin11:
          PortPinDirectionChangeable = false
          PortPinDioAltModeChangeable = false
          PortPinModeChangeable = false
          PortPinPolaritySelect = PORT_PIN_POSITIVE_LOGIC
          PortPinOutDataSelect = PORT_PIN_OUTDT
          PortPinLevelValue = PORT_PIN_LEVEL_LOW
          PortPinSensitiveInterrupt = PORT_PIN_LEVEL_SENSITIVE
          PortPinDetectionInterrupt = PORT_PIN_ONE_EDGE
          PortPinInitialMode = DIO
          PortPinDirection = PORT_PIN_IN
          PortPinPullOption = PULL_DISABLE_PUEN4_BIT1
          PortPinPullControl = PULL_DOWN_PUD4_BIT1
        PortPin12:
          PortPinDirectionChangeable = false
          PortPinDioAltModeChangeable = false
          PortPinModeChangeable = false
          PortPinPolaritySelect = PORT_PIN_POSITIVE_LOGIC
          PortPinOutDataSelect = PORT_PIN_OUTDT
          PortPinLevelValue = PORT_PIN_LEVEL_LOW
          PortPinSensitiveInterrupt = PORT_PIN_LEVEL_SENSITIVE
          PortPinDetectionInterrupt = PORT_PIN_ONE_EDGE
          PortPinInitialMode = DIO
          PortPinDirection = PORT_PIN_IN
          PortPinPullOption = PULL_DISABLE_PUEN4_BIT2
          PortPinPullControl = PULL_DOWN_PUD4_BIT2
        PortPin13:
          PortPinDirectionChangeable = false
          PortPinDioAltModeChangeable = false
          PortPinModeChangeable = false
          PortPinPolaritySelect = PORT_PIN_POSITIVE_LOGIC
          PortPinOutDataSelect = PORT_PIN_OUTDT
          PortPinLevelValue = PORT_PIN_LEVEL_LOW
          PortPinSensitiveInterrupt = PORT_PIN_LEVEL_SENSITIVE
          PortPinDetectionInterrupt = PORT_PIN_ONE_EDGE
          PortPinInitialMode = DIO
          PortPinDirection = PORT_PIN_IN
          PortPinPullOption = PULL_DISABLE_PUEN4_BIT3
          PortPinPullControl = PULL_DOWN_PUD4_BIT3
        PortPin14:
          PortPinDirectionChangeable = false
          PortPinDioAltModeChangeable = false
          PortPinModeChangeable = false
          PortPinPolaritySelect = PORT_PIN_POSITIVE_LOGIC
          PortPinOutDataSelect = PORT_PIN_OUTDT
          PortPinLevelValue = PORT_PIN_LEVEL_LOW
          PortPinSensitiveInterrupt = PORT_PIN_LEVEL_SENSITIVE
          PortPinDetectionInterrupt = PORT_PIN_ONE_EDGE
          PortPinInitialMode = DIO
          PortPinDirection = PORT_PIN_IN
          PortPinPullOption = PULL_DISABLE_PUEN4_BIT4
          PortPinPullControl = PULL_DOWN_PUD4_BIT4
        PortPin15:
          PortPinDirectionChangeable = false
          PortPinDioAltModeChangeable = false
          PortPinModeChangeable = false
          PortPinPolaritySelect = PORT_PIN_POSITIVE_LOGIC
          PortPinOutDataSelect = PORT_PIN_OUTDT
          PortPinLevelValue = PORT_PIN_LEVEL_LOW
          PortPinSensitiveInterrupt = PORT_PIN_LEVEL_SENSITIVE
          PortPinDetectionInterrupt = PORT_PIN_ONE_EDGE
          PortPinInitialMode = DIO
          PortPinDirection = PORT_PIN_IN
          PortPinPullOption = PULL_DISABLE_PUEN4_BIT5
          PortPinPullControl = PULL_DOWN_PUD4_BIT5
        PortPin16:
          PortPinDirectionChangeable = false
          PortPinDioAltModeChangeable = false
          PortPinModeChangeable = false
          PortPinPolaritySelect = PORT_PIN_POSITIVE_LOGIC
          PortPinOutDataSelect = PORT_PIN_OUTDT
          PortPinLevelValue = PORT_PIN_LEVEL_LOW
          PortPinSensitiveInterrupt = PORT_PIN_LEVEL_SENSITIVE
          PortPinDetectionInterrupt = PORT_PIN_ONE_EDGE
          PortPinInitialMode = DIO
          PortPinDirection = PORT_PIN_IN
          PortPinPullOption = PULL_DISABLE_PUEN4_BIT6
          PortPinPullControl = PULL_DOWN_PUD4_BIT6
        PortPin17:
          PortPinDirectionChangeable = false
          PortPinDioAltModeChangeable = false
          PortPinModeChangeable = false
          PortPinPolaritySelect = PORT_PIN_POSITIVE_LOGIC
          PortPinOutDataSelect = PORT_PIN_OUTDT
          PortPinLevelValue = PORT_PIN_LEVEL_LOW
          PortPinSensitiveInterrupt = PORT_PIN_LEVEL_SENSITIVE
          PortPinDetectionInterrupt = PORT_PIN_ONE_EDGE
          PortPinInitialMode = DIO
          PortPinDirection = PORT_PIN_IN
          PortPinPullOption = PULL_DISABLE_PUEN4_BIT7
          PortPinPullControl = PULL_DOWN_PUD4_BIT7
      PortGroup5
        PortPin0:
          PortPinDirectionChangeable = false
          PortPinDioAltModeChangeable = false
          PortPinModeChangeable = false
          PortPinPolaritySelect = PORT_PIN_POSITIVE_LOGIC
          PortPinOutDataSelect = PORT_PIN_OUTDT
          PortPinLevelValue = PORT_PIN_LEVEL_LOW
          PortPinSensitiveInterrupt = PORT_PIN_LEVEL_SENSITIVE
          PortPinDetectionInterrupt = PORT_PIN_ONE_EDGE
          PortPinInitialMode = DIO
          PortPinDirection = PORT_PIN_IN
          PortPinPullOption = PULL_ENABLE_PUEN4_BIT12
          PortPinPullControl = PULL_UP_PUD4_BIT12
        PortPin1:
          PortPinDirectionChangeable = false
          PortPinDioAltModeChangeable = false
          PortPinModeChangeable = false
          PortPinPolaritySelect = PORT_PIN_POSITIVE_LOGIC
          PortPinOutDataSelect = PORT_PIN_OUTDT
          PortPinLevelValue = PORT_PIN_LEVEL_LOW
          PortPinSensitiveInterrupt = PORT_PIN_LEVEL_SENSITIVE
          PortPinDetectionInterrupt = PORT_PIN_ONE_EDGE
          PortPinInitialMode = DIO
          PortPinDirection = PORT_PIN_IN
          PortPinPullOption = PULL_ENABLE_PUEN4_BIT13
          PortPinPullControl = PULL_UP_PUD4_BIT13
        PortPin2:
          PortPinDirectionChangeable = false
          PortPinDioAltModeChangeable = false
          PortPinModeChangeable = false
          PortPinPolaritySelect = PORT_PIN_POSITIVE_LOGIC
          PortPinOutDataSelect = PORT_PIN_OUTDT
          PortPinLevelValue = PORT_PIN_LEVEL_LOW
          PortPinSensitiveInterrupt = PORT_PIN_LEVEL_SENSITIVE
          PortPinDetectionInterrupt = PORT_PIN_ONE_EDGE
          PortPinInitialMode = DIO
          PortPinDirection = PORT_PIN_IN
          PortPinPullOption = PULL_ENABLE_PUEN4_BIT14
          PortPinPullControl = PULL_UP_PUD4_BIT14
        PortPin3:
          PortPinDirectionChangeable = false
          PortPinDioAltModeChangeable = false
          PortPinModeChangeable = false
          PortPinPolaritySelect = PORT_PIN_POSITIVE_LOGIC
          PortPinOutDataSelect = PORT_PIN_OUTDT
          PortPinLevelValue = PORT_PIN_LEVEL_LOW
          PortPinSensitiveInterrupt = PORT_PIN_LEVEL_SENSITIVE
          PortPinDetectionInterrupt = PORT_PIN_ONE_EDGE
          PortPinInitialMode = DIO
          PortPinDirection = PORT_PIN_IN
          PortPinPullOption = PULL_ENABLE_PUEN4_BIT15
          PortPinPullControl = PULL_UP_PUD4_BIT15
        PortPin4:
          PortPinDirectionChangeable = false
          PortPinDioAltModeChangeable = false
          PortPinModeChangeable = false
          PortPinPolaritySelect = PORT_PIN_POSITIVE_LOGIC
          PortPinOutDataSelect = PORT_PIN_OUTDT
          PortPinLevelValue = PORT_PIN_LEVEL_LOW
          PortPinSensitiveInterrupt = PORT_PIN_LEVEL_SENSITIVE
          PortPinDetectionInterrupt = PORT_PIN_ONE_EDGE
          PortPinInitialMode = DIO
          PortPinDirection = PORT_PIN_IN
          PortPinPullOption = PULL_ENABLE_PUEN4_BIT16
          PortPinPullControl = PULL_UP_PUD4_BIT16
        PortPin5:
          PortPinDirectionChangeable = false
          PortPinDioAltModeChangeable = false
          PortPinModeChangeable = false
          PortPinPolaritySelect = PORT_PIN_POSITIVE_LOGIC
          PortPinOutDataSelect = PORT_PIN_OUTDT
          PortPinLevelValue = PORT_PIN_LEVEL_LOW
          PortPinSensitiveInterrupt = PORT_PIN_LEVEL_SENSITIVE
          PortPinDetectionInterrupt = PORT_PIN_ONE_EDGE
          PortPinInitialMode = DIO
          PortPinDirection = PORT_PIN_IN
          PortPinPullOption = PULL_ENABLE_PUEN4_BIT17
          PortPinPullControl = PULL_UP_PUD4_BIT17
        PortPin6:
          PortPinDirectionChangeable = false
          PortPinDioAltModeChangeable = false
          PortPinModeChangeable = false
          PortPinPolaritySelect = PORT_PIN_POSITIVE_LOGIC
          PortPinOutDataSelect = PORT_PIN_OUTDT
          PortPinLevelValue = PORT_PIN_LEVEL_LOW
          PortPinSensitiveInterrupt = PORT_PIN_LEVEL_SENSITIVE
          PortPinDetectionInterrupt = PORT_PIN_ONE_EDGE
          PortPinInitialMode = DIO
          PortPinDirection = PORT_PIN_IN
          PortPinPullOption = PULL_ENABLE_PUEN4_BIT18
          PortPinPullControl = PULL_UP_PUD4_BIT18
        PortPin7:
          PortPinDirectionChangeable = false
          PortPinDioAltModeChangeable = false
          PortPinModeChangeable = false
          PortPinPolaritySelect = PORT_PIN_POSITIVE_LOGIC
          PortPinOutDataSelect = PORT_PIN_OUTDT
          PortPinLevelValue = PORT_PIN_LEVEL_LOW
          PortPinSensitiveInterrupt = PORT_PIN_LEVEL_SENSITIVE
          PortPinDetectionInterrupt = PORT_PIN_ONE_EDGE
          PortPinInitialMode = DIO
          PortPinDirection = PORT_PIN_IN
          PortPinPullOption = PULL_ENABLE_PUEN4_BIT19
          PortPinPullControl = PULL_UP_PUD4_BIT19
        PortPin8:
          PortPinDirectionChangeable = false
          PortPinDioAltModeChangeable = false
          PortPinModeChangeable = false
          PortPinPolaritySelect = PORT_PIN_POSITIVE_LOGIC
          PortPinOutDataSelect = PORT_PIN_OUTDT
          PortPinLevelValue = PORT_PIN_LEVEL_LOW
          PortPinSensitiveInterrupt = PORT_PIN_LEVEL_SENSITIVE
          PortPinDetectionInterrupt = PORT_PIN_ONE_EDGE
          PortPinInitialMode = DIO
          PortPinDirection = PORT_PIN_IN
          PortPinPullOption = PULL_ENABLE_PUEN4_BIT20
          PortPinPullControl = PULL_UP_PUD4_BIT20
        PortPin9:
          PortPinDirectionChangeable = false
          PortPinDioAltModeChangeable = false
          PortPinModeChangeable = false
          PortPinPolaritySelect = PORT_PIN_POSITIVE_LOGIC
          PortPinOutDataSelect = PORT_PIN_OUTDT
          PortPinLevelValue = PORT_PIN_LEVEL_LOW
          PortPinSensitiveInterrupt = PORT_PIN_LEVEL_SENSITIVE
          PortPinDetectionInterrupt = PORT_PIN_ONE_EDGE
          PortPinInitialMode = DIO
          PortPinDirection = PORT_PIN_IN
          PortPinPullOption = PULL_ENABLE_PUEN4_BIT21
          PortPinPullControl = PULL_UP_PUD4_BIT21
        PortPin10:
          PortPinDirectionChangeable = false
          PortPinDioAltModeChangeable = false
          PortPinModeChangeable = false
          PortPinPolaritySelect = PORT_PIN_POSITIVE_LOGIC
          PortPinOutDataSelect = PORT_PIN_OUTDT
          PortPinLevelValue = PORT_PIN_LEVEL_LOW
          PortPinSensitiveInterrupt = PORT_PIN_LEVEL_SENSITIVE
          PortPinDetectionInterrupt = PORT_PIN_ONE_EDGE
          PortPinInitialMode = DIO
          PortPinDirection = PORT_PIN_IN
          PortPinPullOption = PULL_ENABLE_PUEN4_BIT22
          PortPinPullControl = PULL_UP_PUD4_BIT22
        PortPin11:
          PortPinDirectionChangeable = false
          PortPinDioAltModeChangeable = false
          PortPinModeChangeable = false
          PortPinPolaritySelect = PORT_PIN_POSITIVE_LOGIC
          PortPinOutDataSelect = PORT_PIN_OUTDT
          PortPinLevelValue = PORT_PIN_LEVEL_LOW
          PortPinSensitiveInterrupt = PORT_PIN_LEVEL_SENSITIVE
          PortPinDetectionInterrupt = PORT_PIN_ONE_EDGE
          PortPinInitialMode = DIO
          PortPinDirection = PORT_PIN_IN
          PortPinPullOption = PULL_ENABLE_PUEN4_BIT23
          PortPinPullControl = PULL_UP_PUD4_BIT23
        PortPin12:
          PortPinDirectionChangeable = false
          PortPinDioAltModeChangeable = false
          PortPinModeChangeable = false
          PortPinPolaritySelect = PORT_PIN_POSITIVE_LOGIC
          PortPinOutDataSelect = PORT_PIN_OUTDT
          PortPinLevelValue = PORT_PIN_LEVEL_LOW
          PortPinSensitiveInterrupt = PORT_PIN_LEVEL_SENSITIVE
          PortPinDetectionInterrupt = PORT_PIN_ONE_EDGE
          PortPinInitialMode = DIO
          PortPinDirection = PORT_PIN_IN
          PortPinPullOption = PULL_ENABLE_PUEN4_BIT24
          PortPinPullControl = PULL_UP_PUD4_BIT24
        PortPin13:
          PortPinDirectionChangeable = false
          PortPinDioAltModeChangeable = false
          PortPinModeChangeable = false
          PortPinPolaritySelect = PORT_PIN_POSITIVE_LOGIC
          PortPinOutDataSelect = PORT_PIN_OUTDT
          PortPinLevelValue = PORT_PIN_LEVEL_LOW
          PortPinSensitiveInterrupt = PORT_PIN_LEVEL_SENSITIVE
          PortPinDetectionInterrupt = PORT_PIN_ONE_EDGE
          PortPinInitialMode = DIO
          PortPinDirection = PORT_PIN_IN
          PortPinPullOption = PULL_ENABLE_PUEN4_BIT25
          PortPinPullControl = PULL_UP_PUD4_BIT25
        PortPin14:
          PortPinDirectionChangeable = false
          PortPinDioAltModeChangeable = false
          PortPinModeChangeable = false
          PortPinPolaritySelect = PORT_PIN_POSITIVE_LOGIC
          PortPinOutDataSelect = PORT_PIN_OUTDT
          PortPinLevelValue = PORT_PIN_LEVEL_LOW
          PortPinSensitiveInterrupt = PORT_PIN_LEVEL_SENSITIVE
          PortPinDetectionInterrupt = PORT_PIN_ONE_EDGE
          PortPinInitialMode = DIO
          PortPinDirection = PORT_PIN_IN
          PortPinPullOption = PULL_ENABLE_PUEN4_BIT26
          PortPinPullControl = PULL_UP_PUD4_BIT26
        PortPin15:
          PortPinDirectionChangeable = false
          PortPinDioAltModeChangeable = false
          PortPinModeChangeable = false
          PortPinPolaritySelect = PORT_PIN_POSITIVE_LOGIC
          PortPinOutDataSelect = PORT_PIN_OUTDT
          PortPinLevelValue = PORT_PIN_LEVEL_LOW
          PortPinSensitiveInterrupt = PORT_PIN_LEVEL_SENSITIVE
          PortPinDetectionInterrupt = PORT_PIN_ONE_EDGE
          PortPinInitialMode = DIO
          PortPinDirection = PORT_PIN_IN
          PortPinPullOption = PULL_ENABLE_PUEN4_BIT27
          PortPinPullControl = PULL_UP_PUD4_BIT27
        PortPin16:
          PortPinDirectionChangeable = false
          PortPinDioAltModeChangeable = false
          PortPinModeChangeable = false
          PortPinPolaritySelect = PORT_PIN_POSITIVE_LOGIC
          PortPinOutDataSelect = PORT_PIN_OUTDT
          PortPinLevelValue = PORT_PIN_LEVEL_LOW
          PortPinSensitiveInterrupt = PORT_PIN_LEVEL_SENSITIVE
          PortPinDetectionInterrupt = PORT_PIN_ONE_EDGE
          PortPinInitialMode = DIO
          PortPinDirection = PORT_PIN_IN
          PortPinPullOption = PULL_ENABLE_PUEN4_BIT28
          PortPinPullControl = PULL_UP_PUD4_BIT28
        PortPin17:
          PortPinDirectionChangeable = false
          PortPinDioAltModeChangeable = false
          PortPinModeChangeable = false
          PortPinPolaritySelect = PORT_PIN_POSITIVE_LOGIC
          PortPinOutDataSelect = PORT_PIN_OUTDT
          PortPinLevelValue = PORT_PIN_LEVEL_LOW
          PortPinSensitiveInterrupt = PORT_PIN_LEVEL_SENSITIVE
          PortPinDetectionInterrupt = PORT_PIN_ONE_EDGE
          PortPinInitialMode = DIO
          PortPinDirection = PORT_PIN_IN
          PortPinPullOption = PULL_ENABLE_PUEN4_BIT29
          PortPinPullControl = PULL_UP_PUD4_BIT29
        PortPin18:
          PortPinDirectionChangeable = false
          PortPinDioAltModeChangeable = false
          PortPinModeChangeable = false
          PortPinPolaritySelect = PORT_PIN_POSITIVE_LOGIC
          PortPinOutDataSelect = PORT_PIN_OUTDT
          PortPinLevelValue = PORT_PIN_LEVEL_LOW
          PortPinSensitiveInterrupt = PORT_PIN_LEVEL_SENSITIVE
          PortPinDetectionInterrupt = PORT_PIN_ONE_EDGE
          PortPinInitialMode = DIO
          PortPinDirection = PORT_PIN_IN
          PortPinPullOption = PULL_ENABLE_PUEN4_BIT30
          PortPinPullControl = PULL_UP_PUD4_BIT30
        PortPin19:
          PortPinDirectionChangeable = false
          PortPinDioAltModeChangeable = false
          PortPinModeChangeable = false
          PortPinPolaritySelect = PORT_PIN_POSITIVE_LOGIC
          PortPinOutDataSelect = PORT_PIN_OUTDT
          PortPinLevelValue = PORT_PIN_LEVEL_LOW
          PortPinSensitiveInterrupt = PORT_PIN_LEVEL_SENSITIVE
          PortPinDetectionInterrupt = PORT_PIN_ONE_EDGE
          PortPinInitialMode = DIO
          PortPinDirection = PORT_PIN_IN
          PortPinPullOption = PULL_ENABLE_PUEN4_BIT31
          PortPinPullControl = PULL_UP_PUD4_BIT31
        PortPin20:
          PortPinDirectionChangeable = false
          PortPinDioAltModeChangeable = false
          PortPinModeChangeable = false
          PortPinPolaritySelect = PORT_PIN_POSITIVE_LOGIC
          PortPinOutDataSelect = PORT_PIN_OUTDT
          PortPinLevelValue = PORT_PIN_LEVEL_LOW
          PortPinSensitiveInterrupt = PORT_PIN_LEVEL_SENSITIVE
          PortPinDetectionInterrupt = PORT_PIN_ONE_EDGE
          PortPinInitialMode = DIO
          PortPinDirection = PORT_PIN_IN
          PortPinPullOption = PULL_ENABLE_PUEN5_BIT0
          PortPinPullControl = PULL_UP_PUD5_BIT0
        PortPin21:
          PortPinDirectionChangeable = false
          PortPinDioAltModeChangeable = false
          PortPinModeChangeable = false
          PortPinPolaritySelect = PORT_PIN_POSITIVE_LOGIC
          PortPinOutDataSelect = PORT_PIN_OUTDT
          PortPinLevelValue = PORT_PIN_LEVEL_LOW
          PortPinSensitiveInterrupt = PORT_PIN_LEVEL_SENSITIVE
          PortPinDetectionInterrupt = PORT_PIN_ONE_EDGE
          PortPinInitialMode = DIO
          PortPinDirection = PORT_PIN_IN
          PortPinPullOption = PULL_ENABLE_PUEN5_BIT1
          PortPinPullControl = PULL_UP_PUD5_BIT1
        PortPin22:
          PortPinDirectionChangeable = false
          PortPinDioAltModeChangeable = false
          PortPinModeChangeable = false
          PortPinPolaritySelect = PORT_PIN_POSITIVE_LOGIC
          PortPinOutDataSelect = PORT_PIN_OUTDT
          PortPinLevelValue = PORT_PIN_LEVEL_LOW
          PortPinSensitiveInterrupt = PORT_PIN_LEVEL_SENSITIVE
          PortPinDetectionInterrupt = PORT_PIN_ONE_EDGE
          PortPinInitialMode = DIO
          PortPinDirection = PORT_PIN_IN
          PortPinPullOption = PULL_ENABLE_PUEN5_BIT2
          PortPinPullControl = PULL_UP_PUD5_BIT2
        PortPin23:
          PortPinDirectionChangeable = false
          PortPinDioAltModeChangeable = false
          PortPinModeChangeable = false
          PortPinPolaritySelect = PORT_PIN_POSITIVE_LOGIC
          PortPinOutDataSelect = PORT_PIN_OUTDT
          PortPinLevelValue = PORT_PIN_LEVEL_LOW
          PortPinSensitiveInterrupt = PORT_PIN_LEVEL_SENSITIVE
          PortPinDetectionInterrupt = PORT_PIN_ONE_EDGE
          PortPinInitialMode = DIO
          PortPinDirection = PORT_PIN_IN
          PortPinPullOption = PULL_DISABLE_PUEN5_BIT3
          PortPinPullControl = PULL_DOWN_PUD5_BIT3
        PortPin24:
          PortPinDirectionChangeable = false
          PortPinDioAltModeChangeable = false
          PortPinModeChangeable = false
          PortPinPolaritySelect = PORT_PIN_POSITIVE_LOGIC
          PortPinOutDataSelect = PORT_PIN_OUTDT
          PortPinLevelValue = PORT_PIN_LEVEL_LOW
          PortPinSensitiveInterrupt = PORT_PIN_LEVEL_SENSITIVE
          PortPinDetectionInterrupt = PORT_PIN_ONE_EDGE
          PortPinInitialMode = DIO
          PortPinDirection = PORT_PIN_IN
          PortPinPullOption = PULL_DISABLE_PUEN5_BIT4
          PortPinPullControl = PULL_DOWN_PUD5_BIT4
        PortPin25:
          PortPinDirectionChangeable = false
          PortPinDioAltModeChangeable = false
          PortPinModeChangeable = false
          PortPinPolaritySelect = PORT_PIN_POSITIVE_LOGIC
          PortPinOutDataSelect = PORT_PIN_OUTDT
          PortPinLevelValue = PORT_PIN_LEVEL_LOW
          PortPinSensitiveInterrupt = PORT_PIN_LEVEL_SENSITIVE
          PortPinDetectionInterrupt = PORT_PIN_ONE_EDGE
          PortPinInitialMode = DIO
          PortPinDirection = PORT_PIN_IN
          PortPinPullOption = PULL_DISABLE_PUEN5_BIT5
          PortPinPullControl = PULL_DOWN_PUD5_BIT5
      PortGroup6
        PortPin0:
          PortPinDirectionChangeable = false
          PortPinDioAltModeChangeable = false
          PortPinModeChangeable = false
          PortPinPolaritySelect = PORT_PIN_POSITIVE_LOGIC
          PortPinOutDataSelect = PORT_PIN_OUTDT
          PortPinLevelValue = PORT_PIN_LEVEL_LOW
          PortPinSensitiveInterrupt = PORT_PIN_LEVEL_SENSITIVE
          PortPinDetectionInterrupt = PORT_PIN_ONE_EDGE
          PortPinInitialMode = DIO
          PortPinDirection = PORT_PIN_IN
          PortPinPullOption = PULL_ENABLE_PUEN5_BIT7
          PortPinPullControl = PULL_UP_PUD5_BIT7
        PortPin1:
          PortPinDirectionChangeable = false
          PortPinDioAltModeChangeable = false
          PortPinModeChangeable = false
          PortPinPolaritySelect = PORT_PIN_POSITIVE_LOGIC
          PortPinOutDataSelect = PORT_PIN_OUTDT
          PortPinLevelValue = PORT_PIN_LEVEL_LOW
          PortPinSensitiveInterrupt = PORT_PIN_LEVEL_SENSITIVE
          PortPinDetectionInterrupt = PORT_PIN_ONE_EDGE
          PortPinInitialMode = DIO
          PortPinDirection = PORT_PIN_IN
          PortPinPullOption = PULL_ENABLE_PUEN5_BIT8
          PortPinPullControl = PULL_UP_PUD5_BIT8
        PortPin2:
          PortPinDirectionChangeable = false
          PortPinDioAltModeChangeable = false
          PortPinModeChangeable = false
          PortPinPolaritySelect = PORT_PIN_POSITIVE_LOGIC
          PortPinOutDataSelect = PORT_PIN_OUTDT
          PortPinLevelValue = PORT_PIN_LEVEL_LOW
          PortPinSensitiveInterrupt = PORT_PIN_LEVEL_SENSITIVE
          PortPinDetectionInterrupt = PORT_PIN_ONE_EDGE
          PortPinInitialMode = DIO
          PortPinDirection = PORT_PIN_IN
          PortPinPullOption = PULL_ENABLE_PUEN5_BIT9
          PortPinPullControl = PULL_UP_PUD5_BIT9
        PortPin3:
          PortPinDirectionChangeable = false
          PortPinDioAltModeChangeable = false
          PortPinModeChangeable = false
          PortPinPolaritySelect = PORT_PIN_POSITIVE_LOGIC
          PortPinOutDataSelect = PORT_PIN_OUTDT
          PortPinLevelValue = PORT_PIN_LEVEL_LOW
          PortPinSensitiveInterrupt = PORT_PIN_LEVEL_SENSITIVE
          PortPinDetectionInterrupt = PORT_PIN_ONE_EDGE
          PortPinInitialMode = DIO
          PortPinDirection = PORT_PIN_IN
          PortPinPullOption = PULL_ENABLE_PUEN5_BIT10
          PortPinPullControl = PULL_UP_PUD5_BIT10
        PortPin4:
          PortPinDirectionChangeable = false
          PortPinDioAltModeChangeable = false
          PortPinModeChangeable = false
          PortPinPolaritySelect = PORT_PIN_POSITIVE_LOGIC
          PortPinOutDataSelect = PORT_PIN_OUTDT
          PortPinLevelValue = PORT_PIN_LEVEL_LOW
          PortPinSensitiveInterrupt = PORT_PIN_LEVEL_SENSITIVE
          PortPinDetectionInterrupt = PORT_PIN_ONE_EDGE
          PortPinInitialMode = DIO
          PortPinDirection = PORT_PIN_IN
          PortPinPullOption = PULL_ENABLE_PUEN5_BIT11
          PortPinPullControl = PULL_UP_PUD5_BIT11
        PortPin5:
          PortPinDirectionChangeable = false
          PortPinDioAltModeChangeable = false
          PortPinModeChangeable = false
          PortPinPolaritySelect = PORT_PIN_POSITIVE_LOGIC
          PortPinOutDataSelect = PORT_PIN_OUTDT
          PortPinLevelValue = PORT_PIN_LEVEL_LOW
          PortPinSensitiveInterrupt = PORT_PIN_LEVEL_SENSITIVE
          PortPinDetectionInterrupt = PORT_PIN_ONE_EDGE
          PortPinInitialMode = DIO
          PortPinDirection = PORT_PIN_IN
          PortPinPullOption = PULL_ENABLE_PUEN5_BIT12
          PortPinPullControl = PULL_UP_PUD5_BIT12
        PortPin6:
          PortPinDirectionChangeable = false
          PortPinDioAltModeChangeable = false
          PortPinModeChangeable = false
          PortPinPolaritySelect = PORT_PIN_POSITIVE_LOGIC
          PortPinOutDataSelect = PORT_PIN_OUTDT
          PortPinLevelValue = PORT_PIN_LEVEL_LOW
          PortPinSensitiveInterrupt = PORT_PIN_LEVEL_SENSITIVE
          PortPinDetectionInterrupt = PORT_PIN_ONE_EDGE
          PortPinInitialMode = DIO
          PortPinDirection = PORT_PIN_IN
          PortPinPullOption = PULL_ENABLE_PUEN5_BIT13
          PortPinPullControl = PULL_UP_PUD5_BIT13
        PortPin7:
          PortPinDirectionChangeable = false
          PortPinDioAltModeChangeable = false
          PortPinModeChangeable = false
          PortPinPolaritySelect = PORT_PIN_POSITIVE_LOGIC
          PortPinOutDataSelect = PORT_PIN_OUTDT
          PortPinLevelValue = PORT_PIN_LEVEL_LOW
          PortPinSensitiveInterrupt = PORT_PIN_LEVEL_SENSITIVE
          PortPinDetectionInterrupt = PORT_PIN_ONE_EDGE
          PortPinInitialMode = DIO
          PortPinDirection = PORT_PIN_IN
          PortPinPullOption = PULL_ENABLE_PUEN5_BIT14
          PortPinPullControl = PULL_UP_PUD5_BIT14
        PortPin8:
          PortPinDirectionChangeable = false
          PortPinDioAltModeChangeable = false
          PortPinModeChangeable = false
          PortPinPolaritySelect = PORT_PIN_POSITIVE_LOGIC
          PortPinOutDataSelect = PORT_PIN_OUTDT
          PortPinLevelValue = PORT_PIN_LEVEL_LOW
          PortPinSensitiveInterrupt = PORT_PIN_LEVEL_SENSITIVE
          PortPinDetectionInterrupt = PORT_PIN_ONE_EDGE
          PortPinInitialMode = DIO
          PortPinDirection = PORT_PIN_IN
          PortPinPullOption = PULL_ENABLE_PUEN5_BIT15
          PortPinPullControl = PULL_UP_PUD5_BIT15
        PortPin9:
          PortPinDirectionChangeable = false
          PortPinDioAltModeChangeable = false
          PortPinModeChangeable = false
          PortPinPolaritySelect = PORT_PIN_POSITIVE_LOGIC
          PortPinOutDataSelect = PORT_PIN_OUTDT
          PortPinLevelValue = PORT_PIN_LEVEL_LOW
          PortPinSensitiveInterrupt = PORT_PIN_LEVEL_SENSITIVE
          PortPinDetectionInterrupt = PORT_PIN_ONE_EDGE
          PortPinInitialMode = DIO
          PortPinDirection = PORT_PIN_IN
          PortPinPullOption = PULL_ENABLE_PUEN5_BIT16
          PortPinPullControl = PULL_UP_PUD5_BIT16
        PortPin10:
          PortPinDirectionChangeable = false
          PortPinDioAltModeChangeable = false
          PortPinModeChangeable = false
          PortPinPolaritySelect = PORT_PIN_POSITIVE_LOGIC
          PortPinOutDataSelect = PORT_PIN_OUTDT
          PortPinLevelValue = PORT_PIN_LEVEL_LOW
          PortPinSensitiveInterrupt = PORT_PIN_LEVEL_SENSITIVE
          PortPinDetectionInterrupt = PORT_PIN_ONE_EDGE
          PortPinInitialMode = DIO
          PortPinDirection = PORT_PIN_IN
          PortPinPullOption = PULL_ENABLE_PUEN5_BIT17
          PortPinPullControl = PULL_UP_PUD5_BIT17
        PortPin11:
          PortPinDirectionChangeable = false
          PortPinDioAltModeChangeable = false
          PortPinModeChangeable = false
          PortPinPolaritySelect = PORT_PIN_POSITIVE_LOGIC
          PortPinOutDataSelect = PORT_PIN_OUTDT
          PortPinLevelValue = PORT_PIN_LEVEL_LOW
          PortPinSensitiveInterrupt = PORT_PIN_LEVEL_SENSITIVE
          PortPinDetectionInterrupt = PORT_PIN_ONE_EDGE
          PortPinInitialMode = DIO
          PortPinDirection = PORT_PIN_IN
          PortPinPullOption = PULL_ENABLE_PUEN5_BIT18
          PortPinPullControl = PULL_UP_PUD5_BIT18
        PortPin12:
          PortPinDirectionChangeable = false
          PortPinDioAltModeChangeable = false
          PortPinModeChangeable = false
          PortPinPolaritySelect = PORT_PIN_POSITIVE_LOGIC
          PortPinOutDataSelect = PORT_PIN_OUTDT
          PortPinLevelValue = PORT_PIN_LEVEL_LOW
          PortPinSensitiveInterrupt = PORT_PIN_LEVEL_SENSITIVE
          PortPinDetectionInterrupt = PORT_PIN_ONE_EDGE
          PortPinInitialMode = DIO
          PortPinDirection = PORT_PIN_IN
          PortPinPullOption = PULL_ENABLE_PUEN5_BIT19
          PortPinPullControl = PULL_UP_PUD5_BIT19
        PortPin13:
          PortPinDirectionChangeable = false
          PortPinDioAltModeChangeable = false
          PortPinModeChangeable = false
          PortPinPolaritySelect = PORT_PIN_POSITIVE_LOGIC
          PortPinOutDataSelect = PORT_PIN_OUTDT
          PortPinLevelValue = PORT_PIN_LEVEL_LOW
          PortPinSensitiveInterrupt = PORT_PIN_LEVEL_SENSITIVE
          PortPinDetectionInterrupt = PORT_PIN_ONE_EDGE
          PortPinInitialMode = DIO
          PortPinDirection = PORT_PIN_IN
          PortPinPullOption = PULL_ENABLE_PUEN5_BIT20
          PortPinPullControl = PULL_UP_PUD5_BIT20
        PortPin14:
          PortPinDirectionChangeable = false
          PortPinDioAltModeChangeable = false
          PortPinModeChangeable = false
          PortPinPolaritySelect = PORT_PIN_POSITIVE_LOGIC
          PortPinOutDataSelect = PORT_PIN_OUTDT
          PortPinLevelValue = PORT_PIN_LEVEL_LOW
          PortPinSensitiveInterrupt = PORT_PIN_LEVEL_SENSITIVE
          PortPinDetectionInterrupt = PORT_PIN_ONE_EDGE
          PortPinInitialMode = DIO
          PortPinDirection = PORT_PIN_IN
          PortPinPullOption = PULL_DISABLE_PUEN5_BIT21
          PortPinPullControl = PULL_DOWN_PUD5_BIT21
        PortPin15:
          PortPinDirectionChangeable = false
          PortPinDioAltModeChangeable = false
          PortPinModeChangeable = false
          PortPinPolaritySelect = PORT_PIN_POSITIVE_LOGIC
          PortPinOutDataSelect = PORT_PIN_OUTDT
          PortPinLevelValue = PORT_PIN_LEVEL_LOW
          PortPinSensitiveInterrupt = PORT_PIN_LEVEL_SENSITIVE
          PortPinDetectionInterrupt = PORT_PIN_ONE_EDGE
          PortPinInitialMode = DIO
          PortPinDirection = PORT_PIN_IN
          PortPinPullOption = PULL_ENABLE_PUEN5_BIT22
          PortPinPullControl = PULL_UP_PUD5_BIT22
        PortPin16:
          PortPinDirectionChangeable = false
          PortPinDioAltModeChangeable = false
          PortPinModeChangeable = false
          PortPinPolaritySelect = PORT_PIN_POSITIVE_LOGIC
          PortPinOutDataSelect = PORT_PIN_OUTDT
          PortPinLevelValue = PORT_PIN_LEVEL_LOW
          PortPinSensitiveInterrupt = PORT_PIN_LEVEL_SENSITIVE
          PortPinDetectionInterrupt = PORT_PIN_ONE_EDGE
          PortPinInitialMode = DIO
          PortPinDirection = PORT_PIN_IN
          PortPinPullOption = PULL_DISABLE_PUEN5_BIT23
          PortPinPullControl = PULL_DOWN_PUD5_BIT23
        PortPin17:
          PortPinDirectionChangeable = false
          PortPinDioAltModeChangeable = false
          PortPinModeChangeable = false
          PortPinPolaritySelect = PORT_PIN_POSITIVE_LOGIC
          PortPinOutDataSelect = PORT_PIN_OUTDT
          PortPinLevelValue = PORT_PIN_LEVEL_LOW
          PortPinSensitiveInterrupt = PORT_PIN_LEVEL_SENSITIVE
          PortPinDetectionInterrupt = PORT_PIN_ONE_EDGE
          PortPinInitialMode = DIO
          PortPinDirection = PORT_PIN_IN
          PortPinPullOption = PULL_ENABLE_PUEN5_BIT24
          PortPinPullControl = PULL_UP_PUD5_BIT24
        PortPin18:
          PortPinDirectionChangeable = false
          PortPinDioAltModeChangeable = false
          PortPinModeChangeable = false
          PortPinPolaritySelect = PORT_PIN_POSITIVE_LOGIC
          PortPinOutDataSelect = PORT_PIN_OUTDT
          PortPinLevelValue = PORT_PIN_LEVEL_LOW
          PortPinSensitiveInterrupt = PORT_PIN_LEVEL_SENSITIVE
          PortPinDetectionInterrupt = PORT_PIN_ONE_EDGE
          PortPinInitialMode = DIO
          PortPinDirection = PORT_PIN_IN
          PortPinPullOption = PULL_ENABLE_PUEN5_BIT25
          PortPinPullControl = PULL_UP_PUD5_BIT25
        PortPin19:
          PortPinDirectionChangeable = false
          PortPinDioAltModeChangeable = false
          PortPinModeChangeable = false
          PortPinPolaritySelect = PORT_PIN_POSITIVE_LOGIC
          PortPinOutDataSelect = PORT_PIN_OUTDT
          PortPinLevelValue = PORT_PIN_LEVEL_LOW
          PortPinSensitiveInterrupt = PORT_PIN_LEVEL_SENSITIVE
          PortPinDetectionInterrupt = PORT_PIN_ONE_EDGE
          PortPinInitialMode = DIO
          PortPinDirection = PORT_PIN_IN
          PortPinPullOption = PULL_ENABLE_PUEN5_BIT26
          PortPinPullControl = PULL_UP_PUD5_BIT26
        PortPin20:
          PortPinDirectionChangeable = false
          PortPinDioAltModeChangeable = false
          PortPinModeChangeable = false
          PortPinPolaritySelect = PORT_PIN_POSITIVE_LOGIC
          PortPinOutDataSelect = PORT_PIN_OUTDT
          PortPinLevelValue = PORT_PIN_LEVEL_LOW
          PortPinSensitiveInterrupt = PORT_PIN_LEVEL_SENSITIVE
          PortPinDetectionInterrupt = PORT_PIN_ONE_EDGE
          PortPinInitialMode = DIO
          PortPinDirection = PORT_PIN_IN
          PortPinPullOption = PULL_ENABLE_PUEN5_BIT27
          PortPinPullControl = PULL_UP_PUD5_BIT27
        PortPin21:
          PortPinDirectionChangeable = false
          PortPinDioAltModeChangeable = false
          PortPinModeChangeable = false
          PortPinPolaritySelect = PORT_PIN_POSITIVE_LOGIC
          PortPinOutDataSelect = PORT_PIN_OUTDT
          PortPinLevelValue = PORT_PIN_LEVEL_LOW
          PortPinSensitiveInterrupt = PORT_PIN_LEVEL_SENSITIVE
          PortPinDetectionInterrupt = PORT_PIN_ONE_EDGE
          PortPinInitialMode = DIO
          PortPinDirection = PORT_PIN_IN
          PortPinPullOption = PULL_ENABLE_PUEN5_BIT28
          PortPinPullControl = PULL_UP_PUD5_BIT28
        PortPin22:
          PortPinDirectionChangeable = false
          PortPinDioAltModeChangeable = false
          PortPinModeChangeable = false
          PortPinPolaritySelect = PORT_PIN_POSITIVE_LOGIC
          PortPinOutDataSelect = PORT_PIN_OUTDT
          PortPinLevelValue = PORT_PIN_LEVEL_LOW
          PortPinSensitiveInterrupt = PORT_PIN_LEVEL_SENSITIVE
          PortPinDetectionInterrupt = PORT_PIN_ONE_EDGE
          PortPinInitialMode = DIO
          PortPinDirection = PORT_PIN_IN
          PortPinPullOption = PULL_ENABLE_PUEN5_BIT29
          PortPinPullControl = PULL_UP_PUD5_BIT29
        PortPin23:
          PortPinDirectionChangeable = false
          PortPinDioAltModeChangeable = false
          PortPinModeChangeable = false
          PortPinPolaritySelect = PORT_PIN_POSITIVE_LOGIC
          PortPinOutDataSelect = PORT_PIN_OUTDT
          PortPinLevelValue = PORT_PIN_LEVEL_LOW
          PortPinSensitiveInterrupt = PORT_PIN_LEVEL_SENSITIVE
          PortPinDetectionInterrupt = PORT_PIN_ONE_EDGE
          PortPinInitialMode = DIO
          PortPinDirection = PORT_PIN_IN
          PortPinPullOption = PULL_ENABLE_PUEN5_BIT30
          PortPinPullControl = PULL_UP_PUD5_BIT30
        PortPin24:
          PortPinDirectionChangeable = false
          PortPinDioAltModeChangeable = false
          PortPinModeChangeable = false
          PortPinPolaritySelect = PORT_PIN_POSITIVE_LOGIC
          PortPinOutDataSelect = PORT_PIN_OUTDT
          PortPinLevelValue = PORT_PIN_LEVEL_LOW
          PortPinSensitiveInterrupt = PORT_PIN_LEVEL_SENSITIVE
          PortPinDetectionInterrupt = PORT_PIN_ONE_EDGE
          PortPinInitialMode = DIO
          PortPinDirection = PORT_PIN_IN
          PortPinPullOption = PULL_DISABLE_PUEN5_BIT31
          PortPinPullControl = PULL_DOWN_PUD5_BIT31
        PortPin25:
          PortPinDirectionChangeable = false
          PortPinDioAltModeChangeable = false
          PortPinModeChangeable = false
          PortPinPolaritySelect = PORT_PIN_POSITIVE_LOGIC
          PortPinOutDataSelect = PORT_PIN_OUTDT
          PortPinLevelValue = PORT_PIN_LEVEL_LOW
          PortPinSensitiveInterrupt = PORT_PIN_LEVEL_SENSITIVE
          PortPinDetectionInterrupt = PORT_PIN_ONE_EDGE
          PortPinInitialMode = DIO
          PortPinDirection = PORT_PIN_IN
          PortPinPullOption = PULL_ENABLE_PUEN6_BIT0
          PortPinPullControl = PULL_UP_PUD6_BIT0
        PortPin26:
          PortPinDirectionChangeable = false
          PortPinDioAltModeChangeable = false
          PortPinModeChangeable = false
          PortPinPolaritySelect = PORT_PIN_POSITIVE_LOGIC
          PortPinOutDataSelect = PORT_PIN_OUTDT
          PortPinLevelValue = PORT_PIN_LEVEL_LOW
          PortPinSensitiveInterrupt = PORT_PIN_LEVEL_SENSITIVE
          PortPinDetectionInterrupt = PORT_PIN_ONE_EDGE
          PortPinInitialMode = DIO
          PortPinDirection = PORT_PIN_IN
          PortPinPullOption = PULL_ENABLE_PUEN6_BIT1
          PortPinPullControl = PULL_DOWN_PUD6_BIT1
        PortPin27:
          PortPinDirectionChangeable = false
          PortPinDioAltModeChangeable = false
          PortPinModeChangeable = false
          PortPinPolaritySelect = PORT_PIN_POSITIVE_LOGIC
          PortPinOutDataSelect = PORT_PIN_OUTDT
          PortPinLevelValue = PORT_PIN_LEVEL_LOW
          PortPinSensitiveInterrupt = PORT_PIN_LEVEL_SENSITIVE
          PortPinDetectionInterrupt = PORT_PIN_ONE_EDGE
          PortPinInitialMode = DIO
          PortPinDirection = PORT_PIN_IN
          PortPinPullOption = PULL_ENABLE_PUEN6_BIT2
          PortPinPullControl = PULL_UP_PUD6_BIT2
        PortPin28:
          PortPinDirectionChangeable = false
          PortPinDioAltModeChangeable = false
          PortPinModeChangeable = false
          PortPinPolaritySelect = PORT_PIN_POSITIVE_LOGIC
          PortPinOutDataSelect = PORT_PIN_OUTDT
          PortPinLevelValue = PORT_PIN_LEVEL_LOW
          PortPinSensitiveInterrupt = PORT_PIN_LEVEL_SENSITIVE
          PortPinDetectionInterrupt = PORT_PIN_ONE_EDGE
          PortPinInitialMode = DIO
          PortPinDirection = PORT_PIN_IN
          PortPinPullOption = PULL_DISABLE_PUEN6_BIT3
          PortPinPullControl = PULL_DOWN_PUD6_BIT3
        PortPin29:
          PortPinDirectionChangeable = false
          PortPinDioAltModeChangeable = false
          PortPinModeChangeable = false
          PortPinPolaritySelect = PORT_PIN_POSITIVE_LOGIC
          PortPinOutDataSelect = PORT_PIN_OUTDT
          PortPinLevelValue = PORT_PIN_LEVEL_LOW
          PortPinSensitiveInterrupt = PORT_PIN_LEVEL_SENSITIVE
          PortPinDetectionInterrupt = PORT_PIN_ONE_EDGE
          PortPinInitialMode = DIO
          PortPinDirection = PORT_PIN_IN
          PortPinPullOption = PULL_ENABLE_PUEN6_BIT4
          PortPinPullControl = PULL_UP_PUD6_BIT4
        PortPin30:
          PortPinDirectionChangeable = false
          PortPinDioAltModeChangeable = false
          PortPinModeChangeable = false
          PortPinPolaritySelect = PORT_PIN_POSITIVE_LOGIC
          PortPinOutDataSelect = PORT_PIN_OUTDT
          PortPinLevelValue = PORT_PIN_LEVEL_LOW
          PortPinSensitiveInterrupt = PORT_PIN_LEVEL_SENSITIVE
          PortPinDetectionInterrupt = PORT_PIN_ONE_EDGE
          PortPinInitialMode = DIO
          PortPinDirection = PORT_PIN_IN
          PortPinPullOption = PULL_DISABLE_PUEN6_BIT5
          PortPinPullControl = PULL_DOWN_PUD6_BIT5
        PortPin31:
          PortPinDirectionChangeable = false
          PortPinDioAltModeChangeable = false
          PortPinModeChangeable = false
          PortPinPolaritySelect = PORT_PIN_POSITIVE_LOGIC
          PortPinOutDataSelect = PORT_PIN_OUTDT
          PortPinLevelValue = PORT_PIN_LEVEL_LOW
          PortPinSensitiveInterrupt = PORT_PIN_LEVEL_SENSITIVE
          PortPinDetectionInterrupt = PORT_PIN_ONE_EDGE
          PortPinInitialMode = DIO
          PortPinDirection = PORT_PIN_IN
          PortPinPullOption = PULL_ENABLE_PUEN6_BIT6
          PortPinPullControl = PULL_UP_PUD6_BIT6
      PortGroup7
        PortPin0:
          PortPinDirectionChangeable = false
          PortPinDioAltModeChangeable = false
          PortPinModeChangeable = false
          PortPinPolaritySelect = PORT_PIN_POSITIVE_LOGIC
          PortPinOutDataSelect = PORT_PIN_OUTDT
          PortPinLevelValue = PORT_PIN_LEVEL_LOW
          PortPinSensitiveInterrupt = PORT_PIN_LEVEL_SENSITIVE
          PortPinDetectionInterrupt = PORT_PIN_ONE_EDGE
          PortPinInitialMode = DIO
          PortPinDirection = PORT_PIN_IN
          PortPinPullOption = PULL_ENABLE_PUEN2_BIT26
          PortPinPullControl = PULL_DOWN_PUD2_BIT26
        PortPin1:
          PortPinDirectionChangeable = false
          PortPinDioAltModeChangeable = false
          PortPinModeChangeable = false
          PortPinPolaritySelect = PORT_PIN_POSITIVE_LOGIC
          PortPinOutDataSelect = PORT_PIN_OUTDT
          PortPinLevelValue = PORT_PIN_LEVEL_LOW
          PortPinSensitiveInterrupt = PORT_PIN_LEVEL_SENSITIVE
          PortPinDetectionInterrupt = PORT_PIN_ONE_EDGE
          PortPinInitialMode = DIO
          PortPinDirection = PORT_PIN_IN
          PortPinPullOption = PULL_ENABLE_PUEN2_BIT27
          PortPinPullControl = PULL_DOWN_PUD2_BIT27
        PortPin2:
          PortPinDirectionChangeable = false
          PortPinDioAltModeChangeable = false
          PortPinModeChangeable = false
          PortPinPolaritySelect = PORT_PIN_POSITIVE_LOGIC
          PortPinOutDataSelect = PORT_PIN_OUTDT
          PortPinLevelValue = PORT_PIN_LEVEL_LOW
          PortPinSensitiveInterrupt = PORT_PIN_LEVEL_SENSITIVE
          PortPinDetectionInterrupt = PORT_PIN_ONE_EDGE
          PortPinInitialMode = DIO
          PortPinDirection = PORT_PIN_IN
          PortPinPullOption = PULL_ENABLE_PUEN2_BIT28
          PortPinPullControl = PULL_UP_PUD2_BIT28
        PortPin3:
          PortPinDirectionChangeable = false
          PortPinDioAltModeChangeable = false
          PortPinModeChangeable = false
          PortPinPolaritySelect = PORT_PIN_POSITIVE_LOGIC
          PortPinOutDataSelect = PORT_PIN_OUTDT
          PortPinLevelValue = PORT_PIN_LEVEL_LOW
          PortPinSensitiveInterrupt = PORT_PIN_LEVEL_SENSITIVE
          PortPinDetectionInterrupt = PORT_PIN_ONE_EDGE
          PortPinInitialMode = DIO
          PortPinDirection = PORT_PIN_IN
          PortPinPullOption = PULL_ENABLE_PUEN2_BIT29
          PortPinPullControl = PULL_UP_PUD2_BIT29
      PortGroup0_001 (PortGroup0)
        PortPin0:
          PortPinDirectionChangeable = false
          PortPinDioAltModeChangeable = false
          PortPinModeChangeable = false
          PortPinPolaritySelect = PORT_PIN_POSITIVE_LOGIC
          PortPinOutDataSelect = PORT_PIN_OUTDT
          PortPinLevelValue = PORT_PIN_LEVEL_LOW
          PortPinSensitiveInterrupt = PORT_PIN_LEVEL_SENSITIVE
          PortPinDetectionInterrupt = PORT_PIN_ONE_EDGE
          PortPinInitialMode = DIO
          PortPinDirection = PORT_PIN_IN
          PortPinPullOption = PULL_DISABLE_PUEN2_BIT10
          PortPinPullControl = PULL_DOWN_PUD2_BIT10
        PortPin1:
          PortPinDirectionChangeable = false
          PortPinDioAltModeChangeable = false
          PortPinModeChangeable = false
          PortPinPolaritySelect = PORT_PIN_POSITIVE_LOGIC
          PortPinOutDataSelect = PORT_PIN_OUTDT
          PortPinLevelValue = PORT_PIN_LEVEL_LOW
          PortPinSensitiveInterrupt = PORT_PIN_LEVEL_SENSITIVE
          PortPinDetectionInterrupt = PORT_PIN_ONE_EDGE
          PortPinInitialMode = DIO
          PortPinDirection = PORT_PIN_IN
          PortPinPullOption = PULL_DISABLE_PUEN2_BIT11
          PortPinPullControl = PULL_DOWN_PUD2_BIT11
        PortPin2:
          PortPinDirectionChangeable = false
          PortPinDioAltModeChangeable = false
          PortPinModeChangeable = false
          PortPinPolaritySelect = PORT_PIN_POSITIVE_LOGIC
          PortPinOutDataSelect = PORT_PIN_OUTDT
          PortPinLevelValue = PORT_PIN_LEVEL_LOW
          PortPinSensitiveInterrupt = PORT_PIN_LEVEL_SENSITIVE
          PortPinDetectionInterrupt = PORT_PIN_ONE_EDGE
          PortPinInitialMode = DIO
          PortPinDirection = PORT_PIN_IN
          PortPinPullOption = PULL_DISABLE_PUEN2_BIT12
          PortPinPullControl = PULL_DOWN_PUD2_BIT12
        PortPin3:
          PortPinDirectionChangeable = false
          PortPinDioAltModeChangeable = false
          PortPinModeChangeable = false
          PortPinPolaritySelect = PORT_PIN_POSITIVE_LOGIC
          PortPinOutDataSelect = PORT_PIN_OUTDT
          PortPinLevelValue = PORT_PIN_LEVEL_LOW
          PortPinSensitiveInterrupt = PORT_PIN_LEVEL_SENSITIVE
          PortPinDetectionInterrupt = PORT_PIN_ONE_EDGE
          PortPinInitialMode = DIO
          PortPinDirection = PORT_PIN_IN
          PortPinPullOption = PULL_DISABLE_PUEN2_BIT13
          PortPinPullControl = PULL_DOWN_PUD2_BIT13
        PortPin4:
          PortPinDirectionChangeable = false
          PortPinDioAltModeChangeable = false
          PortPinModeChangeable = false
          PortPinPolaritySelect = PORT_PIN_POSITIVE_LOGIC
          PortPinOutDataSelect = PORT_PIN_OUTDT
          PortPinLevelValue = PORT_PIN_LEVEL_LOW
          PortPinSensitiveInterrupt = PORT_PIN_LEVEL_SENSITIVE
          PortPinDetectionInterrupt = PORT_PIN_ONE_EDGE
          PortPinInitialMode = DIO
          PortPinDirection = PORT_PIN_IN
          PortPinPullOption = PULL_DISABLE_PUEN2_BIT14
          PortPinPullControl = PULL_DOWN_PUD2_BIT14
        PortPin5:
          PortPinDirectionChangeable = false
          PortPinDioAltModeChangeable = false
          PortPinModeChangeable = false
          PortPinPolaritySelect = PORT_PIN_POSITIVE_LOGIC
          PortPinOutDataSelect = PORT_PIN_OUTDT
          PortPinLevelValue = PORT_PIN_LEVEL_LOW
          PortPinSensitiveInterrupt = PORT_PIN_LEVEL_SENSITIVE
          PortPinDetectionInterrupt = PORT_PIN_ONE_EDGE
          PortPinInitialMode = DIO
          PortPinDirection = PORT_PIN_IN
          PortPinPullOption = PULL_DISABLE_PUEN2_BIT15
          PortPinPullControl = PULL_DOWN_PUD2_BIT15
        PortPin6:
          PortPinDirectionChangeable = false
          PortPinDioAltModeChangeable = false
          PortPinModeChangeable = false
          PortPinPolaritySelect = PORT_PIN_POSITIVE_LOGIC
          PortPinOutDataSelect = PORT_PIN_OUTDT
          PortPinLevelValue = PORT_PIN_LEVEL_LOW
          PortPinSensitiveInterrupt = PORT_PIN_LEVEL_SENSITIVE
          PortPinDetectionInterrupt = PORT_PIN_ONE_EDGE
          PortPinInitialMode = DIO
          PortPinDirection = PORT_PIN_IN
          PortPinPullOption = PULL_DISABLE_PUEN2_BIT16
          PortPinPullControl = PULL_DOWN_PUD2_BIT16
        PortPin7:
          PortPinDirectionChangeable = false
          PortPinDioAltModeChangeable = false
          PortPinModeChangeable = false
          PortPinPolaritySelect = PORT_PIN_POSITIVE_LOGIC
          PortPinOutDataSelect = PORT_PIN_OUTDT
          PortPinLevelValue = PORT_PIN_LEVEL_LOW
          PortPinSensitiveInterrupt = PORT_PIN_LEVEL_SENSITIVE
          PortPinDetectionInterrupt = PORT_PIN_ONE_EDGE
          PortPinInitialMode = DIO
          PortPinDirection = PORT_PIN_IN
          PortPinPullOption = PULL_DISABLE_PUEN2_BIT17
          PortPinPullControl = PULL_DOWN_PUD2_BIT17
        PortPin8:
          PortPinDirectionChangeable = false
          PortPinDioAltModeChangeable = false
          PortPinModeChangeable = false
          PortPinPolaritySelect = PORT_PIN_POSITIVE_LOGIC
          PortPinOutDataSelect = PORT_PIN_OUTDT
          PortPinLevelValue = PORT_PIN_LEVEL_LOW
          PortPinSensitiveInterrupt = PORT_PIN_LEVEL_SENSITIVE
          PortPinDetectionInterrupt = PORT_PIN_ONE_EDGE
          PortPinInitialMode = DIO
          PortPinDirection = PORT_PIN_IN
          PortPinPullOption = PULL_DISABLE_PUEN2_BIT18
          PortPinPullControl = PULL_DOWN_PUD2_BIT18
        PortPin9:
          PortPinDirectionChangeable = false
          PortPinDioAltModeChangeable = false
          PortPinModeChangeable = false
          PortPinPolaritySelect = PORT_PIN_POSITIVE_LOGIC
          PortPinOutDataSelect = PORT_PIN_OUTDT
          PortPinLevelValue = PORT_PIN_LEVEL_LOW
          PortPinSensitiveInterrupt = PORT_PIN_LEVEL_SENSITIVE
          PortPinDetectionInterrupt = PORT_PIN_ONE_EDGE
          PortPinInitialMode = DIO
          PortPinDirection = PORT_PIN_IN
          PortPinPullOption = PULL_DISABLE_PUEN2_BIT19
          PortPinPullControl = PULL_DOWN_PUD2_BIT19
        PortPin10:
          PortPinDirectionChangeable = false
          PortPinDioAltModeChangeable = false
          PortPinModeChangeable = false
          PortPinPolaritySelect = PORT_PIN_POSITIVE_LOGIC
          PortPinOutDataSelect = PORT_PIN_OUTDT
          PortPinLevelValue = PORT_PIN_LEVEL_LOW
          PortPinSensitiveInterrupt = PORT_PIN_LEVEL_SENSITIVE
          PortPinDetectionInterrupt = PORT_PIN_ONE_EDGE
          PortPinInitialMode = DIO
          PortPinDirection = PORT_PIN_IN
          PortPinPullOption = PULL_DISABLE_PUEN2_BIT20
          PortPinPullControl = PULL_DOWN_PUD2_BIT20
        PortPin11:
          PortPinDirectionChangeable = false
          PortPinDioAltModeChangeable = false
          PortPinModeChangeable = false
          PortPinPolaritySelect = PORT_PIN_POSITIVE_LOGIC
          PortPinOutDataSelect = PORT_PIN_OUTDT
          PortPinLevelValue = PORT_PIN_LEVEL_LOW
          PortPinSensitiveInterrupt = PORT_PIN_LEVEL_SENSITIVE
          PortPinDetectionInterrupt = PORT_PIN_ONE_EDGE
          PortPinInitialMode = DIO
          PortPinDirection = PORT_PIN_IN
          PortPinPullOption = PULL_DISABLE_PUEN2_BIT21
          PortPinPullControl = PULL_DOWN_PUD2_BIT21
        PortPin12:
          PortPinDirectionChangeable = false
          PortPinDioAltModeChangeable = false
          PortPinModeChangeable = false
          PortPinPolaritySelect = PORT_PIN_POSITIVE_LOGIC
          PortPinOutDataSelect = PORT_PIN_OUTDT
          PortPinLevelValue = PORT_PIN_LEVEL_LOW
          PortPinSensitiveInterrupt = PORT_PIN_LEVEL_SENSITIVE
          PortPinDetectionInterrupt = PORT_PIN_ONE_EDGE
          PortPinInitialMode = DIO
          PortPinDirection = PORT_PIN_IN
          PortPinPullOption = PULL_DISABLE_PUEN2_BIT22
          PortPinPullControl = PULL_DOWN_PUD2_BIT22
        PortPin13:
          PortPinDirectionChangeable = false
          PortPinDioAltModeChangeable = false
          PortPinModeChangeable = false
          PortPinPolaritySelect = PORT_PIN_POSITIVE_LOGIC
          PortPinOutDataSelect = PORT_PIN_OUTDT
          PortPinLevelValue = PORT_PIN_LEVEL_LOW
          PortPinSensitiveInterrupt = PORT_PIN_LEVEL_SENSITIVE
          PortPinDetectionInterrupt = PORT_PIN_ONE_EDGE
          PortPinInitialMode = DIO
          PortPinDirection = PORT_PIN_IN
          PortPinPullOption = PULL_DISABLE_PUEN2_BIT23
          PortPinPullControl = PULL_DOWN_PUD2_BIT23
        PortPin14:
          PortPinDirectionChangeable = false
          PortPinDioAltModeChangeable = false
          PortPinModeChangeable = false
          PortPinPolaritySelect = PORT_PIN_POSITIVE_LOGIC
          PortPinOutDataSelect = PORT_PIN_OUTDT
          PortPinLevelValue = PORT_PIN_LEVEL_LOW
          PortPinSensitiveInterrupt = PORT_PIN_LEVEL_SENSITIVE
          PortPinDetectionInterrupt = PORT_PIN_ONE_EDGE
          PortPinInitialMode = DIO
          PortPinDirection = PORT_PIN_IN
          PortPinPullOption = PULL_ENABLE_PUEN2_BIT24
          PortPinPullControl = PULL_UP_PUD2_BIT24
        PortPin15:
          PortPinDirectionChangeable = false
          PortPinDioAltModeChangeable = false
          PortPinModeChangeable = false
          PortPinPolaritySelect = PORT_PIN_POSITIVE_LOGIC
          PortPinOutDataSelect = PORT_PIN_OUTDT
          PortPinLevelValue = PORT_PIN_LEVEL_LOW
          PortPinSensitiveInterrupt = PORT_PIN_LEVEL_SENSITIVE
          PortPinDetectionInterrupt = PORT_PIN_ONE_EDGE
          PortPinInitialMode = DIO
          PortPinDirection = PORT_PIN_IN
          PortPinPullOption = PULL_ENABLE_PUEN2_BIT25
          PortPinPullControl = PULL_UP_PUD2_BIT25
      PortGroup1_001 (PortGroup1)
        PortPin28:
          PortPinDirectionChangeable = false
          PortPinDioAltModeChangeable = false
          PortPinModeChangeable = false
          PortPinPolaritySelect = PORT_PIN_POSITIVE_LOGIC
          PortPinOutDataSelect = PORT_PIN_OUTDT
          PortPinLevelValue = PORT_PIN_LEVEL_LOW
          PortPinSensitiveInterrupt = PORT_PIN_LEVEL_SENSITIVE
          PortPinDetectionInterrupt = PORT_PIN_ONE_EDGE
          PortPinInitialMode = DIO
          PortPinDirection = PORT_PIN_IN
          PortPinPullOption = PULL_DISABLE_PUEN2_BIT0
          PortPinPullControl = PULL_UP_PUD2_BIT0
        PortPin0:
          PortPinDirectionChangeable = false
          PortPinDioAltModeChangeable = false
          PortPinModeChangeable = false
          PortPinPolaritySelect = PORT_PIN_POSITIVE_LOGIC
          PortPinOutDataSelect = PORT_PIN_OUTDT
          PortPinLevelValue = PORT_PIN_LEVEL_LOW
          PortPinSensitiveInterrupt = PORT_PIN_LEVEL_SENSITIVE
          PortPinDetectionInterrupt = PORT_PIN_ONE_EDGE
          PortPinInitialMode = DIO
          PortPinDirection = PORT_PIN_IN
          PortPinPullOption = PULL_DISABLE_PUEN1_BIT12
          PortPinPullControl = PULL_DOWN_PUD1_BIT12
        PortPin1:
          PortPinDirectionChangeable = false
          PortPinDioAltModeChangeable = false
          PortPinModeChangeable = false
          PortPinPolaritySelect = PORT_PIN_POSITIVE_LOGIC
          PortPinOutDataSelect = PORT_PIN_OUTDT
          PortPinLevelValue = PORT_PIN_LEVEL_LOW
          PortPinSensitiveInterrupt = PORT_PIN_LEVEL_SENSITIVE
          PortPinDetectionInterrupt = PORT_PIN_ONE_EDGE
          PortPinInitialMode = DIO
          PortPinDirection = PORT_PIN_IN
          PortPinPullOption = PULL_DISABLE_PUEN1_BIT13
          PortPinPullControl = PULL_DOWN_PUD1_BIT13
        PortPin2:
          PortPinDirectionChangeable = false
          PortPinDioAltModeChangeable = false
          PortPinModeChangeable = false
          PortPinPolaritySelect = PORT_PIN_POSITIVE_LOGIC
          PortPinOutDataSelect = PORT_PIN_OUTDT
          PortPinLevelValue = PORT_PIN_LEVEL_LOW
          PortPinSensitiveInterrupt = PORT_PIN_LEVEL_SENSITIVE
          PortPinDetectionInterrupt = PORT_PIN_ONE_EDGE
          PortPinInitialMode = DIO
          PortPinDirection = PORT_PIN_IN
          PortPinPullOption = PULL_ENABLE_PUEN1_BIT14
          PortPinPullControl = PULL_DOWN_PUD1_BIT14
        PortPin3:
          PortPinDirectionChangeable = false
          PortPinDioAltModeChangeable = false
          PortPinModeChangeable = false
          PortPinPolaritySelect = PORT_PIN_POSITIVE_LOGIC
          PortPinOutDataSelect = PORT_PIN_OUTDT
          PortPinLevelValue = PORT_PIN_LEVEL_LOW
          PortPinSensitiveInterrupt = PORT_PIN_LEVEL_SENSITIVE
          PortPinDetectionInterrupt = PORT_PIN_ONE_EDGE
          PortPinInitialMode = DIO
          PortPinDirection = PORT_PIN_IN
          PortPinPullOption = PULL_DISABLE_PUEN1_BIT15
          PortPinPullControl = PULL_DOWN_PUD1_BIT15
        PortPin4:
          PortPinDirectionChangeable = false
          PortPinDioAltModeChangeable = false
          PortPinModeChangeable = false
          PortPinPolaritySelect = PORT_PIN_POSITIVE_LOGIC
          PortPinOutDataSelect = PORT_PIN_OUTDT
          PortPinLevelValue = PORT_PIN_LEVEL_LOW
          PortPinSensitiveInterrupt = PORT_PIN_LEVEL_SENSITIVE
          PortPinDetectionInterrupt = PORT_PIN_ONE_EDGE
          PortPinInitialMode = DIO
          PortPinDirection = PORT_PIN_IN
          PortPinPullOption = PULL_DISABLE_PUEN1_BIT16
          PortPinPullControl = PULL_DOWN_PUD1_BIT16
        PortPin5:
          PortPinDirectionChangeable = false
          PortPinDioAltModeChangeable = false
          PortPinModeChangeable = false
          PortPinPolaritySelect = PORT_PIN_POSITIVE_LOGIC
          PortPinOutDataSelect = PORT_PIN_OUTDT
          PortPinLevelValue = PORT_PIN_LEVEL_LOW
          PortPinSensitiveInterrupt = PORT_PIN_LEVEL_SENSITIVE
          PortPinDetectionInterrupt = PORT_PIN_ONE_EDGE
          PortPinInitialMode = DIO
          PortPinDirection = PORT_PIN_IN
          PortPinPullOption = PULL_DISABLE_PUEN1_BIT17
          PortPinPullControl = PULL_DOWN_PUD1_BIT17
        PortPin6:
          PortPinDirectionChangeable = false
          PortPinDioAltModeChangeable = false
          PortPinModeChangeable = false
          PortPinPolaritySelect = PORT_PIN_POSITIVE_LOGIC
          PortPinOutDataSelect = PORT_PIN_OUTDT
          PortPinLevelValue = PORT_PIN_LEVEL_LOW
          PortPinSensitiveInterrupt = PORT_PIN_LEVEL_SENSITIVE
          PortPinDetectionInterrupt = PORT_PIN_ONE_EDGE
          PortPinInitialMode = DIO
          PortPinDirection = PORT_PIN_IN
          PortPinPullOption = PULL_DISABLE_PUEN1_BIT18
          PortPinPullControl = PULL_DOWN_PUD1_BIT18
        PortPin7:
          PortPinDirectionChangeable = false
          PortPinDioAltModeChangeable = false
          PortPinModeChangeable = false
          PortPinPolaritySelect = PORT_PIN_POSITIVE_LOGIC
          PortPinOutDataSelect = PORT_PIN_OUTDT
          PortPinLevelValue = PORT_PIN_LEVEL_LOW
          PortPinSensitiveInterrupt = PORT_PIN_LEVEL_SENSITIVE
          PortPinDetectionInterrupt = PORT_PIN_ONE_EDGE
          PortPinInitialMode = DIO
          PortPinDirection = PORT_PIN_IN
          PortPinPullOption = PULL_DISABLE_PUEN1_BIT19
          PortPinPullControl = PULL_DOWN_PUD1_BIT19
        PortPin8:
          PortPinDirectionChangeable = false
          PortPinDioAltModeChangeable = false
          PortPinModeChangeable = false
          PortPinPolaritySelect = PORT_PIN_POSITIVE_LOGIC
          PortPinOutDataSelect = PORT_PIN_OUTDT
          PortPinLevelValue = PORT_PIN_LEVEL_LOW
          PortPinSensitiveInterrupt = PORT_PIN_LEVEL_SENSITIVE
          PortPinDetectionInterrupt = PORT_PIN_ONE_EDGE
          PortPinInitialMode = DIO
          PortPinDirection = PORT_PIN_IN
          PortPinPullOption = PULL_ENABLE_PUEN1_BIT20
          PortPinPullControl = PULL_UP_PUD1_BIT20
        PortPin9:
          PortPinDirectionChangeable = false
          PortPinDioAltModeChangeable = false
          PortPinModeChangeable = false
          PortPinPolaritySelect = PORT_PIN_POSITIVE_LOGIC
          PortPinOutDataSelect = PORT_PIN_OUTDT
          PortPinLevelValue = PORT_PIN_LEVEL_LOW
          PortPinSensitiveInterrupt = PORT_PIN_LEVEL_SENSITIVE
          PortPinDetectionInterrupt = PORT_PIN_ONE_EDGE
          PortPinInitialMode = DIO
          PortPinDirection = PORT_PIN_IN
          PortPinPullOption = PULL_ENABLE_PUEN1_BIT21
          PortPinPullControl = PULL_UP_PUD1_BIT21
        PortPin10:
          PortPinDirectionChangeable = false
          PortPinDioAltModeChangeable = false
          PortPinModeChangeable = false
          PortPinPolaritySelect = PORT_PIN_POSITIVE_LOGIC
          PortPinOutDataSelect = PORT_PIN_OUTDT
          PortPinLevelValue = PORT_PIN_LEVEL_LOW
          PortPinSensitiveInterrupt = PORT_PIN_LEVEL_SENSITIVE
          PortPinDetectionInterrupt = PORT_PIN_ONE_EDGE
          PortPinInitialMode = DIO
          PortPinDirection = PORT_PIN_IN
          PortPinPullOption = PULL_DISABLE_PUEN1_BIT22
          PortPinPullControl = PULL_DOWN_PUD1_BIT22
        PortPin11:
          PortPinDirectionChangeable = false
          PortPinDioAltModeChangeable = false
          PortPinModeChangeable = false
          PortPinPolaritySelect = PORT_PIN_POSITIVE_LOGIC
          PortPinOutDataSelect = PORT_PIN_OUTDT
          PortPinLevelValue = PORT_PIN_LEVEL_LOW
          PortPinSensitiveInterrupt = PORT_PIN_LEVEL_SENSITIVE
          PortPinDetectionInterrupt = PORT_PIN_ONE_EDGE
          PortPinInitialMode = DIO
          PortPinDirection = PORT_PIN_IN
          PortPinPullOption = PULL_ENABLE_PUEN1_BIT23
          PortPinPullControl = PULL_DOWN_PUD1_BIT23
        PortPin12:
          PortPinDirectionChangeable = false
          PortPinDioAltModeChangeable = false
          PortPinModeChangeable = false
          PortPinPolaritySelect = PORT_PIN_POSITIVE_LOGIC
          PortPinOutDataSelect = PORT_PIN_OUTDT
          PortPinLevelValue = PORT_PIN_LEVEL_LOW
          PortPinSensitiveInterrupt = PORT_PIN_LEVEL_SENSITIVE
          PortPinDetectionInterrupt = PORT_PIN_ONE_EDGE
          PortPinInitialMode = DIO
          PortPinDirection = PORT_PIN_IN
          PortPinPullOption = PULL_DISABLE_PUEN1_BIT24
          PortPinPullControl = PULL_DOWN_PUD1_BIT24
        PortPin13:
          PortPinDirectionChangeable = false
          PortPinDioAltModeChangeable = false
          PortPinModeChangeable = false
          PortPinPolaritySelect = PORT_PIN_POSITIVE_LOGIC
          PortPinOutDataSelect = PORT_PIN_OUTDT
          PortPinLevelValue = PORT_PIN_LEVEL_LOW
          PortPinSensitiveInterrupt = PORT_PIN_LEVEL_SENSITIVE
          PortPinDetectionInterrupt = PORT_PIN_ONE_EDGE
          PortPinInitialMode = DIO
          PortPinDirection = PORT_PIN_IN
          PortPinPullOption = PULL_DISABLE_PUEN1_BIT25
          PortPinPullControl = PULL_DOWN_PUD1_BIT25
        PortPin14:
          PortPinDirectionChangeable = false
          PortPinDioAltModeChangeable = false
          PortPinModeChangeable = false
          PortPinPolaritySelect = PORT_PIN_POSITIVE_LOGIC
          PortPinOutDataSelect = PORT_PIN_OUTDT
          PortPinLevelValue = PORT_PIN_LEVEL_LOW
          PortPinSensitiveInterrupt = PORT_PIN_LEVEL_SENSITIVE
          PortPinDetectionInterrupt = PORT_PIN_ONE_EDGE
          PortPinInitialMode = DIO
          PortPinDirection = PORT_PIN_IN
          PortPinPullOption = PULL_DISABLE_PUEN1_BIT26
          PortPinPullControl = PULL_DOWN_PUD1_BIT26
        PortPin15:
          PortPinDirectionChangeable = false
          PortPinDioAltModeChangeable = false
          PortPinModeChangeable = false
          PortPinPolaritySelect = PORT_PIN_POSITIVE_LOGIC
          PortPinOutDataSelect = PORT_PIN_OUTDT
          PortPinLevelValue = PORT_PIN_LEVEL_LOW
          PortPinSensitiveInterrupt = PORT_PIN_LEVEL_SENSITIVE
          PortPinDetectionInterrupt = PORT_PIN_ONE_EDGE
          PortPinInitialMode = DIO
          PortPinDirection = PORT_PIN_IN
          PortPinPullOption = PULL_DISABLE_PUEN1_BIT27
          PortPinPullControl = PULL_DOWN_PUD1_BIT27
        PortPin16:
          PortPinDirectionChangeable = false
          PortPinDioAltModeChangeable = false
          PortPinModeChangeable = false
          PortPinPolaritySelect = PORT_PIN_POSITIVE_LOGIC
          PortPinOutDataSelect = PORT_PIN_OUTDT
          PortPinLevelValue = PORT_PIN_LEVEL_LOW
          PortPinSensitiveInterrupt = PORT_PIN_LEVEL_SENSITIVE
          PortPinDetectionInterrupt = PORT_PIN_ONE_EDGE
          PortPinInitialMode = DIO
          PortPinDirection = PORT_PIN_IN
          PortPinPullOption = PULL_DISABLE_PUEN1_BIT28
          PortPinPullControl = PULL_DOWN_PUD1_BIT28
        PortPin17:
          PortPinDirectionChangeable = false
          PortPinDioAltModeChangeable = false
          PortPinModeChangeable = false
          PortPinPolaritySelect = PORT_PIN_POSITIVE_LOGIC
          PortPinOutDataSelect = PORT_PIN_OUTDT
          PortPinLevelValue = PORT_PIN_LEVEL_LOW
          PortPinSensitiveInterrupt = PORT_PIN_LEVEL_SENSITIVE
          PortPinDetectionInterrupt = PORT_PIN_ONE_EDGE
          PortPinInitialMode = DIO
          PortPinDirection = PORT_PIN_IN
          PortPinPullOption = PULL_DISABLE_PUEN1_BIT29
          PortPinPullControl = PULL_DOWN_PUD1_BIT29
        PortPin18:
          PortPinDirectionChangeable = false
          PortPinDioAltModeChangeable = false
          PortPinModeChangeable = false
          PortPinPolaritySelect = PORT_PIN_POSITIVE_LOGIC
          PortPinOutDataSelect = PORT_PIN_OUTDT
          PortPinLevelValue = PORT_PIN_LEVEL_LOW
          PortPinSensitiveInterrupt = PORT_PIN_LEVEL_SENSITIVE
          PortPinDetectionInterrupt = PORT_PIN_ONE_EDGE
          PortPinInitialMode = DIO
          PortPinDirection = PORT_PIN_IN
          PortPinPullOption = PULL_DISABLE_PUEN1_BIT30
          PortPinPullControl = PULL_DOWN_PUD1_BIT30
        PortPin19:
          PortPinDirectionChangeable = false
          PortPinDioAltModeChangeable = false
          PortPinModeChangeable = false
          PortPinPolaritySelect = PORT_PIN_POSITIVE_LOGIC
          PortPinOutDataSelect = PORT_PIN_OUTDT
          PortPinLevelValue = PORT_PIN_LEVEL_LOW
          PortPinSensitiveInterrupt = PORT_PIN_LEVEL_SENSITIVE
          PortPinDetectionInterrupt = PORT_PIN_ONE_EDGE
          PortPinInitialMode = DIO
          PortPinDirection = PORT_PIN_IN
          PortPinPullOption = PULL_DISABLE_PUEN1_BIT31
          PortPinPullControl = PULL_DOWN_PUD1_BIT31
        PortPin20:
          PortPinDirectionChangeable = false
          PortPinDioAltModeChangeable = false
          PortPinModeChangeable = false
          PortPinPolaritySelect = PORT_PIN_POSITIVE_LOGIC
          PortPinOutDataSelect = PORT_PIN_OUTDT
          PortPinLevelValue = PORT_PIN_LEVEL_LOW
          PortPinSensitiveInterrupt = PORT_PIN_LEVEL_SENSITIVE
          PortPinDetectionInterrupt = PORT_PIN_ONE_EDGE
          PortPinInitialMode = DIO
          PortPinDirection = PORT_PIN_IN
          PortPinPullOption = PULL_ENABLE_PUEN2_BIT1
          PortPinPullControl = PULL_UP_PUD2_BIT1
        PortPin21:
          PortPinDirectionChangeable = false
          PortPinDioAltModeChangeable = false
          PortPinModeChangeable = false
          PortPinPolaritySelect = PORT_PIN_POSITIVE_LOGIC
          PortPinOutDataSelect = PORT_PIN_OUTDT
          PortPinLevelValue = PORT_PIN_LEVEL_LOW
          PortPinSensitiveInterrupt = PORT_PIN_LEVEL_SENSITIVE
          PortPinDetectionInterrupt = PORT_PIN_ONE_EDGE
          PortPinInitialMode = DIO
          PortPinDirection = PORT_PIN_IN
          PortPinPullOption = PULL_ENABLE_PUEN2_BIT2
          PortPinPullControl = PULL_UP_PUD2_BIT2
        PortPin22:
          PortPinDirectionChangeable = false
          PortPinDioAltModeChangeable = false
          PortPinModeChangeable = false
          PortPinPolaritySelect = PORT_PIN_POSITIVE_LOGIC
          PortPinOutDataSelect = PORT_PIN_OUTDT
          PortPinLevelValue = PORT_PIN_LEVEL_LOW
          PortPinSensitiveInterrupt = PORT_PIN_LEVEL_SENSITIVE
          PortPinDetectionInterrupt = PORT_PIN_ONE_EDGE
          PortPinInitialMode = DIO
          PortPinDirection = PORT_PIN_IN
          PortPinPullOption = PULL_DISABLE_PUEN2_BIT3
          PortPinPullControl = PULL_DOWN_PUD2_BIT3
        PortPin23:
          PortPinDirectionChangeable = false
          PortPinDioAltModeChangeable = false
          PortPinModeChangeable = false
          PortPinPolaritySelect = PORT_PIN_POSITIVE_LOGIC
          PortPinOutDataSelect = PORT_PIN_OUTDT
          PortPinLevelValue = PORT_PIN_LEVEL_LOW
          PortPinSensitiveInterrupt = PORT_PIN_LEVEL_SENSITIVE
          PortPinDetectionInterrupt = PORT_PIN_ONE_EDGE
          PortPinInitialMode = DIO
          PortPinDirection = PORT_PIN_IN
          PortPinPullOption = PULL_DISABLE_PUEN2_BIT4
          PortPinPullControl = PULL_DOWN_PUD2_BIT4
        PortPin24:
          PortPinDirectionChangeable = false
          PortPinDioAltModeChangeable = false
          PortPinModeChangeable = false
          PortPinPolaritySelect = PORT_PIN_POSITIVE_LOGIC
          PortPinOutDataSelect = PORT_PIN_OUTDT
          PortPinLevelValue = PORT_PIN_LEVEL_LOW
          PortPinSensitiveInterrupt = PORT_PIN_LEVEL_SENSITIVE
          PortPinDetectionInterrupt = PORT_PIN_ONE_EDGE
          PortPinInitialMode = DIO
          PortPinDirection = PORT_PIN_IN
          PortPinPullOption = PULL_ENABLE_PUEN2_BIT5
          PortPinPullControl = PULL_UP_PUD2_BIT5
        PortPin25:
          PortPinDirectionChangeable = false
          PortPinDioAltModeChangeable = false
          PortPinModeChangeable = false
          PortPinPolaritySelect = PORT_PIN_POSITIVE_LOGIC
          PortPinOutDataSelect = PORT_PIN_OUTDT
          PortPinLevelValue = PORT_PIN_LEVEL_LOW
          PortPinSensitiveInterrupt = PORT_PIN_LEVEL_SENSITIVE
          PortPinDetectionInterrupt = PORT_PIN_ONE_EDGE
          PortPinInitialMode = DIO
          PortPinDirection = PORT_PIN_IN
          PortPinPullOption = PULL_ENABLE_PUEN2_BIT6
          PortPinPullControl = PULL_UP_PUD2_BIT6
        PortPin26:
          PortPinDirectionChangeable = false
          PortPinDioAltModeChangeable = false
          PortPinModeChangeable = false
          PortPinPolaritySelect = PORT_PIN_POSITIVE_LOGIC
          PortPinOutDataSelect = PORT_PIN_OUTDT
          PortPinLevelValue = PORT_PIN_LEVEL_LOW
          PortPinSensitiveInterrupt = PORT_PIN_LEVEL_SENSITIVE
          PortPinDetectionInterrupt = PORT_PIN_ONE_EDGE
          PortPinInitialMode = DIO
          PortPinDirection = PORT_PIN_IN
          PortPinPullOption = PULL_ENABLE_PUEN2_BIT7
          PortPinPullControl = PULL_UP_PUD2_BIT7
        PortPin27:
          PortPinDirectionChangeable = false
          PortPinDioAltModeChangeable = false
          PortPinModeChangeable = false
          PortPinPolaritySelect = PORT_PIN_POSITIVE_LOGIC
          PortPinOutDataSelect = PORT_PIN_OUTDT
          PortPinLevelValue = PORT_PIN_LEVEL_LOW
          PortPinSensitiveInterrupt = PORT_PIN_LEVEL_SENSITIVE
          PortPinDetectionInterrupt = PORT_PIN_ONE_EDGE
          PortPinInitialMode = DIO
          PortPinDirection = PORT_PIN_IN
          PortPinPullOption = PULL_ENABLE_PUEN2_BIT8
          PortPinPullControl = PULL_UP_PUD2_BIT8
      PortGroup2_001 (PortGroup2)
        PortPin0:
          PortPinDirectionChangeable = false
          PortPinDioAltModeChangeable = false
          PortPinModeChangeable = false
          PortPinPolaritySelect = PORT_PIN_POSITIVE_LOGIC
          PortPinOutDataSelect = PORT_PIN_OUTDT
          PortPinLevelValue = PORT_PIN_LEVEL_LOW
          PortPinSensitiveInterrupt = PORT_PIN_LEVEL_SENSITIVE
          PortPinDetectionInterrupt = PORT_PIN_ONE_EDGE
          PortPinInitialMode = DIO
          PortPinDirection = PORT_PIN_IN
          PortPinPullOption = PULL_ENABLE_PUEN1_BIT3
          PortPinPullControl = PULL_UP_PUD1_BIT3
        PortPin1:
          PortPinDirectionChangeable = false
          PortPinDioAltModeChangeable = false
          PortPinModeChangeable = false
          PortPinPolaritySelect = PORT_PIN_POSITIVE_LOGIC
          PortPinOutDataSelect = PORT_PIN_OUTDT
          PortPinLevelValue = PORT_PIN_LEVEL_LOW
          PortPinSensitiveInterrupt = PORT_PIN_LEVEL_SENSITIVE
          PortPinDetectionInterrupt = PORT_PIN_ONE_EDGE
          PortPinInitialMode = DIO
          PortPinDirection = PORT_PIN_IN
          PortPinPullOption = PULL_ENABLE_PUEN1_BIT4
          PortPinPullControl = PULL_UP_PUD1_BIT4
        PortPin2:
          PortPinDirectionChangeable = false
          PortPinDioAltModeChangeable = false
          PortPinModeChangeable = false
          PortPinPolaritySelect = PORT_PIN_POSITIVE_LOGIC
          PortPinOutDataSelect = PORT_PIN_OUTDT
          PortPinLevelValue = PORT_PIN_LEVEL_LOW
          PortPinSensitiveInterrupt = PORT_PIN_LEVEL_SENSITIVE
          PortPinDetectionInterrupt = PORT_PIN_ONE_EDGE
          PortPinInitialMode = DIO
          PortPinDirection = PORT_PIN_IN
          PortPinPullOption = PULL_ENABLE_PUEN1_BIT5
          PortPinPullControl = PULL_UP_PUD1_BIT5
        PortPin3:
          PortPinDirectionChangeable = false
          PortPinDioAltModeChangeable = false
          PortPinModeChangeable = false
          PortPinPolaritySelect = PORT_PIN_POSITIVE_LOGIC
          PortPinOutDataSelect = PORT_PIN_OUTDT
          PortPinLevelValue = PORT_PIN_LEVEL_LOW
          PortPinSensitiveInterrupt = PORT_PIN_LEVEL_SENSITIVE
          PortPinDetectionInterrupt = PORT_PIN_ONE_EDGE
          PortPinInitialMode = DIO
          PortPinDirection = PORT_PIN_IN
          PortPinPullOption = PULL_ENABLE_PUEN1_BIT6
          PortPinPullControl = PULL_UP_PUD1_BIT6
        PortPin4:
          PortPinDirectionChangeable = false
          PortPinDioAltModeChangeable = false
          PortPinModeChangeable = false
          PortPinPolaritySelect = PORT_PIN_POSITIVE_LOGIC
          PortPinOutDataSelect = PORT_PIN_OUTDT
          PortPinLevelValue = PORT_PIN_LEVEL_LOW
          PortPinSensitiveInterrupt = PORT_PIN_LEVEL_SENSITIVE
          PortPinDetectionInterrupt = PORT_PIN_ONE_EDGE
          PortPinInitialMode = DIO
          PortPinDirection = PORT_PIN_IN
          PortPinPullOption = PULL_ENABLE_PUEN1_BIT7
          PortPinPullControl = PULL_UP_PUD1_BIT7
        PortPin5:
          PortPinDirectionChangeable = false
          PortPinDioAltModeChangeable = false
          PortPinModeChangeable = false
          PortPinPolaritySelect = PORT_PIN_POSITIVE_LOGIC
          PortPinOutDataSelect = PORT_PIN_OUTDT
          PortPinLevelValue = PORT_PIN_LEVEL_LOW
          PortPinSensitiveInterrupt = PORT_PIN_LEVEL_SENSITIVE
          PortPinDetectionInterrupt = PORT_PIN_ONE_EDGE
          PortPinInitialMode = DIO
          PortPinDirection = PORT_PIN_IN
          PortPinPullOption = PULL_ENABLE_PUEN1_BIT8
          PortPinPullControl = PULL_UP_PUD1_BIT8
        PortPin6:
          PortPinDirectionChangeable = false
          PortPinDioAltModeChangeable = false
          PortPinModeChangeable = false
          PortPinPolaritySelect = PORT_PIN_POSITIVE_LOGIC
          PortPinOutDataSelect = PORT_PIN_OUTDT
          PortPinLevelValue = PORT_PIN_LEVEL_LOW
          PortPinSensitiveInterrupt = PORT_PIN_LEVEL_SENSITIVE
          PortPinDetectionInterrupt = PORT_PIN_ONE_EDGE
          PortPinInitialMode = DIO
          PortPinDirection = PORT_PIN_IN
          PortPinPullOption = PULL_ENABLE_PUEN1_BIT9
          PortPinPullControl = PULL_UP_PUD1_BIT9
        PortPin7:
          PortPinDirectionChangeable = false
          PortPinDioAltModeChangeable = false
          PortPinModeChangeable = false
          PortPinPolaritySelect = PORT_PIN_POSITIVE_LOGIC
          PortPinOutDataSelect = PORT_PIN_OUTDT
          PortPinLevelValue = PORT_PIN_LEVEL_LOW
          PortPinSensitiveInterrupt = PORT_PIN_LEVEL_SENSITIVE
          PortPinDetectionInterrupt = PORT_PIN_ONE_EDGE
          PortPinInitialMode = DIO
          PortPinDirection = PORT_PIN_IN
          PortPinPullOption = PULL_ENABLE_PUEN1_BIT10
          PortPinPullControl = PULL_UP_PUD1_BIT10
        PortPin8:
          PortPinDirectionChangeable = false
          PortPinDioAltModeChangeable = false
          PortPinModeChangeable = false
          PortPinPolaritySelect = PORT_PIN_POSITIVE_LOGIC
          PortPinOutDataSelect = PORT_PIN_OUTDT
          PortPinLevelValue = PORT_PIN_LEVEL_LOW
          PortPinSensitiveInterrupt = PORT_PIN_LEVEL_SENSITIVE
          PortPinDetectionInterrupt = PORT_PIN_ONE_EDGE
          PortPinInitialMode = DIO
          PortPinDirection = PORT_PIN_IN
          PortPinPullOption = PULL_ENABLE_PUEN1_BIT11
          PortPinPullControl = PULL_UP_PUD1_BIT11
        PortPin9:
          PortPinDirectionChangeable = false
          PortPinDioAltModeChangeable = false
          PortPinModeChangeable = false
          PortPinPolaritySelect = PORT_PIN_POSITIVE_LOGIC
          PortPinOutDataSelect = PORT_PIN_OUTDT
          PortPinLevelValue = PORT_PIN_LEVEL_LOW
          PortPinSensitiveInterrupt = PORT_PIN_LEVEL_SENSITIVE
          PortPinDetectionInterrupt = PORT_PIN_ONE_EDGE
          PortPinInitialMode = DIO
          PortPinDirection = PORT_PIN_IN
          PortPinPullOption = PULL_DISABLE_PUEN0_BIT29
          PortPinPullControl = PULL_DOWN_PUD0_BIT29
        PortPin10:
          PortPinDirectionChangeable = false
          PortPinDioAltModeChangeable = false
          PortPinModeChangeable = false
          PortPinPolaritySelect = PORT_PIN_POSITIVE_LOGIC
          PortPinOutDataSelect = PORT_PIN_OUTDT
          PortPinLevelValue = PORT_PIN_LEVEL_LOW
          PortPinSensitiveInterrupt = PORT_PIN_LEVEL_SENSITIVE
          PortPinDetectionInterrupt = PORT_PIN_ONE_EDGE
          PortPinInitialMode = DIO
          PortPinDirection = PORT_PIN_IN
          PortPinPullOption = PULL_ENABLE_PUEN0_BIT30
          PortPinPullControl = PULL_DOWN_PUD0_BIT30
        PortPin11:
          PortPinDirectionChangeable = false
          PortPinDioAltModeChangeable = false
          PortPinModeChangeable = false
          PortPinPolaritySelect = PORT_PIN_POSITIVE_LOGIC
          PortPinOutDataSelect = PORT_PIN_OUTDT
          PortPinLevelValue = PORT_PIN_LEVEL_LOW
          PortPinSensitiveInterrupt = PORT_PIN_LEVEL_SENSITIVE
          PortPinDetectionInterrupt = PORT_PIN_ONE_EDGE
          PortPinInitialMode = DIO
          PortPinDirection = PORT_PIN_IN
          PortPinPullOption = PULL_ENABLE_PUEN0_BIT31
          PortPinPullControl = PULL_DOWN_PUD0_BIT31
        PortPin12:
          PortPinDirectionChangeable = false
          PortPinDioAltModeChangeable = false
          PortPinModeChangeable = false
          PortPinPolaritySelect = PORT_PIN_POSITIVE_LOGIC
          PortPinOutDataSelect = PORT_PIN_OUTDT
          PortPinLevelValue = PORT_PIN_LEVEL_LOW
          PortPinSensitiveInterrupt = PORT_PIN_LEVEL_SENSITIVE
          PortPinDetectionInterrupt = PORT_PIN_ONE_EDGE
          PortPinInitialMode = DIO
          PortPinDirection = PORT_PIN_IN
          PortPinPullOption = PULL_ENABLE_PUEN1_BIT0
          PortPinPullControl = PULL_DOWN_PUD1_BIT0
        PortPin13:
          PortPinDirectionChangeable = false
          PortPinDioAltModeChangeable = false
          PortPinModeChangeable = false
          PortPinPolaritySelect = PORT_PIN_POSITIVE_LOGIC
          PortPinOutDataSelect = PORT_PIN_OUTDT
          PortPinLevelValue = PORT_PIN_LEVEL_LOW
          PortPinSensitiveInterrupt = PORT_PIN_LEVEL_SENSITIVE
          PortPinDetectionInterrupt = PORT_PIN_ONE_EDGE
          PortPinInitialMode = DIO
          PortPinDirection = PORT_PIN_IN
          PortPinPullOption = PULL_ENABLE_PUEN1_BIT1
          PortPinPullControl = PULL_UP_PUD1_BIT1
        PortPin14:
          PortPinDirectionChangeable = false
          PortPinDioAltModeChangeable = false
          PortPinModeChangeable = false
          PortPinPolaritySelect = PORT_PIN_POSITIVE_LOGIC
          PortPinOutDataSelect = PORT_PIN_OUTDT
          PortPinLevelValue = PORT_PIN_LEVEL_LOW
          PortPinSensitiveInterrupt = PORT_PIN_LEVEL_SENSITIVE
          PortPinDetectionInterrupt = PORT_PIN_ONE_EDGE
          PortPinInitialMode = DIO
          PortPinDirection = PORT_PIN_IN
          PortPinPullOption = PULL_ENABLE_PUEN1_BIT2
          PortPinPullControl = PULL_UP_PUD1_BIT2
      PortGroup3_001 (PortGroup3)
        PortPin0:
          PortPinDirectionChangeable = false
          PortPinDioAltModeChangeable = false
          PortPinModeChangeable = false
          PortPinPolaritySelect = PORT_PIN_POSITIVE_LOGIC
          PortPinOutDataSelect = PORT_PIN_OUTDT
          PortPinLevelValue = PORT_PIN_LEVEL_LOW
          PortPinSensitiveInterrupt = PORT_PIN_LEVEL_SENSITIVE
          PortPinDetectionInterrupt = PORT_PIN_ONE_EDGE
          PortPinInitialMode = DIO
          PortPinDirection = PORT_PIN_IN
          PortPinPullOption = PULL_DISABLE_PUEN3_BIT10
          PortPinPullControl = PULL_DOWN_PUD3_BIT10
        PortPin1:
          PortPinDirectionChangeable = false
          PortPinDioAltModeChangeable = false
          PortPinModeChangeable = false
          PortPinPolaritySelect = PORT_PIN_POSITIVE_LOGIC
          PortPinOutDataSelect = PORT_PIN_OUTDT
          PortPinLevelValue = PORT_PIN_LEVEL_LOW
          PortPinSensitiveInterrupt = PORT_PIN_LEVEL_SENSITIVE
          PortPinDetectionInterrupt = PORT_PIN_ONE_EDGE
          PortPinInitialMode = DIO
          PortPinDirection = PORT_PIN_IN
          PortPinPullOption = PULL_DISABLE_PUEN3_BIT11
          PortPinPullControl = PULL_DOWN_PUD3_BIT11
        PortPin2:
          PortPinDirectionChangeable = false
          PortPinDioAltModeChangeable = false
          PortPinModeChangeable = false
          PortPinPolaritySelect = PORT_PIN_POSITIVE_LOGIC
          PortPinOutDataSelect = PORT_PIN_OUTDT
          PortPinLevelValue = PORT_PIN_LEVEL_LOW
          PortPinSensitiveInterrupt = PORT_PIN_LEVEL_SENSITIVE
          PortPinDetectionInterrupt = PORT_PIN_ONE_EDGE
          PortPinInitialMode = DIO
          PortPinDirection = PORT_PIN_IN
          PortPinPullOption = PULL_DISABLE_PUEN3_BIT12
          PortPinPullControl = PULL_DOWN_PUD3_BIT12
        PortPin3:
          PortPinDirectionChangeable = false
          PortPinDioAltModeChangeable = false
          PortPinModeChangeable = false
          PortPinPolaritySelect = PORT_PIN_POSITIVE_LOGIC
          PortPinOutDataSelect = PORT_PIN_OUTDT
          PortPinLevelValue = PORT_PIN_LEVEL_LOW
          PortPinSensitiveInterrupt = PORT_PIN_LEVEL_SENSITIVE
          PortPinDetectionInterrupt = PORT_PIN_ONE_EDGE
          PortPinInitialMode = DIO
          PortPinDirection = PORT_PIN_IN
          PortPinPullOption = PULL_DISABLE_PUEN3_BIT13
          PortPinPullControl = PULL_DOWN_PUD3_BIT13
        PortPin4:
          PortPinDirectionChangeable = false
          PortPinDioAltModeChangeable = false
          PortPinModeChangeable = false
          PortPinPolaritySelect = PORT_PIN_POSITIVE_LOGIC
          PortPinOutDataSelect = PORT_PIN_OUTDT
          PortPinLevelValue = PORT_PIN_LEVEL_LOW
          PortPinSensitiveInterrupt = PORT_PIN_LEVEL_SENSITIVE
          PortPinDetectionInterrupt = PORT_PIN_ONE_EDGE
          PortPinInitialMode = DIO
          PortPinDirection = PORT_PIN_IN
          PortPinPullOption = PULL_DISABLE_PUEN3_BIT14
          PortPinPullControl = PULL_DOWN_PUD3_BIT14
        PortPin5:
          PortPinDirectionChangeable = false
          PortPinDioAltModeChangeable = false
          PortPinModeChangeable = false
          PortPinPolaritySelect = PORT_PIN_POSITIVE_LOGIC
          PortPinOutDataSelect = PORT_PIN_OUTDT
          PortPinLevelValue = PORT_PIN_LEVEL_LOW
          PortPinSensitiveInterrupt = PORT_PIN_LEVEL_SENSITIVE
          PortPinDetectionInterrupt = PORT_PIN_ONE_EDGE
          PortPinInitialMode = DIO
          PortPinDirection = PORT_PIN_IN
          PortPinPullOption = PULL_DISABLE_PUEN3_BIT15
          PortPinPullControl = PULL_DOWN_PUD3_BIT15
        PortPin6:
          PortPinDirectionChangeable = false
          PortPinDioAltModeChangeable = false
          PortPinModeChangeable = false
          PortPinPolaritySelect = PORT_PIN_POSITIVE_LOGIC
          PortPinOutDataSelect = PORT_PIN_OUTDT
          PortPinLevelValue = PORT_PIN_LEVEL_LOW
          PortPinSensitiveInterrupt = PORT_PIN_LEVEL_SENSITIVE
          PortPinDetectionInterrupt = PORT_PIN_ONE_EDGE
          PortPinInitialMode = DIO
          PortPinDirection = PORT_PIN_IN
          PortPinPullOption = PULL_DISABLE_PUEN3_BIT16
          PortPinPullControl = PULL_DOWN_PUD3_BIT16
        PortPin7:
          PortPinDirectionChangeable = false
          PortPinDioAltModeChangeable = false
          PortPinModeChangeable = false
          PortPinPolaritySelect = PORT_PIN_POSITIVE_LOGIC
          PortPinOutDataSelect = PORT_PIN_OUTDT
          PortPinLevelValue = PORT_PIN_LEVEL_LOW
          PortPinSensitiveInterrupt = PORT_PIN_LEVEL_SENSITIVE
          PortPinDetectionInterrupt = PORT_PIN_ONE_EDGE
          PortPinInitialMode = DIO
          PortPinDirection = PORT_PIN_IN
          PortPinPullOption = PULL_DISABLE_PUEN3_BIT17
          PortPinPullControl = PULL_DOWN_PUD3_BIT17
        PortPin8:
          PortPinDirectionChangeable = false
          PortPinDioAltModeChangeable = false
          PortPinModeChangeable = false
          PortPinPolaritySelect = PORT_PIN_POSITIVE_LOGIC
          PortPinOutDataSelect = PORT_PIN_OUTDT
          PortPinLevelValue = PORT_PIN_LEVEL_LOW
          PortPinSensitiveInterrupt = PORT_PIN_LEVEL_SENSITIVE
          PortPinDetectionInterrupt = PORT_PIN_ONE_EDGE
          PortPinInitialMode = DIO
          PortPinDirection = PORT_PIN_IN
          PortPinPullOption = PULL_DISABLE_PUEN3_BIT18
          PortPinPullControl = PULL_DOWN_PUD3_BIT18
        PortPin9:
          PortPinDirectionChangeable = false
          PortPinDioAltModeChangeable = false
          PortPinModeChangeable = false
          PortPinPolaritySelect = PORT_PIN_POSITIVE_LOGIC
          PortPinOutDataSelect = PORT_PIN_OUTDT
          PortPinLevelValue = PORT_PIN_LEVEL_LOW
          PortPinSensitiveInterrupt = PORT_PIN_LEVEL_SENSITIVE
          PortPinDetectionInterrupt = PORT_PIN_ONE_EDGE
          PortPinInitialMode = DIO
          PortPinDirection = PORT_PIN_IN
          PortPinPullOption = PULL_DISABLE_PUEN3_BIT19
          PortPinPullControl = PULL_DOWN_PUD3_BIT19
        PortPin10:
          PortPinDirectionChangeable = false
          PortPinDioAltModeChangeable = false
          PortPinModeChangeable = false
          PortPinPolaritySelect = PORT_PIN_POSITIVE_LOGIC
          PortPinOutDataSelect = PORT_PIN_OUTDT
          PortPinLevelValue = PORT_PIN_LEVEL_LOW
          PortPinSensitiveInterrupt = PORT_PIN_LEVEL_SENSITIVE
          PortPinDetectionInterrupt = PORT_PIN_ONE_EDGE
          PortPinInitialMode = DIO
          PortPinDirection = PORT_PIN_IN
          PortPinPullOption = PULL_DISABLE_PUEN3_BIT20
          PortPinPullControl = PULL_DOWN_PUD3_BIT20
        PortPin11:
          PortPinDirectionChangeable = false
          PortPinDioAltModeChangeable = false
          PortPinModeChangeable = false
          PortPinPolaritySelect = PORT_PIN_POSITIVE_LOGIC
          PortPinOutDataSelect = PORT_PIN_OUTDT
          PortPinLevelValue = PORT_PIN_LEVEL_LOW
          PortPinSensitiveInterrupt = PORT_PIN_LEVEL_SENSITIVE
          PortPinDetectionInterrupt = PORT_PIN_ONE_EDGE
          PortPinInitialMode = DIO
          PortPinDirection = PORT_PIN_IN
          PortPinPullOption = PULL_DISABLE_PUEN3_BIT21
          PortPinPullControl = PULL_DOWN_PUD3_BIT21
        PortPin12:
          PortPinDirectionChangeable = false
          PortPinDioAltModeChangeable = false
          PortPinModeChangeable = false
          PortPinPolaritySelect = PORT_PIN_POSITIVE_LOGIC
          PortPinOutDataSelect = PORT_PIN_OUTDT
          PortPinLevelValue = PORT_PIN_LEVEL_LOW
          PortPinSensitiveInterrupt = PORT_PIN_LEVEL_SENSITIVE
          PortPinDetectionInterrupt = PORT_PIN_ONE_EDGE
          PortPinInitialMode = DIO
          PortPinDirection = PORT_PIN_IN
          PortPinPullOption = PULL_ENABLE_PUEN4_BIT8
          PortPinPullControl = PULL_UP_PUD4_BIT8
        PortPin13:
          PortPinDirectionChangeable = false
          PortPinDioAltModeChangeable = false
          PortPinModeChangeable = false
          PortPinPolaritySelect = PORT_PIN_POSITIVE_LOGIC
          PortPinOutDataSelect = PORT_PIN_OUTDT
          PortPinLevelValue = PORT_PIN_LEVEL_LOW
          PortPinSensitiveInterrupt = PORT_PIN_LEVEL_SENSITIVE
          PortPinDetectionInterrupt = PORT_PIN_ONE_EDGE
          PortPinInitialMode = DIO
          PortPinDirection = PORT_PIN_IN
          PortPinPullOption = PULL_ENABLE_PUEN4_BIT9
          PortPinPullControl = PULL_UP_PUD4_BIT9
        PortPin14:
          PortPinDirectionChangeable = false
          PortPinDioAltModeChangeable = false
          PortPinModeChangeable = false
          PortPinPolaritySelect = PORT_PIN_POSITIVE_LOGIC
          PortPinOutDataSelect = PORT_PIN_OUTDT
          PortPinLevelValue = PORT_PIN_LEVEL_LOW
          PortPinSensitiveInterrupt = PORT_PIN_LEVEL_SENSITIVE
          PortPinDetectionInterrupt = PORT_PIN_ONE_EDGE
          PortPinInitialMode = DIO
          PortPinDirection = PORT_PIN_IN
          PortPinPullOption = PULL_ENABLE_PUEN4_BIT10
          PortPinPullControl = PULL_UP_PUD4_BIT10
        PortPin15:
          PortPinDirectionChangeable = false
          PortPinDioAltModeChangeable = false
          PortPinModeChangeable = false
          PortPinPolaritySelect = PORT_PIN_POSITIVE_LOGIC
          PortPinOutDataSelect = PORT_PIN_OUTDT
          PortPinLevelValue = PORT_PIN_LEVEL_LOW
          PortPinSensitiveInterrupt = PORT_PIN_LEVEL_SENSITIVE
          PortPinDetectionInterrupt = PORT_PIN_ONE_EDGE
          PortPinInitialMode = DIO
          PortPinDirection = PORT_PIN_IN
          PortPinPullOption = PULL_ENABLE_PUEN4_BIT11
          PortPinPullControl = PULL_UP_PUD4_BIT11
      PortGroup4_001 (PortGroup4)
        PortPin0:
          PortPinDirectionChangeable = false
          PortPinDioAltModeChangeable = false
          PortPinModeChangeable = false
          PortPinPolaritySelect = PORT_PIN_POSITIVE_LOGIC
          PortPinOutDataSelect = PORT_PIN_OUTDT
          PortPinLevelValue = PORT_PIN_LEVEL_LOW
          PortPinSensitiveInterrupt = PORT_PIN_LEVEL_SENSITIVE
          PortPinDetectionInterrupt = PORT_PIN_ONE_EDGE
          PortPinInitialMode = DIO
          PortPinDirection = PORT_PIN_IN
          PortPinPullOption = PULL_DISABLE_PUEN3_BIT22
          PortPinPullControl = PULL_DOWN_PUD3_BIT22
        PortPin1:
          PortPinDirectionChangeable = false
          PortPinDioAltModeChangeable = false
          PortPinModeChangeable = false
          PortPinPolaritySelect = PORT_PIN_POSITIVE_LOGIC
          PortPinOutDataSelect = PORT_PIN_OUTDT
          PortPinLevelValue = PORT_PIN_LEVEL_LOW
          PortPinSensitiveInterrupt = PORT_PIN_LEVEL_SENSITIVE
          PortPinDetectionInterrupt = PORT_PIN_ONE_EDGE
          PortPinInitialMode = DIO
          PortPinDirection = PORT_PIN_IN
          PortPinPullOption = PULL_DISABLE_PUEN3_BIT23
          PortPinPullControl = PULL_DOWN_PUD3_BIT23
        PortPin2:
          PortPinDirectionChangeable = false
          PortPinDioAltModeChangeable = false
          PortPinModeChangeable = false
          PortPinPolaritySelect = PORT_PIN_POSITIVE_LOGIC
          PortPinOutDataSelect = PORT_PIN_OUTDT
          PortPinLevelValue = PORT_PIN_LEVEL_LOW
          PortPinSensitiveInterrupt = PORT_PIN_LEVEL_SENSITIVE
          PortPinDetectionInterrupt = PORT_PIN_ONE_EDGE
          PortPinInitialMode = DIO
          PortPinDirection = PORT_PIN_IN
          PortPinPullOption = PULL_DISABLE_PUEN3_BIT24
          PortPinPullControl = PULL_DOWN_PUD3_BIT24
        PortPin3:
          PortPinDirectionChangeable = false
          PortPinDioAltModeChangeable = false
          PortPinModeChangeable = false
          PortPinPolaritySelect = PORT_PIN_POSITIVE_LOGIC
          PortPinOutDataSelect = PORT_PIN_OUTDT
          PortPinLevelValue = PORT_PIN_LEVEL_LOW
          PortPinSensitiveInterrupt = PORT_PIN_LEVEL_SENSITIVE
          PortPinDetectionInterrupt = PORT_PIN_ONE_EDGE
          PortPinInitialMode = DIO
          PortPinDirection = PORT_PIN_IN
          PortPinPullOption = PULL_DISABLE_PUEN3_BIT25
          PortPinPullControl = PULL_DOWN_PUD3_BIT25
        PortPin4:
          PortPinDirectionChangeable = false
          PortPinDioAltModeChangeable = false
          PortPinModeChangeable = false
          PortPinPolaritySelect = PORT_PIN_POSITIVE_LOGIC
          PortPinOutDataSelect = PORT_PIN_OUTDT
          PortPinLevelValue = PORT_PIN_LEVEL_LOW
          PortPinSensitiveInterrupt = PORT_PIN_LEVEL_SENSITIVE
          PortPinDetectionInterrupt = PORT_PIN_ONE_EDGE
          PortPinInitialMode = DIO
          PortPinDirection = PORT_PIN_IN
          PortPinPullOption = PULL_DISABLE_PUEN3_BIT26
          PortPinPullControl = PULL_DOWN_PUD3_BIT26
        PortPin5:
          PortPinDirectionChangeable = false
          PortPinDioAltModeChangeable = false
          PortPinModeChangeable = false
          PortPinPolaritySelect = PORT_PIN_POSITIVE_LOGIC
          PortPinOutDataSelect = PORT_PIN_OUTDT
          PortPinLevelValue = PORT_PIN_LEVEL_LOW
          PortPinSensitiveInterrupt = PORT_PIN_LEVEL_SENSITIVE
          PortPinDetectionInterrupt = PORT_PIN_ONE_EDGE
          PortPinInitialMode = DIO
          PortPinDirection = PORT_PIN_IN
          PortPinPullOption = PULL_DISABLE_PUEN3_BIT27
          PortPinPullControl = PULL_DOWN_PUD3_BIT27
        PortPin6:
          PortPinDirectionChangeable = false
          PortPinDioAltModeChangeable = false
          PortPinModeChangeable = false
          PortPinPolaritySelect = PORT_PIN_POSITIVE_LOGIC
          PortPinOutDataSelect = PORT_PIN_OUTDT
          PortPinLevelValue = PORT_PIN_LEVEL_LOW
          PortPinSensitiveInterrupt = PORT_PIN_LEVEL_SENSITIVE
          PortPinDetectionInterrupt = PORT_PIN_ONE_EDGE
          PortPinInitialMode = DIO
          PortPinDirection = PORT_PIN_IN
          PortPinPullOption = PULL_DISABLE_PUEN3_BIT28
          PortPinPullControl = PULL_DOWN_PUD3_BIT28
        PortPin7:
          PortPinDirectionChangeable = false
          PortPinDioAltModeChangeable = false
          PortPinModeChangeable = false
          PortPinPolaritySelect = PORT_PIN_POSITIVE_LOGIC
          PortPinOutDataSelect = PORT_PIN_OUTDT
          PortPinLevelValue = PORT_PIN_LEVEL_LOW
          PortPinSensitiveInterrupt = PORT_PIN_LEVEL_SENSITIVE
          PortPinDetectionInterrupt = PORT_PIN_ONE_EDGE
          PortPinInitialMode = DIO
          PortPinDirection = PORT_PIN_IN
          PortPinPullOption = PULL_DISABLE_PUEN3_BIT29
          PortPinPullControl = PULL_DOWN_PUD3_BIT29
        PortPin8:
          PortPinDirectionChangeable = false
          PortPinDioAltModeChangeable = false
          PortPinModeChangeable = false
          PortPinPolaritySelect = PORT_PIN_POSITIVE_LOGIC
          PortPinOutDataSelect = PORT_PIN_OUTDT
          PortPinLevelValue = PORT_PIN_LEVEL_LOW
          PortPinSensitiveInterrupt = PORT_PIN_LEVEL_SENSITIVE
          PortPinDetectionInterrupt = PORT_PIN_ONE_EDGE
          PortPinInitialMode = DIO
          PortPinDirection = PORT_PIN_IN
          PortPinPullOption = PULL_DISABLE_PUEN3_BIT30
          PortPinPullControl = PULL_DOWN_PUD3_BIT30
        PortPin9:
          PortPinDirectionChangeable = false
          PortPinDioAltModeChangeable = false
          PortPinModeChangeable = false
          PortPinPolaritySelect = PORT_PIN_POSITIVE_LOGIC
          PortPinOutDataSelect = PORT_PIN_OUTDT
          PortPinLevelValue = PORT_PIN_LEVEL_LOW
          PortPinSensitiveInterrupt = PORT_PIN_LEVEL_SENSITIVE
          PortPinDetectionInterrupt = PORT_PIN_ONE_EDGE
          PortPinInitialMode = DIO
          PortPinDirection = PORT_PIN_IN
          PortPinPullOption = PULL_DISABLE_PUEN3_BIT31
          PortPinPullControl = PULL_DOWN_PUD3_BIT31
        PortPin10:
          PortPinDirectionChangeable = false
          PortPinDioAltModeChangeable = false
          PortPinModeChangeable = false
          PortPinPolaritySelect = PORT_PIN_POSITIVE_LOGIC
          PortPinOutDataSelect = PORT_PIN_OUTDT
          PortPinLevelValue = PORT_PIN_LEVEL_LOW
          PortPinSensitiveInterrupt = PORT_PIN_LEVEL_SENSITIVE
          PortPinDetectionInterrupt = PORT_PIN_ONE_EDGE
          PortPinInitialMode = DIO
          PortPinDirection = PORT_PIN_IN
          PortPinPullOption = PULL_DISABLE_PUEN4_BIT0
          PortPinPullControl = PULL_DOWN_PUD4_BIT0
        PortPin11:
          PortPinDirectionChangeable = false
          PortPinDioAltModeChangeable = false
          PortPinModeChangeable = false
          PortPinPolaritySelect = PORT_PIN_POSITIVE_LOGIC
          PortPinOutDataSelect = PORT_PIN_OUTDT
          PortPinLevelValue = PORT_PIN_LEVEL_LOW
          PortPinSensitiveInterrupt = PORT_PIN_LEVEL_SENSITIVE
          PortPinDetectionInterrupt = PORT_PIN_ONE_EDGE
          PortPinInitialMode = DIO
          PortPinDirection = PORT_PIN_IN
          PortPinPullOption = PULL_DISABLE_PUEN4_BIT1
          PortPinPullControl = PULL_DOWN_PUD4_BIT1
        PortPin12:
          PortPinDirectionChangeable = false
          PortPinDioAltModeChangeable = false
          PortPinModeChangeable = false
          PortPinPolaritySelect = PORT_PIN_POSITIVE_LOGIC
          PortPinOutDataSelect = PORT_PIN_OUTDT
          PortPinLevelValue = PORT_PIN_LEVEL_LOW
          PortPinSensitiveInterrupt = PORT_PIN_LEVEL_SENSITIVE
          PortPinDetectionInterrupt = PORT_PIN_ONE_EDGE
          PortPinInitialMode = DIO
          PortPinDirection = PORT_PIN_IN
          PortPinPullOption = PULL_DISABLE_PUEN4_BIT2
          PortPinPullControl = PULL_DOWN_PUD4_BIT2
        PortPin13:
          PortPinDirectionChangeable = false
          PortPinDioAltModeChangeable = false
          PortPinModeChangeable = false
          PortPinPolaritySelect = PORT_PIN_POSITIVE_LOGIC
          PortPinOutDataSelect = PORT_PIN_OUTDT
          PortPinLevelValue = PORT_PIN_LEVEL_LOW
          PortPinSensitiveInterrupt = PORT_PIN_LEVEL_SENSITIVE
          PortPinDetectionInterrupt = PORT_PIN_ONE_EDGE
          PortPinInitialMode = DIO
          PortPinDirection = PORT_PIN_IN
          PortPinPullOption = PULL_DISABLE_PUEN4_BIT3
          PortPinPullControl = PULL_DOWN_PUD4_BIT3
        PortPin14:
          PortPinDirectionChangeable = false
          PortPinDioAltModeChangeable = false
          PortPinModeChangeable = false
          PortPinPolaritySelect = PORT_PIN_POSITIVE_LOGIC
          PortPinOutDataSelect = PORT_PIN_OUTDT
          PortPinLevelValue = PORT_PIN_LEVEL_LOW
          PortPinSensitiveInterrupt = PORT_PIN_LEVEL_SENSITIVE
          PortPinDetectionInterrupt = PORT_PIN_ONE_EDGE
          PortPinInitialMode = DIO
          PortPinDirection = PORT_PIN_IN
          PortPinPullOption = PULL_DISABLE_PUEN4_BIT4
          PortPinPullControl = PULL_DOWN_PUD4_BIT4
        PortPin15:
          PortPinDirectionChangeable = false
          PortPinDioAltModeChangeable = false
          PortPinModeChangeable = false
          PortPinPolaritySelect = PORT_PIN_POSITIVE_LOGIC
          PortPinOutDataSelect = PORT_PIN_OUTDT
          PortPinLevelValue = PORT_PIN_LEVEL_LOW
          PortPinSensitiveInterrupt = PORT_PIN_LEVEL_SENSITIVE
          PortPinDetectionInterrupt = PORT_PIN_ONE_EDGE
          PortPinInitialMode = DIO
          PortPinDirection = PORT_PIN_IN
          PortPinPullOption = PULL_DISABLE_PUEN4_BIT5
          PortPinPullControl = PULL_DOWN_PUD4_BIT5
        PortPin16:
          PortPinDirectionChangeable = false
          PortPinDioAltModeChangeable = false
          PortPinModeChangeable = false
          PortPinPolaritySelect = PORT_PIN_POSITIVE_LOGIC
          PortPinOutDataSelect = PORT_PIN_OUTDT
          PortPinLevelValue = PORT_PIN_LEVEL_LOW
          PortPinSensitiveInterrupt = PORT_PIN_LEVEL_SENSITIVE
          PortPinDetectionInterrupt = PORT_PIN_ONE_EDGE
          PortPinInitialMode = DIO
          PortPinDirection = PORT_PIN_IN
          PortPinPullOption = PULL_DISABLE_PUEN4_BIT6
          PortPinPullControl = PULL_DOWN_PUD4_BIT6
        PortPin17:
          PortPinDirectionChangeable = false
          PortPinDioAltModeChangeable = false
          PortPinModeChangeable = false
          PortPinPolaritySelect = PORT_PIN_POSITIVE_LOGIC
          PortPinOutDataSelect = PORT_PIN_OUTDT
          PortPinLevelValue = PORT_PIN_LEVEL_LOW
          PortPinSensitiveInterrupt = PORT_PIN_LEVEL_SENSITIVE
          PortPinDetectionInterrupt = PORT_PIN_ONE_EDGE
          PortPinInitialMode = DIO
          PortPinDirection = PORT_PIN_IN
          PortPinPullOption = PULL_DISABLE_PUEN4_BIT7
          PortPinPullControl = PULL_DOWN_PUD4_BIT7
      PortGroup5_001 (PortGroup5)
        PortPin0:
          PortPinDirectionChangeable = false
          PortPinDioAltModeChangeable = false
          PortPinModeChangeable = false
          PortPinPolaritySelect = PORT_PIN_POSITIVE_LOGIC
          PortPinOutDataSelect = PORT_PIN_OUTDT
          PortPinLevelValue = PORT_PIN_LEVEL_LOW
          PortPinSensitiveInterrupt = PORT_PIN_LEVEL_SENSITIVE
          PortPinDetectionInterrupt = PORT_PIN_ONE_EDGE
          PortPinInitialMode = DIO
          PortPinDirection = PORT_PIN_IN
          PortPinPullOption = PULL_ENABLE_PUEN4_BIT12
          PortPinPullControl = PULL_UP_PUD4_BIT12
        PortPin1:
          PortPinDirectionChangeable = false
          PortPinDioAltModeChangeable = false
          PortPinModeChangeable = false
          PortPinPolaritySelect = PORT_PIN_POSITIVE_LOGIC
          PortPinOutDataSelect = PORT_PIN_OUTDT
          PortPinLevelValue = PORT_PIN_LEVEL_LOW
          PortPinSensitiveInterrupt = PORT_PIN_LEVEL_SENSITIVE
          PortPinDetectionInterrupt = PORT_PIN_ONE_EDGE
          PortPinInitialMode = DIO
          PortPinDirection = PORT_PIN_IN
          PortPinPullOption = PULL_ENABLE_PUEN4_BIT13
          PortPinPullControl = PULL_UP_PUD4_BIT13
        PortPin2:
          PortPinDirectionChangeable = false
          PortPinDioAltModeChangeable = false
          PortPinModeChangeable = false
          PortPinPolaritySelect = PORT_PIN_POSITIVE_LOGIC
          PortPinOutDataSelect = PORT_PIN_OUTDT
          PortPinLevelValue = PORT_PIN_LEVEL_LOW
          PortPinSensitiveInterrupt = PORT_PIN_LEVEL_SENSITIVE
          PortPinDetectionInterrupt = PORT_PIN_ONE_EDGE
          PortPinInitialMode = DIO
          PortPinDirection = PORT_PIN_IN
          PortPinPullOption = PULL_ENABLE_PUEN4_BIT14
          PortPinPullControl = PULL_UP_PUD4_BIT14
        PortPin3:
          PortPinDirectionChangeable = false
          PortPinDioAltModeChangeable = false
          PortPinModeChangeable = false
          PortPinPolaritySelect = PORT_PIN_POSITIVE_LOGIC
          PortPinOutDataSelect = PORT_PIN_OUTDT
          PortPinLevelValue = PORT_PIN_LEVEL_LOW
          PortPinSensitiveInterrupt = PORT_PIN_LEVEL_SENSITIVE
          PortPinDetectionInterrupt = PORT_PIN_ONE_EDGE
          PortPinInitialMode = DIO
          PortPinDirection = PORT_PIN_IN
          PortPinPullOption = PULL_ENABLE_PUEN4_BIT15
          PortPinPullControl = PULL_UP_PUD4_BIT15
        PortPin4:
          PortPinDirectionChangeable = false
          PortPinDioAltModeChangeable = false
          PortPinModeChangeable = false
          PortPinPolaritySelect = PORT_PIN_POSITIVE_LOGIC
          PortPinOutDataSelect = PORT_PIN_OUTDT
          PortPinLevelValue = PORT_PIN_LEVEL_LOW
          PortPinSensitiveInterrupt = PORT_PIN_LEVEL_SENSITIVE
          PortPinDetectionInterrupt = PORT_PIN_ONE_EDGE
          PortPinInitialMode = DIO
          PortPinDirection = PORT_PIN_IN
          PortPinPullOption = PULL_ENABLE_PUEN4_BIT16
          PortPinPullControl = PULL_UP_PUD4_BIT16
        PortPin5:
          PortPinDirectionChangeable = false
          PortPinDioAltModeChangeable = false
          PortPinModeChangeable = false
          PortPinPolaritySelect = PORT_PIN_POSITIVE_LOGIC
          PortPinOutDataSelect = PORT_PIN_OUTDT
          PortPinLevelValue = PORT_PIN_LEVEL_LOW
          PortPinSensitiveInterrupt = PORT_PIN_LEVEL_SENSITIVE
          PortPinDetectionInterrupt = PORT_PIN_ONE_EDGE
          PortPinInitialMode = DIO
          PortPinDirection = PORT_PIN_IN
          PortPinPullOption = PULL_ENABLE_PUEN4_BIT17
          PortPinPullControl = PULL_UP_PUD4_BIT17
        PortPin6:
          PortPinDirectionChangeable = false
          PortPinDioAltModeChangeable = false
          PortPinModeChangeable = false
          PortPinPolaritySelect = PORT_PIN_POSITIVE_LOGIC
          PortPinOutDataSelect = PORT_PIN_OUTDT
          PortPinLevelValue = PORT_PIN_LEVEL_LOW
          PortPinSensitiveInterrupt = PORT_PIN_LEVEL_SENSITIVE
          PortPinDetectionInterrupt = PORT_PIN_ONE_EDGE
          PortPinInitialMode = DIO
          PortPinDirection = PORT_PIN_IN
          PortPinPullOption = PULL_ENABLE_PUEN4_BIT18
          PortPinPullControl = PULL_UP_PUD4_BIT18
        PortPin7:
          PortPinDirectionChangeable = false
          PortPinDioAltModeChangeable = false
          PortPinModeChangeable = false
          PortPinPolaritySelect = PORT_PIN_POSITIVE_LOGIC
          PortPinOutDataSelect = PORT_PIN_OUTDT
          PortPinLevelValue = PORT_PIN_LEVEL_LOW
          PortPinSensitiveInterrupt = PORT_PIN_LEVEL_SENSITIVE
          PortPinDetectionInterrupt = PORT_PIN_ONE_EDGE
          PortPinInitialMode = DIO
          PortPinDirection = PORT_PIN_IN
          PortPinPullOption = PULL_ENABLE_PUEN4_BIT19
          PortPinPullControl = PULL_UP_PUD4_BIT19
        PortPin8:
          PortPinDirectionChangeable = false
          PortPinDioAltModeChangeable = false
          PortPinModeChangeable = false
          PortPinPolaritySelect = PORT_PIN_POSITIVE_LOGIC
          PortPinOutDataSelect = PORT_PIN_OUTDT
          PortPinLevelValue = PORT_PIN_LEVEL_LOW
          PortPinSensitiveInterrupt = PORT_PIN_LEVEL_SENSITIVE
          PortPinDetectionInterrupt = PORT_PIN_ONE_EDGE
          PortPinInitialMode = DIO
          PortPinDirection = PORT_PIN_IN
          PortPinPullOption = PULL_ENABLE_PUEN4_BIT20
          PortPinPullControl = PULL_UP_PUD4_BIT20
        PortPin9:
          PortPinDirectionChangeable = false
          PortPinDioAltModeChangeable = false
          PortPinModeChangeable = false
          PortPinPolaritySelect = PORT_PIN_POSITIVE_LOGIC
          PortPinOutDataSelect = PORT_PIN_OUTDT
          PortPinLevelValue = PORT_PIN_LEVEL_LOW
          PortPinSensitiveInterrupt = PORT_PIN_LEVEL_SENSITIVE
          PortPinDetectionInterrupt = PORT_PIN_ONE_EDGE
          PortPinInitialMode = DIO
          PortPinDirection = PORT_PIN_IN
          PortPinPullOption = PULL_ENABLE_PUEN4_BIT21
          PortPinPullControl = PULL_UP_PUD4_BIT21
        PortPin10:
          PortPinDirectionChangeable = false
          PortPinDioAltModeChangeable = false
          PortPinModeChangeable = false
          PortPinPolaritySelect = PORT_PIN_POSITIVE_LOGIC
          PortPinOutDataSelect = PORT_PIN_OUTDT
          PortPinLevelValue = PORT_PIN_LEVEL_LOW
          PortPinSensitiveInterrupt = PORT_PIN_LEVEL_SENSITIVE
          PortPinDetectionInterrupt = PORT_PIN_ONE_EDGE
          PortPinInitialMode = DIO
          PortPinDirection = PORT_PIN_IN
          PortPinPullOption = PULL_ENABLE_PUEN4_BIT22
          PortPinPullControl = PULL_UP_PUD4_BIT22
        PortPin11:
          PortPinDirectionChangeable = false
          PortPinDioAltModeChangeable = false
          PortPinModeChangeable = false
          PortPinPolaritySelect = PORT_PIN_POSITIVE_LOGIC
          PortPinOutDataSelect = PORT_PIN_OUTDT
          PortPinLevelValue = PORT_PIN_LEVEL_LOW
          PortPinSensitiveInterrupt = PORT_PIN_LEVEL_SENSITIVE
          PortPinDetectionInterrupt = PORT_PIN_ONE_EDGE
          PortPinInitialMode = DIO
          PortPinDirection = PORT_PIN_IN
          PortPinPullOption = PULL_ENABLE_PUEN4_BIT23
          PortPinPullControl = PULL_UP_PUD4_BIT23
        PortPin12:
          PortPinDirectionChangeable = false
          PortPinDioAltModeChangeable = false
          PortPinModeChangeable = false
          PortPinPolaritySelect = PORT_PIN_POSITIVE_LOGIC
          PortPinOutDataSelect = PORT_PIN_OUTDT
          PortPinLevelValue = PORT_PIN_LEVEL_LOW
          PortPinSensitiveInterrupt = PORT_PIN_LEVEL_SENSITIVE
          PortPinDetectionInterrupt = PORT_PIN_ONE_EDGE
          PortPinInitialMode = DIO
          PortPinDirection = PORT_PIN_IN
          PortPinPullOption = PULL_ENABLE_PUEN4_BIT24
          PortPinPullControl = PULL_UP_PUD4_BIT24
        PortPin13:
          PortPinDirectionChangeable = false
          PortPinDioAltModeChangeable = false
          PortPinModeChangeable = false
          PortPinPolaritySelect = PORT_PIN_POSITIVE_LOGIC
          PortPinOutDataSelect = PORT_PIN_OUTDT
          PortPinLevelValue = PORT_PIN_LEVEL_LOW
          PortPinSensitiveInterrupt = PORT_PIN_LEVEL_SENSITIVE
          PortPinDetectionInterrupt = PORT_PIN_ONE_EDGE
          PortPinInitialMode = DIO
          PortPinDirection = PORT_PIN_IN
          PortPinPullOption = PULL_ENABLE_PUEN4_BIT25
          PortPinPullControl = PULL_UP_PUD4_BIT25
        PortPin14:
          PortPinDirectionChangeable = false
          PortPinDioAltModeChangeable = false
          PortPinModeChangeable = false
          PortPinPolaritySelect = PORT_PIN_POSITIVE_LOGIC
          PortPinOutDataSelect = PORT_PIN_OUTDT
          PortPinLevelValue = PORT_PIN_LEVEL_LOW
          PortPinSensitiveInterrupt = PORT_PIN_LEVEL_SENSITIVE
          PortPinDetectionInterrupt = PORT_PIN_ONE_EDGE
          PortPinInitialMode = DIO
          PortPinDirection = PORT_PIN_IN
          PortPinPullOption = PULL_ENABLE_PUEN4_BIT26
          PortPinPullControl = PULL_UP_PUD4_BIT26
        PortPin15:
          PortPinDirectionChangeable = false
          PortPinDioAltModeChangeable = false
          PortPinModeChangeable = false
          PortPinPolaritySelect = PORT_PIN_POSITIVE_LOGIC
          PortPinOutDataSelect = PORT_PIN_OUTDT
          PortPinLevelValue = PORT_PIN_LEVEL_LOW
          PortPinSensitiveInterrupt = PORT_PIN_LEVEL_SENSITIVE
          PortPinDetectionInterrupt = PORT_PIN_ONE_EDGE
          PortPinInitialMode = DIO
          PortPinDirection = PORT_PIN_IN
          PortPinPullOption = PULL_ENABLE_PUEN4_BIT27
          PortPinPullControl = PULL_UP_PUD4_BIT27
        PortPin16:
          PortPinDirectionChangeable = false
          PortPinDioAltModeChangeable = false
          PortPinModeChangeable = false
          PortPinPolaritySelect = PORT_PIN_POSITIVE_LOGIC
          PortPinOutDataSelect = PORT_PIN_OUTDT
          PortPinLevelValue = PORT_PIN_LEVEL_LOW
          PortPinSensitiveInterrupt = PORT_PIN_LEVEL_SENSITIVE
          PortPinDetectionInterrupt = PORT_PIN_ONE_EDGE
          PortPinInitialMode = DIO
          PortPinDirection = PORT_PIN_IN
          PortPinPullOption = PULL_ENABLE_PUEN4_BIT28
          PortPinPullControl = PULL_UP_PUD4_BIT28
        PortPin17:
          PortPinDirectionChangeable = false
          PortPinDioAltModeChangeable = false
          PortPinModeChangeable = false
          PortPinPolaritySelect = PORT_PIN_POSITIVE_LOGIC
          PortPinOutDataSelect = PORT_PIN_OUTDT
          PortPinLevelValue = PORT_PIN_LEVEL_LOW
          PortPinSensitiveInterrupt = PORT_PIN_LEVEL_SENSITIVE
          PortPinDetectionInterrupt = PORT_PIN_ONE_EDGE
          PortPinInitialMode = DIO
          PortPinDirection = PORT_PIN_IN
          PortPinPullOption = PULL_ENABLE_PUEN4_BIT29
          PortPinPullControl = PULL_UP_PUD4_BIT29
        PortPin18:
          PortPinDirectionChangeable = false
          PortPinDioAltModeChangeable = false
          PortPinModeChangeable = false
          PortPinPolaritySelect = PORT_PIN_POSITIVE_LOGIC
          PortPinOutDataSelect = PORT_PIN_OUTDT
          PortPinLevelValue = PORT_PIN_LEVEL_LOW
          PortPinSensitiveInterrupt = PORT_PIN_LEVEL_SENSITIVE
          PortPinDetectionInterrupt = PORT_PIN_ONE_EDGE
          PortPinInitialMode = DIO
          PortPinDirection = PORT_PIN_IN
          PortPinPullOption = PULL_ENABLE_PUEN4_BIT30
          PortPinPullControl = PULL_UP_PUD4_BIT30
        PortPin19:
          PortPinDirectionChangeable = false
          PortPinDioAltModeChangeable = false
          PortPinModeChangeable = false
          PortPinPolaritySelect = PORT_PIN_POSITIVE_LOGIC
          PortPinOutDataSelect = PORT_PIN_OUTDT
          PortPinLevelValue = PORT_PIN_LEVEL_LOW
          PortPinSensitiveInterrupt = PORT_PIN_LEVEL_SENSITIVE
          PortPinDetectionInterrupt = PORT_PIN_ONE_EDGE
          PortPinInitialMode = DIO
          PortPinDirection = PORT_PIN_IN
          PortPinPullOption = PULL_ENABLE_PUEN4_BIT31
          PortPinPullControl = PULL_UP_PUD4_BIT31
        PortPin20:
          PortPinDirectionChangeable = false
          PortPinDioAltModeChangeable = false
          PortPinModeChangeable = false
          PortPinPolaritySelect = PORT_PIN_POSITIVE_LOGIC
          PortPinOutDataSelect = PORT_PIN_OUTDT
          PortPinLevelValue = PORT_PIN_LEVEL_LOW
          PortPinSensitiveInterrupt = PORT_PIN_LEVEL_SENSITIVE
          PortPinDetectionInterrupt = PORT_PIN_ONE_EDGE
          PortPinInitialMode = DIO
          PortPinDirection = PORT_PIN_IN
          PortPinPullOption = PULL_ENABLE_PUEN5_BIT0
          PortPinPullControl = PULL_UP_PUD5_BIT0
        PortPin21:
          PortPinDirectionChangeable = false
          PortPinDioAltModeChangeable = false
          PortPinModeChangeable = false
          PortPinPolaritySelect = PORT_PIN_POSITIVE_LOGIC
          PortPinOutDataSelect = PORT_PIN_OUTDT
          PortPinLevelValue = PORT_PIN_LEVEL_LOW
          PortPinSensitiveInterrupt = PORT_PIN_LEVEL_SENSITIVE
          PortPinDetectionInterrupt = PORT_PIN_ONE_EDGE
          PortPinInitialMode = DIO
          PortPinDirection = PORT_PIN_IN
          PortPinPullOption = PULL_ENABLE_PUEN5_BIT1
          PortPinPullControl = PULL_UP_PUD5_BIT1
        PortPin22:
          PortPinDirectionChangeable = false
          PortPinDioAltModeChangeable = false
          PortPinModeChangeable = false
          PortPinPolaritySelect = PORT_PIN_POSITIVE_LOGIC
          PortPinOutDataSelect = PORT_PIN_OUTDT
          PortPinLevelValue = PORT_PIN_LEVEL_LOW
          PortPinSensitiveInterrupt = PORT_PIN_LEVEL_SENSITIVE
          PortPinDetectionInterrupt = PORT_PIN_ONE_EDGE
          PortPinInitialMode = DIO
          PortPinDirection = PORT_PIN_IN
          PortPinPullOption = PULL_ENABLE_PUEN5_BIT2
          PortPinPullControl = PULL_UP_PUD5_BIT2
        PortPin23:
          PortPinDirectionChangeable = false
          PortPinDioAltModeChangeable = false
          PortPinModeChangeable = false
          PortPinPolaritySelect = PORT_PIN_POSITIVE_LOGIC
          PortPinOutDataSelect = PORT_PIN_OUTDT
          PortPinLevelValue = PORT_PIN_LEVEL_LOW
          PortPinSensitiveInterrupt = PORT_PIN_LEVEL_SENSITIVE
          PortPinDetectionInterrupt = PORT_PIN_ONE_EDGE
          PortPinInitialMode = DIO
          PortPinDirection = PORT_PIN_IN
          PortPinPullOption = PULL_DISABLE_PUEN5_BIT3
          PortPinPullControl = PULL_DOWN_PUD5_BIT3
        PortPin24:
          PortPinDirectionChangeable = false
          PortPinDioAltModeChangeable = false
          PortPinModeChangeable = false
          PortPinPolaritySelect = PORT_PIN_POSITIVE_LOGIC
          PortPinOutDataSelect = PORT_PIN_OUTDT
          PortPinLevelValue = PORT_PIN_LEVEL_LOW
          PortPinSensitiveInterrupt = PORT_PIN_LEVEL_SENSITIVE
          PortPinDetectionInterrupt = PORT_PIN_ONE_EDGE
          PortPinInitialMode = DIO
          PortPinDirection = PORT_PIN_IN
          PortPinPullOption = PULL_DISABLE_PUEN5_BIT4
          PortPinPullControl = PULL_DOWN_PUD5_BIT4
        PortPin25:
          PortPinDirectionChangeable = false
          PortPinDioAltModeChangeable = false
          PortPinModeChangeable = false
          PortPinPolaritySelect = PORT_PIN_POSITIVE_LOGIC
          PortPinOutDataSelect = PORT_PIN_OUTDT
          PortPinLevelValue = PORT_PIN_LEVEL_LOW
          PortPinSensitiveInterrupt = PORT_PIN_LEVEL_SENSITIVE
          PortPinDetectionInterrupt = PORT_PIN_ONE_EDGE
          PortPinInitialMode = DIO
          PortPinDirection = PORT_PIN_IN
          PortPinPullOption = PULL_DISABLE_PUEN5_BIT5
          PortPinPullControl = PULL_DOWN_PUD5_BIT5
      PortGroup6_001 (PortGroup6)
        PortPin0:
          PortPinDirectionChangeable = false
          PortPinDioAltModeChangeable = false
          PortPinModeChangeable = false
          PortPinPolaritySelect = PORT_PIN_POSITIVE_LOGIC
          PortPinOutDataSelect = PORT_PIN_OUTDT
          PortPinLevelValue = PORT_PIN_LEVEL_LOW
          PortPinSensitiveInterrupt = PORT_PIN_LEVEL_SENSITIVE
          PortPinDetectionInterrupt = PORT_PIN_ONE_EDGE
          PortPinInitialMode = DIO
          PortPinDirection = PORT_PIN_IN
          PortPinPullOption = PULL_ENABLE_PUEN5_BIT7
          PortPinPullControl = PULL_UP_PUD5_BIT7
        PortPin1:
          PortPinDirectionChangeable = false
          PortPinDioAltModeChangeable = false
          PortPinModeChangeable = false
          PortPinPolaritySelect = PORT_PIN_POSITIVE_LOGIC
          PortPinOutDataSelect = PORT_PIN_OUTDT
          PortPinLevelValue = PORT_PIN_LEVEL_LOW
          PortPinSensitiveInterrupt = PORT_PIN_LEVEL_SENSITIVE
          PortPinDetectionInterrupt = PORT_PIN_ONE_EDGE
          PortPinInitialMode = DIO
          PortPinDirection = PORT_PIN_IN
          PortPinPullOption = PULL_ENABLE_PUEN5_BIT8
          PortPinPullControl = PULL_UP_PUD5_BIT8
        PortPin2:
          PortPinDirectionChangeable = false
          PortPinDioAltModeChangeable = false
          PortPinModeChangeable = false
          PortPinPolaritySelect = PORT_PIN_POSITIVE_LOGIC
          PortPinOutDataSelect = PORT_PIN_OUTDT
          PortPinLevelValue = PORT_PIN_LEVEL_LOW
          PortPinSensitiveInterrupt = PORT_PIN_LEVEL_SENSITIVE
          PortPinDetectionInterrupt = PORT_PIN_ONE_EDGE
          PortPinInitialMode = DIO
          PortPinDirection = PORT_PIN_IN
          PortPinPullOption = PULL_ENABLE_PUEN5_BIT9
          PortPinPullControl = PULL_UP_PUD5_BIT9
        PortPin3:
          PortPinDirectionChangeable = false
          PortPinDioAltModeChangeable = false
          PortPinModeChangeable = false
          PortPinPolaritySelect = PORT_PIN_POSITIVE_LOGIC
          PortPinOutDataSelect = PORT_PIN_OUTDT
          PortPinLevelValue = PORT_PIN_LEVEL_LOW
          PortPinSensitiveInterrupt = PORT_PIN_LEVEL_SENSITIVE
          PortPinDetectionInterrupt = PORT_PIN_ONE_EDGE
          PortPinInitialMode = DIO
          PortPinDirection = PORT_PIN_IN
          PortPinPullOption = PULL_ENABLE_PUEN5_BIT10
          PortPinPullControl = PULL_UP_PUD5_BIT10
        PortPin4:
          PortPinDirectionChangeable = false
          PortPinDioAltModeChangeable = false
          PortPinModeChangeable = false
          PortPinPolaritySelect = PORT_PIN_POSITIVE_LOGIC
          PortPinOutDataSelect = PORT_PIN_OUTDT
          PortPinLevelValue = PORT_PIN_LEVEL_LOW
          PortPinSensitiveInterrupt = PORT_PIN_LEVEL_SENSITIVE
          PortPinDetectionInterrupt = PORT_PIN_ONE_EDGE
          PortPinInitialMode = DIO
          PortPinDirection = PORT_PIN_IN
          PortPinPullOption = PULL_ENABLE_PUEN5_BIT11
          PortPinPullControl = PULL_UP_PUD5_BIT11
        PortPin5:
          PortPinDirectionChangeable = false
          PortPinDioAltModeChangeable = false
          PortPinModeChangeable = false
          PortPinPolaritySelect = PORT_PIN_POSITIVE_LOGIC
          PortPinOutDataSelect = PORT_PIN_OUTDT
          PortPinLevelValue = PORT_PIN_LEVEL_LOW
          PortPinSensitiveInterrupt = PORT_PIN_LEVEL_SENSITIVE
          PortPinDetectionInterrupt = PORT_PIN_ONE_EDGE
          PortPinInitialMode = DIO
          PortPinDirection = PORT_PIN_IN
          PortPinPullOption = PULL_ENABLE_PUEN5_BIT12
          PortPinPullControl = PULL_UP_PUD5_BIT12
        PortPin6:
          PortPinDirectionChangeable = false
          PortPinDioAltModeChangeable = false
          PortPinModeChangeable = false
          PortPinPolaritySelect = PORT_PIN_POSITIVE_LOGIC
          PortPinOutDataSelect = PORT_PIN_OUTDT
          PortPinLevelValue = PORT_PIN_LEVEL_LOW
          PortPinSensitiveInterrupt = PORT_PIN_LEVEL_SENSITIVE
          PortPinDetectionInterrupt = PORT_PIN_ONE_EDGE
          PortPinInitialMode = DIO
          PortPinDirection = PORT_PIN_IN
          PortPinPullOption = PULL_ENABLE_PUEN5_BIT13
          PortPinPullControl = PULL_UP_PUD5_BIT13
        PortPin7:
          PortPinDirectionChangeable = false
          PortPinDioAltModeChangeable = false
          PortPinModeChangeable = false
          PortPinPolaritySelect = PORT_PIN_POSITIVE_LOGIC
          PortPinOutDataSelect = PORT_PIN_OUTDT
          PortPinLevelValue = PORT_PIN_LEVEL_LOW
          PortPinSensitiveInterrupt = PORT_PIN_LEVEL_SENSITIVE
          PortPinDetectionInterrupt = PORT_PIN_ONE_EDGE
          PortPinInitialMode = DIO
          PortPinDirection = PORT_PIN_IN
          PortPinPullOption = PULL_ENABLE_PUEN5_BIT14
          PortPinPullControl = PULL_UP_PUD5_BIT14
        PortPin8:
          PortPinDirectionChangeable = false
          PortPinDioAltModeChangeable = false
          PortPinModeChangeable = false
          PortPinPolaritySelect = PORT_PIN_POSITIVE_LOGIC
          PortPinOutDataSelect = PORT_PIN_OUTDT
          PortPinLevelValue = PORT_PIN_LEVEL_LOW
          PortPinSensitiveInterrupt = PORT_PIN_LEVEL_SENSITIVE
          PortPinDetectionInterrupt = PORT_PIN_ONE_EDGE
          PortPinInitialMode = DIO
          PortPinDirection = PORT_PIN_IN
          PortPinPullOption = PULL_ENABLE_PUEN5_BIT15
          PortPinPullControl = PULL_UP_PUD5_BIT15
        PortPin9:
          PortPinDirectionChangeable = false
          PortPinDioAltModeChangeable = false
          PortPinModeChangeable = false
          PortPinPolaritySelect = PORT_PIN_POSITIVE_LOGIC
          PortPinOutDataSelect = PORT_PIN_OUTDT
          PortPinLevelValue = PORT_PIN_LEVEL_LOW
          PortPinSensitiveInterrupt = PORT_PIN_LEVEL_SENSITIVE
          PortPinDetectionInterrupt = PORT_PIN_ONE_EDGE
          PortPinInitialMode = DIO
          PortPinDirection = PORT_PIN_IN
          PortPinPullOption = PULL_ENABLE_PUEN5_BIT16
          PortPinPullControl = PULL_UP_PUD5_BIT16
        PortPin10:
          PortPinDirectionChangeable = false
          PortPinDioAltModeChangeable = false
          PortPinModeChangeable = false
          PortPinPolaritySelect = PORT_PIN_POSITIVE_LOGIC
          PortPinOutDataSelect = PORT_PIN_OUTDT
          PortPinLevelValue = PORT_PIN_LEVEL_LOW
          PortPinSensitiveInterrupt = PORT_PIN_LEVEL_SENSITIVE
          PortPinDetectionInterrupt = PORT_PIN_ONE_EDGE
          PortPinInitialMode = DIO
          PortPinDirection = PORT_PIN_IN
          PortPinPullOption = PULL_ENABLE_PUEN5_BIT17
          PortPinPullControl = PULL_UP_PUD5_BIT17
        PortPin11:
          PortPinDirectionChangeable = false
          PortPinDioAltModeChangeable = false
          PortPinModeChangeable = false
          PortPinPolaritySelect = PORT_PIN_POSITIVE_LOGIC
          PortPinOutDataSelect = PORT_PIN_OUTDT
          PortPinLevelValue = PORT_PIN_LEVEL_LOW
          PortPinSensitiveInterrupt = PORT_PIN_LEVEL_SENSITIVE
          PortPinDetectionInterrupt = PORT_PIN_ONE_EDGE
          PortPinInitialMode = DIO
          PortPinDirection = PORT_PIN_IN
          PortPinPullOption = PULL_ENABLE_PUEN5_BIT18
          PortPinPullControl = PULL_UP_PUD5_BIT18
        PortPin12:
          PortPinDirectionChangeable = false
          PortPinDioAltModeChangeable = false
          PortPinModeChangeable = false
          PortPinPolaritySelect = PORT_PIN_POSITIVE_LOGIC
          PortPinOutDataSelect = PORT_PIN_OUTDT
          PortPinLevelValue = PORT_PIN_LEVEL_LOW
          PortPinSensitiveInterrupt = PORT_PIN_LEVEL_SENSITIVE
          PortPinDetectionInterrupt = PORT_PIN_ONE_EDGE
          PortPinInitialMode = DIO
          PortPinDirection = PORT_PIN_IN
          PortPinPullOption = PULL_ENABLE_PUEN5_BIT19
          PortPinPullControl = PULL_UP_PUD5_BIT19
        PortPin13:
          PortPinDirectionChangeable = false
          PortPinDioAltModeChangeable = false
          PortPinModeChangeable = false
          PortPinPolaritySelect = PORT_PIN_POSITIVE_LOGIC
          PortPinOutDataSelect = PORT_PIN_OUTDT
          PortPinLevelValue = PORT_PIN_LEVEL_LOW
          PortPinSensitiveInterrupt = PORT_PIN_LEVEL_SENSITIVE
          PortPinDetectionInterrupt = PORT_PIN_ONE_EDGE
          PortPinInitialMode = DIO
          PortPinDirection = PORT_PIN_IN
          PortPinPullOption = PULL_ENABLE_PUEN5_BIT20
          PortPinPullControl = PULL_UP_PUD5_BIT20
        PortPin14:
          PortPinDirectionChangeable = false
          PortPinDioAltModeChangeable = false
          PortPinModeChangeable = false
          PortPinPolaritySelect = PORT_PIN_POSITIVE_LOGIC
          PortPinOutDataSelect = PORT_PIN_OUTDT
          PortPinLevelValue = PORT_PIN_LEVEL_LOW
          PortPinSensitiveInterrupt = PORT_PIN_LEVEL_SENSITIVE
          PortPinDetectionInterrupt = PORT_PIN_ONE_EDGE
          PortPinInitialMode = DIO
          PortPinDirection = PORT_PIN_IN
          PortPinPullOption = PULL_DISABLE_PUEN5_BIT21
          PortPinPullControl = PULL_DOWN_PUD5_BIT21
        PortPin15:
          PortPinDirectionChangeable = false
          PortPinDioAltModeChangeable = false
          PortPinModeChangeable = false
          PortPinPolaritySelect = PORT_PIN_POSITIVE_LOGIC
          PortPinOutDataSelect = PORT_PIN_OUTDT
          PortPinLevelValue = PORT_PIN_LEVEL_LOW
          PortPinSensitiveInterrupt = PORT_PIN_LEVEL_SENSITIVE
          PortPinDetectionInterrupt = PORT_PIN_ONE_EDGE
          PortPinInitialMode = DIO
          PortPinDirection = PORT_PIN_IN
          PortPinPullOption = PULL_ENABLE_PUEN5_BIT22
          PortPinPullControl = PULL_UP_PUD5_BIT22
        PortPin16:
          PortPinDirectionChangeable = false
          PortPinDioAltModeChangeable = false
          PortPinModeChangeable = false
          PortPinPolaritySelect = PORT_PIN_POSITIVE_LOGIC
          PortPinOutDataSelect = PORT_PIN_OUTDT
          PortPinLevelValue = PORT_PIN_LEVEL_LOW
          PortPinSensitiveInterrupt = PORT_PIN_LEVEL_SENSITIVE
          PortPinDetectionInterrupt = PORT_PIN_ONE_EDGE
          PortPinInitialMode = DIO
          PortPinDirection = PORT_PIN_IN
          PortPinPullOption = PULL_DISABLE_PUEN5_BIT23
          PortPinPullControl = PULL_DOWN_PUD5_BIT23
        PortPin17:
          PortPinDirectionChangeable = false
          PortPinDioAltModeChangeable = false
          PortPinModeChangeable = false
          PortPinPolaritySelect = PORT_PIN_POSITIVE_LOGIC
          PortPinOutDataSelect = PORT_PIN_OUTDT
          PortPinLevelValue = PORT_PIN_LEVEL_LOW
          PortPinSensitiveInterrupt = PORT_PIN_LEVEL_SENSITIVE
          PortPinDetectionInterrupt = PORT_PIN_ONE_EDGE
          PortPinInitialMode = DIO
          PortPinDirection = PORT_PIN_IN
          PortPinPullOption = PULL_ENABLE_PUEN5_BIT24
          PortPinPullControl = PULL_UP_PUD5_BIT24
        PortPin18:
          PortPinDirectionChangeable = false
          PortPinDioAltModeChangeable = false
          PortPinModeChangeable = false
          PortPinPolaritySelect = PORT_PIN_POSITIVE_LOGIC
          PortPinOutDataSelect = PORT_PIN_OUTDT
          PortPinLevelValue = PORT_PIN_LEVEL_LOW
          PortPinSensitiveInterrupt = PORT_PIN_LEVEL_SENSITIVE
          PortPinDetectionInterrupt = PORT_PIN_ONE_EDGE
          PortPinInitialMode = DIO
          PortPinDirection = PORT_PIN_IN
          PortPinPullOption = PULL_ENABLE_PUEN5_BIT25
          PortPinPullControl = PULL_UP_PUD5_BIT25
        PortPin19:
          PortPinDirectionChangeable = false
          PortPinDioAltModeChangeable = false
          PortPinModeChangeable = false
          PortPinPolaritySelect = PORT_PIN_POSITIVE_LOGIC
          PortPinOutDataSelect = PORT_PIN_OUTDT
          PortPinLevelValue = PORT_PIN_LEVEL_LOW
          PortPinSensitiveInterrupt = PORT_PIN_LEVEL_SENSITIVE
          PortPinDetectionInterrupt = PORT_PIN_ONE_EDGE
          PortPinInitialMode = DIO
          PortPinDirection = PORT_PIN_IN
          PortPinPullOption = PULL_ENABLE_PUEN5_BIT26
          PortPinPullControl = PULL_UP_PUD5_BIT26
        PortPin20:
          PortPinDirectionChangeable = false
          PortPinDioAltModeChangeable = false
          PortPinModeChangeable = false
          PortPinPolaritySelect = PORT_PIN_POSITIVE_LOGIC
          PortPinOutDataSelect = PORT_PIN_OUTDT
          PortPinLevelValue = PORT_PIN_LEVEL_LOW
          PortPinSensitiveInterrupt = PORT_PIN_LEVEL_SENSITIVE
          PortPinDetectionInterrupt = PORT_PIN_ONE_EDGE
          PortPinInitialMode = DIO
          PortPinDirection = PORT_PIN_IN
          PortPinPullOption = PULL_ENABLE_PUEN5_BIT27
          PortPinPullControl = PULL_UP_PUD5_BIT27
        PortPin21:
          PortPinDirectionChangeable = false
          PortPinDioAltModeChangeable = false
          PortPinModeChangeable = false
          PortPinPolaritySelect = PORT_PIN_POSITIVE_LOGIC
          PortPinOutDataSelect = PORT_PIN_OUTDT
          PortPinLevelValue = PORT_PIN_LEVEL_LOW
          PortPinSensitiveInterrupt = PORT_PIN_LEVEL_SENSITIVE
          PortPinDetectionInterrupt = PORT_PIN_ONE_EDGE
          PortPinInitialMode = DIO
          PortPinDirection = PORT_PIN_IN
          PortPinPullOption = PULL_ENABLE_PUEN5_BIT28
          PortPinPullControl = PULL_UP_PUD5_BIT28
        PortPin22:
          PortPinDirectionChangeable = false
          PortPinDioAltModeChangeable = false
          PortPinModeChangeable = false
          PortPinPolaritySelect = PORT_PIN_POSITIVE_LOGIC
          PortPinOutDataSelect = PORT_PIN_OUTDT
          PortPinLevelValue = PORT_PIN_LEVEL_LOW
          PortPinSensitiveInterrupt = PORT_PIN_LEVEL_SENSITIVE
          PortPinDetectionInterrupt = PORT_PIN_ONE_EDGE
          PortPinInitialMode = DIO
          PortPinDirection = PORT_PIN_IN
          PortPinPullOption = PULL_ENABLE_PUEN5_BIT29
          PortPinPullControl = PULL_UP_PUD5_BIT29
        PortPin23:
          PortPinDirectionChangeable = false
          PortPinDioAltModeChangeable = false
          PortPinModeChangeable = false
          PortPinPolaritySelect = PORT_PIN_POSITIVE_LOGIC
          PortPinOutDataSelect = PORT_PIN_OUTDT
          PortPinLevelValue = PORT_PIN_LEVEL_LOW
          PortPinSensitiveInterrupt = PORT_PIN_LEVEL_SENSITIVE
          PortPinDetectionInterrupt = PORT_PIN_ONE_EDGE
          PortPinInitialMode = DIO
          PortPinDirection = PORT_PIN_IN
          PortPinPullOption = PULL_ENABLE_PUEN5_BIT30
          PortPinPullControl = PULL_UP_PUD5_BIT30
        PortPin24:
          PortPinDirectionChangeable = false
          PortPinDioAltModeChangeable = false
          PortPinModeChangeable = false
          PortPinPolaritySelect = PORT_PIN_POSITIVE_LOGIC
          PortPinOutDataSelect = PORT_PIN_OUTDT
          PortPinLevelValue = PORT_PIN_LEVEL_LOW
          PortPinSensitiveInterrupt = PORT_PIN_LEVEL_SENSITIVE
          PortPinDetectionInterrupt = PORT_PIN_ONE_EDGE
          PortPinInitialMode = DIO
          PortPinDirection = PORT_PIN_IN
          PortPinPullOption = PULL_DISABLE_PUEN5_BIT31
          PortPinPullControl = PULL_DOWN_PUD5_BIT31
        PortPin25:
          PortPinDirectionChangeable = false
          PortPinDioAltModeChangeable = false
          PortPinModeChangeable = false
          PortPinPolaritySelect = PORT_PIN_POSITIVE_LOGIC
          PortPinOutDataSelect = PORT_PIN_OUTDT
          PortPinLevelValue = PORT_PIN_LEVEL_LOW
          PortPinSensitiveInterrupt = PORT_PIN_LEVEL_SENSITIVE
          PortPinDetectionInterrupt = PORT_PIN_ONE_EDGE
          PortPinInitialMode = DIO
          PortPinDirection = PORT_PIN_IN
          PortPinPullOption = PULL_ENABLE_PUEN6_BIT0
          PortPinPullControl = PULL_UP_PUD6_BIT0
        PortPin26:
          PortPinDirectionChangeable = false
          PortPinDioAltModeChangeable = false
          PortPinModeChangeable = false
          PortPinPolaritySelect = PORT_PIN_POSITIVE_LOGIC
          PortPinOutDataSelect = PORT_PIN_OUTDT
          PortPinLevelValue = PORT_PIN_LEVEL_LOW
          PortPinSensitiveInterrupt = PORT_PIN_LEVEL_SENSITIVE
          PortPinDetectionInterrupt = PORT_PIN_ONE_EDGE
          PortPinInitialMode = DIO
          PortPinDirection = PORT_PIN_IN
          PortPinPullOption = PULL_ENABLE_PUEN6_BIT1
          PortPinPullControl = PULL_DOWN_PUD6_BIT1
        PortPin27:
          PortPinDirectionChangeable = false
          PortPinDioAltModeChangeable = false
          PortPinModeChangeable = false
          PortPinPolaritySelect = PORT_PIN_POSITIVE_LOGIC
          PortPinOutDataSelect = PORT_PIN_OUTDT
          PortPinLevelValue = PORT_PIN_LEVEL_LOW
          PortPinSensitiveInterrupt = PORT_PIN_LEVEL_SENSITIVE
          PortPinDetectionInterrupt = PORT_PIN_ONE_EDGE
          PortPinInitialMode = DIO
          PortPinDirection = PORT_PIN_IN
          PortPinPullOption = PULL_ENABLE_PUEN6_BIT2
          PortPinPullControl = PULL_UP_PUD6_BIT2
        PortPin28:
          PortPinDirectionChangeable = false
          PortPinDioAltModeChangeable = false
          PortPinModeChangeable = false
          PortPinPolaritySelect = PORT_PIN_POSITIVE_LOGIC
          PortPinOutDataSelect = PORT_PIN_OUTDT
          PortPinLevelValue = PORT_PIN_LEVEL_LOW
          PortPinSensitiveInterrupt = PORT_PIN_LEVEL_SENSITIVE
          PortPinDetectionInterrupt = PORT_PIN_ONE_EDGE
          PortPinInitialMode = DIO
          PortPinDirection = PORT_PIN_IN
          PortPinPullOption = PULL_DISABLE_PUEN6_BIT3
          PortPinPullControl = PULL_DOWN_PUD6_BIT3
        PortPin29:
          PortPinDirectionChangeable = false
          PortPinDioAltModeChangeable = false
          PortPinModeChangeable = false
          PortPinPolaritySelect = PORT_PIN_POSITIVE_LOGIC
          PortPinOutDataSelect = PORT_PIN_OUTDT
          PortPinLevelValue = PORT_PIN_LEVEL_LOW
          PortPinSensitiveInterrupt = PORT_PIN_LEVEL_SENSITIVE
          PortPinDetectionInterrupt = PORT_PIN_ONE_EDGE
          PortPinInitialMode = DIO
          PortPinDirection = PORT_PIN_IN
          PortPinPullOption = PULL_ENABLE_PUEN6_BIT4
          PortPinPullControl = PULL_UP_PUD6_BIT4
        PortPin30:
          PortPinDirectionChangeable = false
          PortPinDioAltModeChangeable = false
          PortPinModeChangeable = false
          PortPinPolaritySelect = PORT_PIN_POSITIVE_LOGIC
          PortPinOutDataSelect = PORT_PIN_OUTDT
          PortPinLevelValue = PORT_PIN_LEVEL_LOW
          PortPinSensitiveInterrupt = PORT_PIN_LEVEL_SENSITIVE
          PortPinDetectionInterrupt = PORT_PIN_ONE_EDGE
          PortPinInitialMode = DIO
          PortPinDirection = PORT_PIN_IN
          PortPinPullOption = PULL_DISABLE_PUEN6_BIT5
          PortPinPullControl = PULL_DOWN_PUD6_BIT5
        PortPin31:
          PortPinDirectionChangeable = false
          PortPinDioAltModeChangeable = false
          PortPinModeChangeable = false
          PortPinPolaritySelect = PORT_PIN_POSITIVE_LOGIC
          PortPinOutDataSelect = PORT_PIN_OUTDT
          PortPinLevelValue = PORT_PIN_LEVEL_LOW
          PortPinSensitiveInterrupt = PORT_PIN_LEVEL_SENSITIVE
          PortPinDetectionInterrupt = PORT_PIN_ONE_EDGE
          PortPinInitialMode = DIO
          PortPinDirection = PORT_PIN_IN
          PortPinPullOption = PULL_ENABLE_PUEN6_BIT6
          PortPinPullControl = PULL_UP_PUD6_BIT6
      PortGroup7_001 (PortGroup7)
        PortPin0:
          PortPinDirectionChangeable = false
          PortPinDioAltModeChangeable = false
          PortPinModeChangeable = false
          PortPinPolaritySelect = PORT_PIN_POSITIVE_LOGIC
          PortPinOutDataSelect = PORT_PIN_OUTDT
          PortPinLevelValue = PORT_PIN_LEVEL_LOW
          PortPinSensitiveInterrupt = PORT_PIN_LEVEL_SENSITIVE
          PortPinDetectionInterrupt = PORT_PIN_ONE_EDGE
          PortPinInitialMode = DIO
          PortPinDirection = PORT_PIN_IN
          PortPinPullOption = PULL_ENABLE_PUEN2_BIT26
          PortPinPullControl = PULL_DOWN_PUD2_BIT26
        PortPin1:
          PortPinDirectionChangeable = false
          PortPinDioAltModeChangeable = false
          PortPinModeChangeable = false
          PortPinPolaritySelect = PORT_PIN_POSITIVE_LOGIC
          PortPinOutDataSelect = PORT_PIN_OUTDT
          PortPinLevelValue = PORT_PIN_LEVEL_LOW
          PortPinSensitiveInterrupt = PORT_PIN_LEVEL_SENSITIVE
          PortPinDetectionInterrupt = PORT_PIN_ONE_EDGE
          PortPinInitialMode = DIO
          PortPinDirection = PORT_PIN_IN
          PortPinPullOption = PULL_ENABLE_PUEN2_BIT27
          PortPinPullControl = PULL_DOWN_PUD2_BIT27
        PortPin2:
          PortPinDirectionChangeable = false
          PortPinDioAltModeChangeable = false
          PortPinModeChangeable = false
          PortPinPolaritySelect = PORT_PIN_POSITIVE_LOGIC
          PortPinOutDataSelect = PORT_PIN_OUTDT
          PortPinLevelValue = PORT_PIN_LEVEL_LOW
          PortPinSensitiveInterrupt = PORT_PIN_LEVEL_SENSITIVE
          PortPinDetectionInterrupt = PORT_PIN_ONE_EDGE
          PortPinInitialMode = DIO
          PortPinDirection = PORT_PIN_IN
          PortPinPullOption = PULL_ENABLE_PUEN2_BIT28
          PortPinPullControl = PULL_UP_PUD2_BIT28
        PortPin3:
          PortPinDirectionChangeable = false
          PortPinDioAltModeChangeable = false
          PortPinModeChangeable = false
          PortPinPolaritySelect = PORT_PIN_POSITIVE_LOGIC
          PortPinOutDataSelect = PORT_PIN_OUTDT
          PortPinLevelValue = PORT_PIN_LEVEL_LOW
          PortPinSensitiveInterrupt = PORT_PIN_LEVEL_SENSITIVE
          PortPinDetectionInterrupt = PORT_PIN_ONE_EDGE
          PortPinInitialMode = DIO
          PortPinDirection = PORT_PIN_IN
          PortPinPullOption = PULL_ENABLE_PUEN2_BIT29
          PortPinPullControl = PULL_UP_PUD2_BIT29
    PortGeneral:
      PortDevErrorDetect = true
      PortSetPinDirectionApi = true
      PortSetPinDefaultDirectionApi = true
      PortSetPinModeApi = true
      PortSetPinDefaultModeApi = true
      PortVersionInfoApi = true
      PortVersionCheckExternalModules = true
      PortDeviceName = RCar_M3N
      PortCriticalSectionProtection = true
      PortMaxMode = 13
      PortSetToDioAltModeApi = true
      PortConfigurationRegisterCheckApi = RFSO_0
      PortWriteVerifyCheck = RFSO_2
      PortExclusiveControl = true
      PortExclusiveTimeout = 66407
      PortExclusiveSelection0 = MFISLCKR0
      PortExclusiveSelection1 = MFISLCKR1
      PortFUSEMonitoringApi = RFSO_1
      PortFUSEMONExpectedValue = 20
    PortDemEventParameterRefs:
      PORT_E_WRITE_VERIFY_FAILURE = DemEventParameter1
      PORT_E_GET_CONTROL_FAILURE = DemEventParameter0
      PORT_E_CONFIGURATION_CHECK_TRANSIENT_FAILURE = DemEventParameter2
      PORT_E_CONFIGURATION_CHECK_PERMANENT_FAILURE = DemEventParameter3
      PORT_E_FUSE_MONITORING_FAILURE = DemEventParameter4
