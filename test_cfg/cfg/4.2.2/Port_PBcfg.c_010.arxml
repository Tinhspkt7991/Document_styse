AUTOSAR XML (schema 4-2-2)
package /ActiveEcuC
  module config Port: implementation-config-variant=VARIANT-POST-BUILD, module-description=Port_Impl
    PortConfigSet
      PortContainer: PortNumberOfPortPins=1
        PortPin:
          PortPinDirection = NOT_USED
          PortPinDirectionChangeable = false
          PortPinId = 1
          PortPinInitialMode = NOT_USED
          PortPinLevelValue = NOT_USED
          PortPinMode = NOT_USED
          PortPinModeChangeable = false
      PortFilterGroupConfig
        PortChatteringFilterGroup0:
          PortFilterClockFrequency = S3D4PHI_DIV_BY_66000
          PortChatteringFilterInput{0..3} = false
        PortChatteringFilterGroup1:
          PortFilterClockFrequency = S3D4PHI_DIV_BY_66000
          PortChatteringFilterInput{0..3} = false
        PortChatteringFilterGroup2:
          PortFilterClockFrequency = S3D4PHI_DIV_BY_66000
          PortChatteringFilterInput{0..3} = false
        PortChatteringFilterGroup3:
          PortFilterClockFrequency = S3D4PHI_DIV_BY_66000
          PortChatteringFilterInput{0..3} = false
        PortChatteringFilterGroup4:
          PortFilterClockFrequency = S3D4PHI_DIV_BY_66000
          PortChatteringFilterInput{0..3} = false
        PortChatteringFilterGroup5:
          PortFilterClockFrequency = S3D4PHI_DIV_BY_66000
          PortChatteringFilterInput{0..3} = false
        PortChatteringFilterGroup6:
          PortFilterClockFrequency = S3D4PHI_DIV_BY_66000
          PortChatteringFilterInput{0..3} = false
        PortChatteringFilterGroup7:
          PortFilterClockFrequency = S3D4PHI_DIV_BY_66000
          PortChatteringFilterInput{0..3} = false
      PortGroup0
        PortPin0:
          PortPinDirectionChangeable = false
          PortPinDioAltModeChangeable = false
          PortPinModeChangeable = false
          PortPinPolaritySelect = PORT_PIN_POSITIVE_LOGIC
          PortPinOutDataSelect = PORT_PIN_OUTDT
          PortPinLevelValue = PORT_PIN_LEVEL_LOW
          PortPinSensitiveInterrupt = PORT_PIN_LEVEL_SENSITIVE
          PortPinDetectionInterrupt = PORT_PIN_ONE_EDGE
          PortPinInitialMode = DIO
          PortPinDirection = PORT_PIN_IN
          PortPinPullOption = PULL_DISABLE_PUEN2_BIT10
          PortPinPullControl = PULL_DOWN_PUD2_BIT10
        PortPin1:
          PortPinDirectionChangeable = false
          PortPinDioAltModeChangeable = false
          PortPinModeChangeable = false
          PortPinPolaritySelect = PORT_PIN_POSITIVE_LOGIC
          PortPinOutDataSelect = PORT_PIN_OUTDTH_OUTDTL
          PortPinLevelValue = PORT_PIN_LEVEL_LOW
          PortPinSensitiveInterrupt = PORT_PIN_LEVEL_SENSITIVE
          PortPinDetectionInterrupt = PORT_PIN_ONE_EDGE
          PortPinInitialMode = DIO
          PortPinDirection = PORT_PIN_IN
          PortPinPullOption = PULL_DISABLE_PUEN2_BIT11
          PortPinPullControl = PULL_DOWN_PUD2_BIT11
        PortPin2:
          PortPinDirectionChangeable = false
          PortPinDioAltModeChangeable = false
          PortPinModeChangeable = false
          PortPinPolaritySelect = PORT_PIN_POSITIVE_LOGIC
          PortPinOutDataSelect = PORT_PIN_OUTDT
          PortPinLevelValue = PORT_PIN_LEVEL_LOW
          PortPinSensitiveInterrupt = PORT_PIN_LEVEL_SENSITIVE
          PortPinDetectionInterrupt = PORT_PIN_ONE_EDGE
          PortPinInitialMode = DIO
          PortPinDirection = PORT_PIN_IN
          PortPinPullOption = PULL_DISABLE_PUEN2_BIT12
          PortPinPullControl = PULL_DOWN_PUD2_BIT12
        PortPin3:
          PortPinDirectionChangeable = false
          PortPinDioAltModeChangeable = false
          PortPinModeChangeable = false
          PortPinPolaritySelect = PORT_PIN_POSITIVE_LOGIC
          PortPinOutDataSelect = PORT_PIN_OUTDTH_OUTDTL
          PortPinLevelValue = PORT_PIN_LEVEL_LOW
          PortPinSensitiveInterrupt = PORT_PIN_LEVEL_SENSITIVE
          PortPinDetectionInterrupt = PORT_PIN_ONE_EDGE
          PortPinInitialMode = DIO
          PortPinDirection = PORT_PIN_IN
          PortPinPullOption = PULL_DISABLE_PUEN2_BIT13
          PortPinPullControl = PULL_DOWN_PUD2_BIT13
      PortGroup1
        PortPin0:
          PortPinDirectionChangeable = false
          PortPinDioAltModeChangeable = false
          PortPinModeChangeable = false
          PortPinPolaritySelect = PORT_PIN_POSITIVE_LOGIC
          PortPinOutDataSelect = PORT_PIN_OUTDT
          PortPinLevelValue = PORT_PIN_LEVEL_LOW
          PortPinSensitiveInterrupt = PORT_PIN_LEVEL_SENSITIVE
          PortPinDetectionInterrupt = PORT_PIN_ONE_EDGE
          PortPinInitialMode = DIO
          PortPinDirection = PORT_PIN_IN
          PortPinPullOption = PULL_DISABLE_PUEN1_BIT12
          PortPinPullControl = PULL_DOWN_PUD1_BIT12
        PortPin1:
          PortPinDirectionChangeable = false
          PortPinDioAltModeChangeable = false
          PortPinModeChangeable = false
          PortPinPolaritySelect = PORT_PIN_POSITIVE_LOGIC
          PortPinOutDataSelect = PORT_PIN_OUTDTH_OUTDTL
          PortPinLevelValue = PORT_PIN_LEVEL_LOW
          PortPinSensitiveInterrupt = PORT_PIN_LEVEL_SENSITIVE
          PortPinDetectionInterrupt = PORT_PIN_ONE_EDGE
          PortPinInitialMode = DIO
          PortPinDirection = PORT_PIN_IN
          PortPinPullOption = PULL_DISABLE_PUEN1_BIT13
          PortPinPullControl = PULL_DOWN_PUD1_BIT13
        PortPin2:
          PortPinDirectionChangeable = false
          PortPinDioAltModeChangeable = false
          PortPinModeChangeable = false
          PortPinPolaritySelect = PORT_PIN_POSITIVE_LOGIC
          PortPinOutDataSelect = PORT_PIN_OUTDT
          PortPinLevelValue = PORT_PIN_LEVEL_LOW
          PortPinSensitiveInterrupt = PORT_PIN_LEVEL_SENSITIVE
          PortPinDetectionInterrupt = PORT_PIN_ONE_EDGE
          PortPinInitialMode = DIO
          PortPinDirection = PORT_PIN_IN
          PortPinPullOption = PULL_ENABLE_PUEN1_BIT14
          PortPinPullControl = PULL_DOWN_PUD1_BIT14
        PortPin3:
          PortPinDirectionChangeable = false
          PortPinDioAltModeChangeable = false
          PortPinModeChangeable = false
          PortPinPolaritySelect = PORT_PIN_POSITIVE_LOGIC
          PortPinOutDataSelect = PORT_PIN_OUTDTH_OUTDTL
          PortPinLevelValue = PORT_PIN_LEVEL_LOW
          PortPinSensitiveInterrupt = PORT_PIN_LEVEL_SENSITIVE
          PortPinDetectionInterrupt = PORT_PIN_ONE_EDGE
          PortPinInitialMode = DIO
          PortPinDirection = PORT_PIN_IN
          PortPinPullOption = PULL_DISABLE_PUEN1_BIT15
          PortPinPullControl = PULL_DOWN_PUD1_BIT15
      PortGroup2
        PortPin0:
          PortPinDirectionChangeable = false
          PortPinDioAltModeChangeable = false
          PortPinModeChangeable = false
          PortPinPolaritySelect = PORT_PIN_POSITIVE_LOGIC
          PortPinOutDataSelect = PORT_PIN_OUTDT
          PortPinLevelValue = PORT_PIN_LEVEL_LOW
          PortPinSensitiveInterrupt = PORT_PIN_LEVEL_SENSITIVE
          PortPinDetectionInterrupt = PORT_PIN_ONE_EDGE
          PortPinInitialMode = DIO
          PortPinDirection = PORT_PIN_IN
          PortPinPullOption = PULL_ENABLE_PUEN1_BIT3
          PortPinPullControl = PULL_UP_PUD1_BIT3
        PortPin1:
          PortPinDirectionChangeable = false
          PortPinDioAltModeChangeable = false
          PortPinModeChangeable = false
          PortPinPolaritySelect = PORT_PIN_POSITIVE_LOGIC
          PortPinOutDataSelect = PORT_PIN_OUTDTH_OUTDTL
          PortPinLevelValue = PORT_PIN_LEVEL_LOW
          PortPinSensitiveInterrupt = PORT_PIN_LEVEL_SENSITIVE
          PortPinDetectionInterrupt = PORT_PIN_ONE_EDGE
          PortPinInitialMode = DIO
          PortPinDirection = PORT_PIN_IN
          PortPinPullOption = PULL_ENABLE_PUEN1_BIT4
          PortPinPullControl = PULL_UP_PUD1_BIT4
        PortPin2:
          PortPinDirectionChangeable = false
          PortPinDioAltModeChangeable = false
          PortPinModeChangeable = false
          PortPinPolaritySelect = PORT_PIN_POSITIVE_LOGIC
          PortPinOutDataSelect = PORT_PIN_OUTDT
          PortPinLevelValue = PORT_PIN_LEVEL_LOW
          PortPinSensitiveInterrupt = PORT_PIN_LEVEL_SENSITIVE
          PortPinDetectionInterrupt = PORT_PIN_ONE_EDGE
          PortPinInitialMode = DIO
          PortPinDirection = PORT_PIN_IN
          PortPinPullOption = PULL_ENABLE_PUEN1_BIT5
          PortPinPullControl = PULL_UP_PUD1_BIT5
        PortPin3:
          PortPinDirectionChangeable = false
          PortPinDioAltModeChangeable = false
          PortPinModeChangeable = false
          PortPinPolaritySelect = PORT_PIN_POSITIVE_LOGIC
          PortPinOutDataSelect = PORT_PIN_OUTDTH_OUTDTL
          PortPinLevelValue = PORT_PIN_LEVEL_LOW
          PortPinSensitiveInterrupt = PORT_PIN_LEVEL_SENSITIVE
          PortPinDetectionInterrupt = PORT_PIN_ONE_EDGE
          PortPinInitialMode = DIO
          PortPinDirection = PORT_PIN_IN
          PortPinPullOption = PULL_ENABLE_PUEN1_BIT6
          PortPinPullControl = PULL_UP_PUD1_BIT6
      PortGroup3
        PortPin0:
          PortPinDirectionChangeable = false
          PortPinDioAltModeChangeable = false
          PortPinModeChangeable = false
          PortPinPolaritySelect = PORT_PIN_POSITIVE_LOGIC
          PortPinOutDataSelect = PORT_PIN_OUTDT
          PortPinLevelValue = PORT_PIN_LEVEL_LOW
          PortPinSensitiveInterrupt = PORT_PIN_LEVEL_SENSITIVE
          PortPinDetectionInterrupt = PORT_PIN_ONE_EDGE
          PortPinInitialMode = DIO
          PortPinDirection = PORT_PIN_IN
          PortPinPullOption = PULL_DISABLE_PUEN3_BIT10
          PortPinPullControl = PULL_DOWN_PUD3_BIT10
        PortPin1:
          PortPinDirectionChangeable = false
          PortPinDioAltModeChangeable = false
          PortPinModeChangeable = false
          PortPinPolaritySelect = PORT_PIN_POSITIVE_LOGIC
          PortPinOutDataSelect = PORT_PIN_OUTDTH_OUTDTL
          PortPinLevelValue = PORT_PIN_LEVEL_LOW
          PortPinSensitiveInterrupt = PORT_PIN_LEVEL_SENSITIVE
          PortPinDetectionInterrupt = PORT_PIN_ONE_EDGE
          PortPinInitialMode = DIO
          PortPinDirection = PORT_PIN_IN
          PortPinPullOption = PULL_DISABLE_PUEN3_BIT11
          PortPinPullControl = PULL_DOWN_PUD3_BIT11
        PortPin2:
          PortPinDirectionChangeable = false
          PortPinDioAltModeChangeable = false
          PortPinModeChangeable = false
          PortPinPolaritySelect = PORT_PIN_POSITIVE_LOGIC
          PortPinOutDataSelect = PORT_PIN_OUTDT
          PortPinLevelValue = PORT_PIN_LEVEL_LOW
          PortPinSensitiveInterrupt = PORT_PIN_LEVEL_SENSITIVE
          PortPinDetectionInterrupt = PORT_PIN_ONE_EDGE
          PortPinInitialMode = DIO
          PortPinDirection = PORT_PIN_IN
          PortPinPullOption = PULL_DISABLE_PUEN3_BIT12
          PortPinPullControl = PULL_DOWN_PUD3_BIT12
        PortPin3:
          PortPinDirectionChangeable = false
          PortPinDioAltModeChangeable = false
          PortPinModeChangeable = false
          PortPinPolaritySelect = PORT_PIN_POSITIVE_LOGIC
          PortPinOutDataSelect = PORT_PIN_OUTDTH_OUTDTL
          PortPinLevelValue = PORT_PIN_LEVEL_LOW
          PortPinSensitiveInterrupt = PORT_PIN_LEVEL_SENSITIVE
          PortPinDetectionInterrupt = PORT_PIN_ONE_EDGE
          PortPinInitialMode = DIO
          PortPinDirection = PORT_PIN_IN
          PortPinPullOption = PULL_DISABLE_PUEN3_BIT13
          PortPinPullControl = PULL_DOWN_PUD3_BIT13
      PortGroup4
        PortPin0:
          PortPinDirectionChangeable = false
          PortPinDioAltModeChangeable = false
          PortPinModeChangeable = false
          PortPinPolaritySelect = PORT_PIN_POSITIVE_LOGIC
          PortPinOutDataSelect = PORT_PIN_OUTDT
          PortPinLevelValue = PORT_PIN_LEVEL_LOW
          PortPinSensitiveInterrupt = PORT_PIN_LEVEL_SENSITIVE
          PortPinDetectionInterrupt = PORT_PIN_ONE_EDGE
          PortPinInitialMode = DIO
          PortPinDirection = PORT_PIN_IN
          PortPinPullOption = PULL_DISABLE_PUEN3_BIT22
          PortPinPullControl = PULL_DOWN_PUD3_BIT22
        PortPin1:
          PortPinDirectionChangeable = false
          PortPinDioAltModeChangeable = false
          PortPinModeChangeable = false
          PortPinPolaritySelect = PORT_PIN_POSITIVE_LOGIC
          PortPinOutDataSelect = PORT_PIN_OUTDTH_OUTDTL
          PortPinLevelValue = PORT_PIN_LEVEL_LOW
          PortPinSensitiveInterrupt = PORT_PIN_LEVEL_SENSITIVE
          PortPinDetectionInterrupt = PORT_PIN_ONE_EDGE
          PortPinInitialMode = DIO
          PortPinDirection = PORT_PIN_IN
          PortPinPullOption = PULL_DISABLE_PUEN3_BIT23
          PortPinPullControl = PULL_DOWN_PUD3_BIT23
        PortPin2:
          PortPinDirectionChangeable = false
          PortPinDioAltModeChangeable = false
          PortPinModeChangeable = false
          PortPinPolaritySelect = PORT_PIN_POSITIVE_LOGIC
          PortPinOutDataSelect = PORT_PIN_OUTDT
          PortPinLevelValue = PORT_PIN_LEVEL_LOW
          PortPinSensitiveInterrupt = PORT_PIN_LEVEL_SENSITIVE
          PortPinDetectionInterrupt = PORT_PIN_ONE_EDGE
          PortPinInitialMode = DIO
          PortPinDirection = PORT_PIN_IN
          PortPinPullOption = PULL_DISABLE_PUEN3_BIT24
          PortPinPullControl = PULL_DOWN_PUD3_BIT24
        PortPin3:
          PortPinDirectionChangeable = false
          PortPinDioAltModeChangeable = false
          PortPinModeChangeable = false
          PortPinPolaritySelect = PORT_PIN_POSITIVE_LOGIC
          PortPinOutDataSelect = PORT_PIN_OUTDTH_OUTDTL
          PortPinLevelValue = PORT_PIN_LEVEL_LOW
          PortPinSensitiveInterrupt = PORT_PIN_LEVEL_SENSITIVE
          PortPinDetectionInterrupt = PORT_PIN_ONE_EDGE
          PortPinInitialMode = DIO
          PortPinDirection = PORT_PIN_IN
          PortPinPullOption = PULL_DISABLE_PUEN3_BIT25
          PortPinPullControl = PULL_DOWN_PUD3_BIT25
      PortGroup5
        PortPin0:
          PortPinDirectionChangeable = false
          PortPinDioAltModeChangeable = false
          PortPinModeChangeable = false
          PortPinPolaritySelect = PORT_PIN_POSITIVE_LOGIC
          PortPinOutDataSelect = PORT_PIN_OUTDT
          PortPinLevelValue = PORT_PIN_LEVEL_LOW
          PortPinSensitiveInterrupt = PORT_PIN_LEVEL_SENSITIVE
          PortPinDetectionInterrupt = PORT_PIN_ONE_EDGE
          PortPinInitialMode = DIO
          PortPinDirection = PORT_PIN_IN
          PortPinPullOption = PULL_ENABLE_PUEN4_BIT12
          PortPinPullControl = PULL_UP_PUD4_BIT12
        PortPin1:
          PortPinDirectionChangeable = false
          PortPinDioAltModeChangeable = false
          PortPinModeChangeable = false
          PortPinPolaritySelect = PORT_PIN_POSITIVE_LOGIC
          PortPinOutDataSelect = PORT_PIN_OUTDTH_OUTDTL
          PortPinLevelValue = PORT_PIN_LEVEL_LOW
          PortPinSensitiveInterrupt = PORT_PIN_LEVEL_SENSITIVE
          PortPinDetectionInterrupt = PORT_PIN_ONE_EDGE
          PortPinInitialMode = DIO
          PortPinDirection = PORT_PIN_IN
          PortPinPullOption = PULL_ENABLE_PUEN4_BIT13
          PortPinPullControl = PULL_UP_PUD4_BIT13
        PortPin2:
          PortPinDirectionChangeable = false
          PortPinDioAltModeChangeable = false
          PortPinModeChangeable = false
          PortPinPolaritySelect = PORT_PIN_POSITIVE_LOGIC
          PortPinOutDataSelect = PORT_PIN_OUTDT
          PortPinLevelValue = PORT_PIN_LEVEL_LOW
          PortPinSensitiveInterrupt = PORT_PIN_LEVEL_SENSITIVE
          PortPinDetectionInterrupt = PORT_PIN_ONE_EDGE
          PortPinInitialMode = DIO
          PortPinDirection = PORT_PIN_IN
          PortPinPullOption = PULL_ENABLE_PUEN4_BIT14
          PortPinPullControl = PULL_UP_PUD4_BIT14
        PortPin3:
          PortPinDirectionChangeable = false
          PortPinDioAltModeChangeable = false
          PortPinModeChangeable = false
          PortPinPolaritySelect = PORT_PIN_POSITIVE_LOGIC
          PortPinOutDataSelect = PORT_PIN_OUTDTH_OUTDTL
          PortPinLevelValue = PORT_PIN_LEVEL_LOW
          PortPinSensitiveInterrupt = PORT_PIN_LEVEL_SENSITIVE
          PortPinDetectionInterrupt = PORT_PIN_ONE_EDGE
          PortPinInitialMode = DIO
          PortPinDirection = PORT_PIN_IN
          PortPinPullOption = PULL_ENABLE_PUEN4_BIT15
          PortPinPullControl = PULL_UP_PUD4_BIT15
      PortGroup6
        PortPin0:
          PortPinDirectionChangeable = false
          PortPinDioAltModeChangeable = false
          PortPinModeChangeable = false
          PortPinPolaritySelect = PORT_PIN_POSITIVE_LOGIC
          PortPinOutDataSelect = PORT_PIN_OUTDT
          PortPinLevelValue = PORT_PIN_LEVEL_LOW
          PortPinSensitiveInterrupt = PORT_PIN_LEVEL_SENSITIVE
          PortPinDetectionInterrupt = PORT_PIN_ONE_EDGE
          PortPinInitialMode = DIO
          PortPinDirection = PORT_PIN_IN
          PortPinPullOption = PULL_ENABLE_PUEN5_BIT7
          PortPinPullControl = PULL_UP_PUD5_BIT7
        PortPin1:
          PortPinDirectionChangeable = false
          PortPinDioAltModeChangeable = false
          PortPinModeChangeable = false
          PortPinPolaritySelect = PORT_PIN_POSITIVE_LOGIC
          PortPinOutDataSelect = PORT_PIN_OUTDTH_OUTDTL
          PortPinLevelValue = PORT_PIN_LEVEL_LOW
          PortPinSensitiveInterrupt = PORT_PIN_LEVEL_SENSITIVE
          PortPinDetectionInterrupt = PORT_PIN_ONE_EDGE
          PortPinInitialMode = DIO
          PortPinDirection = PORT_PIN_IN
          PortPinPullOption = PULL_ENABLE_PUEN5_BIT8
          PortPinPullControl = PULL_UP_PUD5_BIT8
        PortPin2:
          PortPinDirectionChangeable = false
          PortPinDioAltModeChangeable = false
          PortPinModeChangeable = false
          PortPinPolaritySelect = PORT_PIN_POSITIVE_LOGIC
          PortPinOutDataSelect = PORT_PIN_OUTDT
          PortPinLevelValue = PORT_PIN_LEVEL_LOW
          PortPinSensitiveInterrupt = PORT_PIN_LEVEL_SENSITIVE
          PortPinDetectionInterrupt = PORT_PIN_ONE_EDGE
          PortPinInitialMode = DIO
          PortPinDirection = PORT_PIN_IN
          PortPinPullOption = PULL_ENABLE_PUEN5_BIT9
          PortPinPullControl = PULL_UP_PUD5_BIT9
        PortPin3:
          PortPinDirectionChangeable = false
          PortPinDioAltModeChangeable = false
          PortPinModeChangeable = false
          PortPinPolaritySelect = PORT_PIN_POSITIVE_LOGIC
          PortPinOutDataSelect = PORT_PIN_OUTDTH_OUTDTL
          PortPinLevelValue = PORT_PIN_LEVEL_LOW
          PortPinSensitiveInterrupt = PORT_PIN_LEVEL_SENSITIVE
          PortPinDetectionInterrupt = PORT_PIN_ONE_EDGE
          PortPinInitialMode = DIO
          PortPinDirection = PORT_PIN_IN
          PortPinPullOption = PULL_ENABLE_PUEN5_BIT10
          PortPinPullControl = PULL_UP_PUD5_BIT10
      PortGroup7
        PortPin0:
          PortPinDirectionChangeable = false
          PortPinDioAltModeChangeable = false
          PortPinModeChangeable = false
          PortPinPolaritySelect = PORT_PIN_POSITIVE_LOGIC
          PortPinOutDataSelect = PORT_PIN_OUTDT
          PortPinLevelValue = PORT_PIN_LEVEL_LOW
          PortPinSensitiveInterrupt = PORT_PIN_LEVEL_SENSITIVE
          PortPinDetectionInterrupt = PORT_PIN_ONE_EDGE
          PortPinInitialMode = DIO
          PortPinDirection = PORT_PIN_IN
          PortPinPullOption = PULL_ENABLE_PUEN2_BIT26
          PortPinPullControl = PULL_DOWN_PUD2_BIT26
        PortPin1:
          PortPinDirectionChangeable = false
          PortPinDioAltModeChangeable = false
          PortPinModeChangeable = false
          PortPinPolaritySelect = PORT_PIN_POSITIVE_LOGIC
          PortPinOutDataSelect = PORT_PIN_OUTDTH_OUTDTL
          PortPinLevelValue = PORT_PIN_LEVEL_LOW
          PortPinSensitiveInterrupt = PORT_PIN_LEVEL_SENSITIVE
          PortPinDetectionInterrupt = PORT_PIN_ONE_EDGE
          PortPinInitialMode = DIO
          PortPinDirection = PORT_PIN_IN
          PortPinPullOption = PULL_ENABLE_PUEN2_BIT27
          PortPinPullControl = PULL_DOWN_PUD2_BIT27
        PortPin2:
          PortPinDirectionChangeable = false
          PortPinDioAltModeChangeable = false
          PortPinModeChangeable = false
          PortPinPolaritySelect = PORT_PIN_POSITIVE_LOGIC
          PortPinOutDataSelect = PORT_PIN_OUTDT
          PortPinLevelValue = PORT_PIN_LEVEL_LOW
          PortPinSensitiveInterrupt = PORT_PIN_LEVEL_SENSITIVE
          PortPinDetectionInterrupt = PORT_PIN_ONE_EDGE
          PortPinInitialMode = DIO
          PortPinDirection = PORT_PIN_IN
          PortPinPullOption = PULL_ENABLE_PUEN2_BIT28
          PortPinPullControl = PULL_UP_PUD2_BIT28
        PortPin3:
          PortPinDirectionChangeable = false
          PortPinDioAltModeChangeable = false
          PortPinModeChangeable = false
          PortPinPolaritySelect = PORT_PIN_POSITIVE_LOGIC
          PortPinOutDataSelect = PORT_PIN_OUTDTH_OUTDTL
          PortPinLevelValue = PORT_PIN_LEVEL_LOW
          PortPinSensitiveInterrupt = PORT_PIN_LEVEL_SENSITIVE
          PortPinDetectionInterrupt = PORT_PIN_ONE_EDGE
          PortPinInitialMode = DIO
          PortPinDirection = PORT_PIN_IN
          PortPinPullOption = PULL_ENABLE_PUEN2_BIT29
          PortPinPullControl = PULL_UP_PUD2_BIT29
    PortGeneral:
      PortDevErrorDetect = true
      PortSetPinDirectionApi = true
      PortSetPinDefaultDirectionApi = true
      PortSetPinModeApi = true
      PortSetPinDefaultModeApi = true
      PortVersionInfoApi = true
      PortVersionCheckExternalModules = true
      PortDeviceName = RCar_M3N
      PortCriticalSectionProtection = true
      PortMaxMode = 13
      PortSetToDioAltModeApi = false
      PortConfigurationRegisterCheckApi = DISABLED
      PortWriteVerifyCheck = DISABLED
      PortExclusiveControl = false
      PortExclusiveTimeout = 20
      PortExclusiveSelection0 = MFISLCKR0
      PortExclusiveSelection1 = MFISLCKR1
      PortFUSEMonitoringApi = DISABLED
      PortFUSEMONExpectedValue = 20
    PortDemEventParameterRefs:
      PORT_E_WRITE_VERIFY_FAILURE = DemEventParameter1
      PORT_E_GET_CONTROL_FAILURE = DemEventParameter0
      PORT_E_CONFIGURATION_CHECK_TRANSIENT_FAILURE = DemEventParameter2
      PORT_E_CONFIGURATION_CHECK_PERMANENT_FAILURE = DemEventParameter3
      PORT_E_FUSE_MONITORING_FAILURE = DemEventParameter4
