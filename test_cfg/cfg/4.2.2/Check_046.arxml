AUTOSAR XML (schema 4-2-2)
package /ActiveEcuC
  module config Port: implementation-config-variant=VARIANT-POST-BUILD, module-description=Port_Impl
    PortConfigSet
      PortContainer: PortNumberOfPortPins=1
        PortPin:
          PortPinDirection = NOT_
          PortPinDirectionChangeable = false
          PortPinId = 1
          PortPinInitialMode = NOT_
          PortPinLevelValue = NOT_
          PortPinMode = NOT_
          PortPinModeChangeable = false
      PortFilterGroupConfig
        PortChatteringFilterGroup0:
          PortFilterClockFrequency = S3D4PHI_DIV_BY_
          PortChatteringFilterInput{0..3} = false
        PortChatteringFilterGroup1:
          PortFilterClockFrequency = S3D4PHI_DIV_BY_
          PortChatteringFilterInput{0..3} = false
        PortChatteringFilterGroup2:
          PortFilterClockFrequency = S3D4PHI_DIV_BY_
          PortChatteringFilterInput{0..3} = false
        PortChatteringFilterGroup3:
          PortFilterClockFrequency = S3D4PHI_DIV_BY_
          PortChatteringFilterInput{0..3} = false
        PortChatteringFilterGroup4:
          PortFilterClockFrequency = S3D4PHI_DIV_BY_
          PortChatteringFilterInput{0..3} = false
        PortChatteringFilterGroup5:
          PortFilterClockFrequency = S3D4PHI_DIV_BY_
          PortChatteringFilterInput{0..3} = false
        PortChatteringFilterGroup6:
          PortFilterClockFrequency = S3D4PHI_DIV_BY_
          PortChatteringFilterInput{0..3} = false
        PortChatteringFilterGroup7:
          PortFilterClockFrequency = S3D4PHI_DIV_BY_
          PortChatteringFilterInput{0..3} = false
    PortGeneral:
      PortDevErrorDetect = true
      PortSetPinDirectionApi = true
      PortSetPinDefaultDirectionApi = true
      PortSetPinModeApi = true
      PortSetPinDefaultModeApi = true
      PortVersionInfoApi = true
      PortVersionCheckExternalModules = true
      PortDeviceName = RCar_M3N
      PortCriticalSectionProtection = true
      PortMaxMode = 13
      PortSetToDioAltModeApi = true
      PortConfigurationRegisterCheckApi = RFSO_
      PortDeviceRevision = H3_WS2_
      PortWriteVerifyCheck = RFSO_
      PortExclusiveControl = true
      PortExclusiveTimeout = 66407
      PortExclusiveSelection0 = MFISLCK
      PortExclusiveSelection1 = MFISLCK
      PortFUSEMonitoringApi = RFSO_
      PortFUSEMONExpectedValue = 20
    PortDemEventParameterRefs:
      PORT_E_WRITE_VERIFY_FAILURE = DemEventParameter1
      PORT_E_GET_CONTROL_FAILURE = DemEventParameter0
      PORT_E_CONFIGURATION_CHECK_TRANSIENT_FAILURE = DemEventParameter2
      PORT_E_CONFIGURATION_CHECK_PERMANENT_FAILURE = DemEventParameter3
      PORT_E_FUSE_MONITORING_FAILURE = DemEventParameter4
