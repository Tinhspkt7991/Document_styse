AUTOSAR XML (schema 4-2-2)
package /ActiveEcuC
  module config Port: implementation-config-variant=VARIANT-PRE-COMPILE, module-description=Port_Impl
    PortConfigSet
      PortContainer: PortNumberOfPortPins=1
        PortPin:
          PortPinDirection = NOT_USED
          PortPinDirectionChangeable = false
          PortPinId = 1
          PortPinInitialMode = NOT_USED
          PortPinLevelValue = NOT_USED
          PortPinMode = NOT_USED
          PortPinModeChangeable = false
      PortFilterGroupConfig
        PortChatteringFilterGroup0:
          PortFilterClockFrequency = S3D4PHI_DIV_BY_66000
          PortChatteringFilterInput{0..3} = false
        PortChatteringFilterGroup1:
          PortFilterClockFrequency = S3D4PHI_DIV_BY_66000
          PortChatteringFilterInput{0..3} = false
        PortChatteringFilterGroup2:
          PortFilterClockFrequency = S3D4PHI_DIV_BY_66000
          PortChatteringFilterInput{0..3} = false
        PortChatteringFilterGroup3:
          PortFilterClockFrequency = S3D4PHI_DIV_BY_66000
          PortChatteringFilterInput{0..3} = false
        PortChatteringFilterGroup4:
          PortFilterClockFrequency = S3D4PHI_DIV_BY_66000
          PortChatteringFilterInput{0..3} = false
        PortChatteringFilterGroup5:
          PortFilterClockFrequency = S3D4PHI_DIV_BY_66000
          PortChatteringFilterInput{0..3} = false
        PortChatteringFilterGroup6:
          PortFilterClockFrequency = S3D4PHI_DIV_BY_66000
          PortChatteringFilterInput{0..3} = false
        PortChatteringFilterGroup7:
          PortFilterClockFrequency = S3D4PHI_DIV_BY_66000
          PortChatteringFilterInput{0..3} = false
      PortGroup4
        PortPin0:
          PortPinDirectionChangeable = false
          PortPinDioAltModeChangeable = false
          PortPinModeChangeable = false
          PortPinPolaritySelect = PORT_PIN_NEGATIVE_LOGIC
          PortPinOutDataSelect = PORT_PIN_OUTDTH_OUTDTL
          PortPinLevelValue = PORT_PIN_LEVEL_HIGH
          PortPinSensitiveInterrupt = PORT_PIN_EDGE_SENSITIVE
          PortPinDetectionInterrupt = PORT_PIN_BOTH_EDGE
          PortPinInitialMode = SD2_CLK
          PortPinDirection = PORT_PIN_IN
          PortPinPullOption = PULL_ENABLE_PUEN3_BIT22
          PortPinPullControl = PULL_UP_PUD3_BIT22
        PortPin1:
          PortPinDirectionChangeable = false
          PortPinDioAltModeChangeable = false
          PortPinModeChangeable = false
          PortPinPolaritySelect = PORT_PIN_NEGATIVE_LOGIC
          PortPinOutDataSelect = PORT_PIN_OUTDTH_OUTDTL
          PortPinLevelValue = PORT_PIN_LEVEL_HIGH
          PortPinSensitiveInterrupt = PORT_PIN_EDGE_SENSITIVE
          PortPinDetectionInterrupt = PORT_PIN_BOTH_EDGE
          PortPinInitialMode = SD2_CMD
          PortPinDirection = PORT_PIN_IN
          PortPinPullOption = PULL_ENABLE_PUEN3_BIT23
          PortPinPullControl = PULL_UP_PUD3_BIT23
        PortPin2:
          PortPinDirectionChangeable = false
          PortPinDioAltModeChangeable = false
          PortPinModeChangeable = false
          PortPinPolaritySelect = PORT_PIN_NEGATIVE_LOGIC
          PortPinOutDataSelect = PORT_PIN_OUTDTH_OUTDTL
          PortPinLevelValue = PORT_PIN_LEVEL_HIGH
          PortPinSensitiveInterrupt = PORT_PIN_EDGE_SENSITIVE
          PortPinDetectionInterrupt = PORT_PIN_BOTH_EDGE
          PortPinInitialMode = SD2_DAT0
          PortPinDirection = PORT_PIN_IN
          PortPinPullOption = PULL_ENABLE_PUEN3_BIT24
          PortPinPullControl = PULL_UP_PUD3_BIT24
        PortPin3:
          PortPinDirectionChangeable = false
          PortPinDioAltModeChangeable = false
          PortPinModeChangeable = false
          PortPinPolaritySelect = PORT_PIN_NEGATIVE_LOGIC
          PortPinOutDataSelect = PORT_PIN_OUTDTH_OUTDTL
          PortPinLevelValue = PORT_PIN_LEVEL_HIGH
          PortPinSensitiveInterrupt = PORT_PIN_EDGE_SENSITIVE
          PortPinDetectionInterrupt = PORT_PIN_BOTH_EDGE
          PortPinInitialMode = SD2_DAT1
          PortPinDirection = PORT_PIN_IN
          PortPinPullOption = PULL_ENABLE_PUEN3_BIT25
          PortPinPullControl = PULL_UP_PUD3_BIT25
        PortPin4:
          PortPinDirectionChangeable = false
          PortPinDioAltModeChangeable = false
          PortPinModeChangeable = false
          PortPinPolaritySelect = PORT_PIN_NEGATIVE_LOGIC
          PortPinOutDataSelect = PORT_PIN_OUTDTH_OUTDTL
          PortPinLevelValue = PORT_PIN_LEVEL_HIGH
          PortPinSensitiveInterrupt = PORT_PIN_EDGE_SENSITIVE
          PortPinDetectionInterrupt = PORT_PIN_BOTH_EDGE
          PortPinInitialMode = SD2_DAT2
          PortPinDirection = PORT_PIN_IN
          PortPinPullOption = PULL_ENABLE_PUEN3_BIT26
          PortPinPullControl = PULL_UP_PUD3_BIT26
        PortPin5:
          PortPinDirectionChangeable = false
          PortPinDioAltModeChangeable = false
          PortPinModeChangeable = false
          PortPinPolaritySelect = PORT_PIN_NEGATIVE_LOGIC
          PortPinOutDataSelect = PORT_PIN_OUTDTH_OUTDTL
          PortPinLevelValue = PORT_PIN_LEVEL_HIGH
          PortPinSensitiveInterrupt = PORT_PIN_EDGE_SENSITIVE
          PortPinDetectionInterrupt = PORT_PIN_BOTH_EDGE
          PortPinInitialMode = INTERRUPT
          PortPinDirection = PORT_PIN_IN
          PortPinPullOption = PULL_ENABLE_PUEN3_BIT27
          PortPinPullControl = PULL_UP_PUD3_BIT27
        PortPin6:
          PortPinDirectionChangeable = false
          PortPinDioAltModeChangeable = false
          PortPinModeChangeable = false
          PortPinPolaritySelect = PORT_PIN_NEGATIVE_LOGIC
          PortPinOutDataSelect = PORT_PIN_OUTDTH_OUTDTL
          PortPinLevelValue = PORT_PIN_LEVEL_HIGH
          PortPinSensitiveInterrupt = PORT_PIN_EDGE_SENSITIVE
          PortPinDetectionInterrupt = PORT_PIN_BOTH_EDGE
          PortPinInitialMode = INTERRUPT
          PortPinDirection = PORT_PIN_IN
          PortPinPullOption = PULL_ENABLE_PUEN3_BIT28
          PortPinPullControl = PULL_UP_PUD3_BIT28
        PortPin7:
          PortPinDirectionChangeable = false
          PortPinDioAltModeChangeable = false
          PortPinModeChangeable = false
          PortPinPolaritySelect = PORT_PIN_NEGATIVE_LOGIC
          PortPinOutDataSelect = PORT_PIN_OUTDTH_OUTDTL
          PortPinLevelValue = PORT_PIN_LEVEL_HIGH
          PortPinSensitiveInterrupt = PORT_PIN_EDGE_SENSITIVE
          PortPinDetectionInterrupt = PORT_PIN_BOTH_EDGE
          PortPinInitialMode = INTERRUPT
          PortPinDirection = PORT_PIN_IN
          PortPinPullOption = PULL_ENABLE_PUEN3_BIT29
          PortPinPullControl = PULL_UP_PUD3_BIT29
        PortPin8:
          PortPinDirectionChangeable = false
          PortPinDioAltModeChangeable = false
          PortPinModeChangeable = false
          PortPinPolaritySelect = PORT_PIN_NEGATIVE_LOGIC
          PortPinOutDataSelect = PORT_PIN_OUTDTH_OUTDTL
          PortPinLevelValue = PORT_PIN_LEVEL_HIGH
          PortPinSensitiveInterrupt = PORT_PIN_EDGE_SENSITIVE
          PortPinDetectionInterrupt = PORT_PIN_BOTH_EDGE
          PortPinInitialMode = INTERRUPT
          PortPinDirection = PORT_PIN_IN
          PortPinPullOption = PULL_ENABLE_PUEN3_BIT30
          PortPinPullControl = PULL_UP_PUD3_BIT30
        PortPin9:
          PortPinDirectionChangeable = false
          PortPinDioAltModeChangeable = false
          PortPinModeChangeable = false
          PortPinPolaritySelect = PORT_PIN_NEGATIVE_LOGIC
          PortPinOutDataSelect = PORT_PIN_OUTDTH_OUTDTL
          PortPinLevelValue = PORT_PIN_LEVEL_HIGH
          PortPinSensitiveInterrupt = PORT_PIN_EDGE_SENSITIVE
          PortPinDetectionInterrupt = PORT_PIN_BOTH_EDGE
          PortPinInitialMode = INTERRUPT
          PortPinDirection = PORT_PIN_IN
          PortPinPullOption = PULL_ENABLE_PUEN3_BIT31
          PortPinPullControl = PULL_UP_PUD3_BIT31
        PortPin10:
          PortPinDirectionChangeable = false
          PortPinDioAltModeChangeable = false
          PortPinModeChangeable = false
          PortPinPolaritySelect = PORT_PIN_POSITIVE_LOGIC
          PortPinOutDataSelect = PORT_PIN_OUTDT
          PortPinLevelValue = PORT_PIN_LEVEL_LOW
          PortPinSensitiveInterrupt = PORT_PIN_LEVEL_SENSITIVE
          PortPinDetectionInterrupt = PORT_PIN_ONE_EDGE
          PortPinInitialMode = DIO
          PortPinDirection = PORT_PIN_OUT
          PortPinPullOption = PULL_DISABLE_PUEN4_BIT0
          PortPinPullControl = PULL_DOWN_PUD4_BIT0
        PortPin11:
          PortPinDirectionChangeable = false
          PortPinDioAltModeChangeable = false
          PortPinModeChangeable = false
          PortPinPolaritySelect = PORT_PIN_POSITIVE_LOGIC
          PortPinOutDataSelect = PORT_PIN_OUTDT
          PortPinLevelValue = PORT_PIN_LEVEL_LOW
          PortPinSensitiveInterrupt = PORT_PIN_LEVEL_SENSITIVE
          PortPinDetectionInterrupt = PORT_PIN_ONE_EDGE
          PortPinInitialMode = DIO
          PortPinDirection = PORT_PIN_OUT
          PortPinPullOption = PULL_DISABLE_PUEN4_BIT1
          PortPinPullControl = PULL_DOWN_PUD4_BIT1
        PortPin12:
          PortPinDirectionChangeable = false
          PortPinDioAltModeChangeable = false
          PortPinModeChangeable = false
          PortPinPolaritySelect = PORT_PIN_POSITIVE_LOGIC
          PortPinOutDataSelect = PORT_PIN_OUTDT
          PortPinLevelValue = PORT_PIN_LEVEL_LOW
          PortPinSensitiveInterrupt = PORT_PIN_LEVEL_SENSITIVE
          PortPinDetectionInterrupt = PORT_PIN_ONE_EDGE
          PortPinInitialMode = DIO
          PortPinDirection = PORT_PIN_OUT
          PortPinPullOption = PULL_DISABLE_PUEN4_BIT2
          PortPinPullControl = PULL_DOWN_PUD4_BIT2
        PortPin13:
          PortPinDirectionChangeable = false
          PortPinDioAltModeChangeable = false
          PortPinModeChangeable = false
          PortPinPolaritySelect = PORT_PIN_POSITIVE_LOGIC
          PortPinOutDataSelect = PORT_PIN_OUTDT
          PortPinLevelValue = PORT_PIN_LEVEL_LOW
          PortPinSensitiveInterrupt = PORT_PIN_LEVEL_SENSITIVE
          PortPinDetectionInterrupt = PORT_PIN_ONE_EDGE
          PortPinInitialMode = DIO
          PortPinDirection = PORT_PIN_OUT
          PortPinPullOption = PULL_DISABLE_PUEN4_BIT3
          PortPinPullControl = PULL_DOWN_PUD4_BIT3
        PortPin14:
          PortPinDirectionChangeable = false
          PortPinDioAltModeChangeable = false
          PortPinModeChangeable = false
          PortPinPolaritySelect = PORT_PIN_POSITIVE_LOGIC
          PortPinOutDataSelect = PORT_PIN_OUTDT
          PortPinLevelValue = PORT_PIN_LEVEL_LOW
          PortPinSensitiveInterrupt = PORT_PIN_LEVEL_SENSITIVE
          PortPinDetectionInterrupt = PORT_PIN_ONE_EDGE
          PortPinInitialMode = DIO
          PortPinDirection = PORT_PIN_OUT
          PortPinPullOption = PULL_DISABLE_PUEN4_BIT4
          PortPinPullControl = PULL_DOWN_PUD4_BIT4
        PortPin15:
          PortPinDirectionChangeable = false
          PortPinDioAltModeChangeable = false
          PortPinModeChangeable = false
          PortPinPolaritySelect = PORT_PIN_POSITIVE_LOGIC
          PortPinOutDataSelect = PORT_PIN_OUTDT
          PortPinLevelValue = PORT_PIN_LEVEL_LOW
          PortPinSensitiveInterrupt = PORT_PIN_LEVEL_SENSITIVE
          PortPinDetectionInterrupt = PORT_PIN_ONE_EDGE
          PortPinInitialMode = DIO
          PortPinDirection = PORT_PIN_OUT
          PortPinPullOption = PULL_DISABLE_PUEN4_BIT5
          PortPinPullControl = PULL_DOWN_PUD4_BIT5
        PortPin16:
          PortPinDirectionChangeable = false
          PortPinDioAltModeChangeable = false
          PortPinModeChangeable = false
          PortPinPolaritySelect = PORT_PIN_POSITIVE_LOGIC
          PortPinOutDataSelect = PORT_PIN_OUTDT
          PortPinLevelValue = PORT_PIN_LEVEL_LOW
          PortPinSensitiveInterrupt = PORT_PIN_LEVEL_SENSITIVE
          PortPinDetectionInterrupt = PORT_PIN_ONE_EDGE
          PortPinInitialMode = DIO
          PortPinDirection = PORT_PIN_OUT
          PortPinPullOption = PULL_DISABLE_PUEN4_BIT6
          PortPinPullControl = PULL_DOWN_PUD4_BIT6
        PortPin17:
          PortPinDirectionChangeable = false
          PortPinDioAltModeChangeable = false
          PortPinModeChangeable = false
          PortPinPolaritySelect = PORT_PIN_POSITIVE_LOGIC
          PortPinOutDataSelect = PORT_PIN_OUTDT
          PortPinLevelValue = PORT_PIN_LEVEL_LOW
          PortPinSensitiveInterrupt = PORT_PIN_LEVEL_SENSITIVE
          PortPinDetectionInterrupt = PORT_PIN_ONE_EDGE
          PortPinInitialMode = DIO
          PortPinDirection = PORT_PIN_OUT
          PortPinPullOption = PULL_DISABLE_PUEN4_BIT7
          PortPinPullControl = PULL_DOWN_PUD4_BIT7
      PortGroup{5..7}
      PortGroup{0..3}
    PortGeneral:
      PortDevErrorDetect = true
      PortSetPinDirectionApi = true
      PortSetPinDefaultDirectionApi = true
      PortSetPinModeApi = true
      PortSetPinDefaultModeApi = true
      PortVersionInfoApi = true
      PortVersionCheckExternalModules = true
      PortDeviceName = RCar_M3N
      PortCriticalSectionProtection = true
      PortMaxMode = 13
      PortSetToDioAltModeApi = true
      PortConfigurationRegisterCheckApi = RFSO_0
      PortWriteVerifyCheck = RFSO_1
      PortExclusiveControl = false
      PortExclusiveTimeout = 20
      PortExclusiveSelection0 = MFISLCKR0
      PortExclusiveSelection1 = MFISLCKR1
      PortFUSEMonitoringApi = DISABLED
      PortFUSEMONExpectedValue = 20
    PortDemEventParameterRefs:
      PORT_E_WRITE_VERIFY_FAILURE = DemEventParameter1
      PORT_E_GET_CONTROL_FAILURE = DemEventParameter0
      PORT_E_CONFIGURATION_CHECK_TRANSIENT_FAILURE = DemEventParameter2
      PORT_E_CONFIGURATION_CHECK_PERMANENT_FAILURE = DemEventParameter3
      PORT_E_FUSE_MONITORING_FAILURE = DemEventParameter4
