AUTOSAR XML (schema 4-2-2)
package /ActiveEcuC
  module config Dem: implementation-config-variant=VARIANT-PRE-COMPILE
    DemConfigSet
      5 x DemEventParameter, all with DemEventKind=, DemMaxNumberFreezeFrameRecords=, DemDTCClassRef=(unset), DemExtendedDataClassRef=(unset), DemFreezeFrameClassRef=(unset), DemFreezeFrameRecNumClassRef=(unset):
        DemEventParameter0: DemEventId=1
        DemEventParameter1: DemEventId=2
        DemEventParameter2: DemEventId=3
        DemEventParameter3: DemEventId=4
        DemEventParameter4: DemEventId=4
    DemGeneral:
      DemAgingCycleCounterProcessing = 
      DemBswErrorBufferSize = 
      DemClearDTCBehavior = 
      DemDTCSuppressionSupport = false
      DemDebounceCounterBasedSupport = false
      DemDebounceTimeBasedSupport = false
      DemDevErrorDetect = false
      DemDtcStatusAvailabilityMask = 
      DemEnableConditionSupport = false
      DemEventCombinationSupport = 
      DemEventDisplacementSupport = false
      DemExtendedDataCapture = 
      DemFreezeFrameCapture = 
      DemHeaderFileInclusion = 
      DemImmediateNvStorageLimit = 
      DemMaxNumberEventEntryMirror = 
      DemMaxNumberEventEntryPermanent = 
      DemMaxNumberEventEntryPrimary = 
      DemMaxNumberEventEntrySecondary = 
      DemMaxNumberPrestoredFF = 
      DemOBDSupport = false
      DemOccurrenceCounterProcessing = 
      DemOperationCycleStatusStorage = false
      DemPTOSupport = false
      DemStatusBitStorageTestFailed = false
      DemStorageConditionSupport = false
      DemTaskTime = 
      DemTriggerDcmReports = false
      DemTriggerDltReports = false
      DemTriggerFiMReports = false
      DemTriggerMonitorInitBeforeClearOk = false
      DemTypeOfDTCSupported = 
      DemTypeOfFreezeFrameRecordNumeration = 
      DemVersionInfoApi = false
      DemMILIndicatorRef = (unset)
