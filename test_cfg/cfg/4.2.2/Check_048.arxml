AUTOSAR XML (schema 4-2-2)
package /ActiveEcuC
  module config Port: implementation-config-variant=VARIANT-POST-BUILD, module-description=Port_Impl
    PortConfigSet
      PortContainer: PortNumberOfPortPins=1
        PortPin:
          PortPinDirection = NOT_USED
          PortPinDirectionChangeable = false
          PortPinId = 1
          PortPinInitialMode = NOT_USED
          PortPinLevelValue = NOT_USED
          PortPinMode = NOT_USED
          PortPinModeChangeable = false
      PortFilterGroupConfig
      PortGroup1
        PortPin0:
          PortPinDirectionChangeable = false
          PortPinDioAltModeChangeable = false
          PortPinModeChangeable = false
          PortPinPolaritySelect = PORT__POSITIVE_LOGIC
          PortPinOutDataSelect = PORT__OUTDT
          PortPinLevelValue = PORT__LEVEL_LOW
          PortPinSensitiveInterrupt = PORT__LEVEL_SENSITIVE
          PortPinDetectionInterrupt = PORT__ONE_EDGE
          PortPinInitialMode = DIOIO
          PortPinDirection = PORT__IN
          PortPinPullOption = PULL__DISABLE_PUEN1_BIT12
          PortPinPullControl = PULL__DOWN_PUD1_BIT12
        PortPin1:
          PortPinDirectionChangeable = false
          PortPinDioAltModeChangeable = false
          PortPinModeChangeable = false
          PortPinPolaritySelect = PORT__POSITIVE_LOGIC
          PortPinOutDataSelect = PORT__OUTDT
          PortPinLevelValue = PORT__LEVEL_LOW
          PortPinSensitiveInterrupt = PORT__LEVEL_SENSITIVE
          PortPinDetectionInterrupt = PORT__ONE_EDGE
          PortPinInitialMode = DIOIO
          PortPinDirection = PORT__IN
          PortPinPullOption = PULL__DISABLE_PUEN1_BIT13
          PortPinPullControl = PULL__DOWN_PUD1_BIT13
        PortPin2:
          PortPinDirectionChangeable = false
          PortPinDioAltModeChangeable = false
          PortPinModeChangeable = false
          PortPinPolaritySelect = PORT__POSITIVE_LOGIC
          PortPinOutDataSelect = PORT__OUTDT
          PortPinLevelValue = PORT__LEVEL_LOW
          PortPinSensitiveInterrupt = PORT__LEVEL_SENSITIVE
          PortPinDetectionInterrupt = PORT__ONE_EDGE
          PortPinInitialMode = DIOIO
          PortPinDirection = PORT__IN
          PortPinPullOption = PULL__ENABLE_PUEN1_BIT14
          PortPinPullControl = PULL__DOWN_PUD1_BIT14
        PortPin3:
          PortPinDirectionChangeable = false
          PortPinDioAltModeChangeable = false
          PortPinModeChangeable = false
          PortPinPolaritySelect = PORT__POSITIVE_LOGIC
          PortPinOutDataSelect = PORT__OUTDT
          PortPinLevelValue = PORT__LEVEL_LOW
          PortPinSensitiveInterrupt = PORT__LEVEL_SENSITIVE
          PortPinDetectionInterrupt = PORT__ONE_EDGE
          PortPinInitialMode = DIOIO
          PortPinDirection = PORT__IN
          PortPinPullOption = PULL__DISABLE_PUEN1_BIT15
          PortPinPullControl = PULL__DOWN_PUD1_BIT15
        PortPin4:
          PortPinDirectionChangeable = false
          PortPinDioAltModeChangeable = false
          PortPinModeChangeable = false
          PortPinPolaritySelect = PORT__POSITIVE_LOGIC
          PortPinOutDataSelect = PORT__OUTDT
          PortPinLevelValue = PORT__LEVEL_LOW
          PortPinSensitiveInterrupt = PORT__LEVEL_SENSITIVE
          PortPinDetectionInterrupt = PORT__ONE_EDGE
          PortPinInitialMode = DIOIO
          PortPinDirection = PORT__IN
          PortPinPullOption = PULL__DISABLE_PUEN1_BIT16
          PortPinPullControl = PULL__DOWN_PUD1_BIT16
        PortPin5:
          PortPinDirectionChangeable = false
          PortPinDioAltModeChangeable = false
          PortPinModeChangeable = false
          PortPinPolaritySelect = PORT__POSITIVE_LOGIC
          PortPinOutDataSelect = PORT__OUTDT
          PortPinLevelValue = PORT__LEVEL_LOW
          PortPinSensitiveInterrupt = PORT__LEVEL_SENSITIVE
          PortPinDetectionInterrupt = PORT__ONE_EDGE
          PortPinInitialMode = DIOIO
          PortPinDirection = PORT__IN
          PortPinPullOption = PULL__DISABLE_PUEN1_BIT17
          PortPinPullControl = PULL__DOWN_PUD1_BIT17
        PortPin6:
          PortPinDirectionChangeable = false
          PortPinDioAltModeChangeable = false
          PortPinModeChangeable = false
          PortPinPolaritySelect = PORT__POSITIVE_LOGIC
          PortPinOutDataSelect = PORT__OUTDT
          PortPinLevelValue = PORT__LEVEL_LOW
          PortPinSensitiveInterrupt = PORT__LEVEL_SENSITIVE
          PortPinDetectionInterrupt = PORT__ONE_EDGE
          PortPinInitialMode = DIOIO
          PortPinDirection = PORT__IN
          PortPinPullOption = PULL__DISABLE_PUEN1_BIT18
          PortPinPullControl = PULL__DOWN_PUD1_BIT18
        PortPin7:
          PortPinDirectionChangeable = false
          PortPinDioAltModeChangeable = false
          PortPinModeChangeable = false
          PortPinPolaritySelect = PORT__POSITIVE_LOGIC
          PortPinOutDataSelect = PORT__OUTDT
          PortPinLevelValue = PORT__LEVEL_LOW
          PortPinSensitiveInterrupt = PORT__LEVEL_SENSITIVE
          PortPinDetectionInterrupt = PORT__ONE_EDGE
          PortPinInitialMode = DIOIO
          PortPinDirection = PORT__IN
          PortPinPullOption = PULL__DISABLE_PUEN1_BIT19
          PortPinPullControl = PULL__DOWN_PUD1_BIT19
        PortPin8:
          PortPinDirectionChangeable = false
          PortPinDioAltModeChangeable = false
          PortPinModeChangeable = false
          PortPinPolaritySelect = PORT__POSITIVE_LOGIC
          PortPinOutDataSelect = PORT__OUTDT
          PortPinLevelValue = PORT__LEVEL_LOW
          PortPinSensitiveInterrupt = PORT__LEVEL_SENSITIVE
          PortPinDetectionInterrupt = PORT__ONE_EDGE
          PortPinInitialMode = DIOIO
          PortPinDirection = PORT__IN
          PortPinPullOption = PULL__ENABLE_PUEN1_BIT20
          PortPinPullControl = PULL__UP_PUD1_BIT20
        PortPin9:
          PortPinDirectionChangeable = false
          PortPinDioAltModeChangeable = false
          PortPinModeChangeable = false
          PortPinPolaritySelect = PORT__POSITIVE_LOGIC
          PortPinOutDataSelect = PORT__OUTDT
          PortPinLevelValue = PORT__LEVEL_LOW
          PortPinSensitiveInterrupt = PORT__LEVEL_SENSITIVE
          PortPinDetectionInterrupt = PORT__ONE_EDGE
          PortPinInitialMode = DIOIO
          PortPinDirection = PORT__IN
          PortPinPullOption = PULL__ENABLE_PUEN1_BIT21
          PortPinPullControl = PULL__UP_PUD1_BIT21
        PortPin10:
          PortPinDirectionChangeable = false
          PortPinDioAltModeChangeable = false
          PortPinModeChangeable = false
          PortPinPolaritySelect = PORT__POSITIVE_LOGIC
          PortPinOutDataSelect = PORT__OUTDT
          PortPinLevelValue = PORT__LEVEL_LOW
          PortPinSensitiveInterrupt = PORT__LEVEL_SENSITIVE
          PortPinDetectionInterrupt = PORT__ONE_EDGE
          PortPinInitialMode = DIOIO
          PortPinDirection = PORT__IN
          PortPinPullOption = PULL__DISABLE_PUEN1_BIT22
          PortPinPullControl = PULL__DOWN_PUD1_BIT22
        PortPin11:
          PortPinDirectionChangeable = false
          PortPinDioAltModeChangeable = false
          PortPinModeChangeable = false
          PortPinPolaritySelect = PORT__POSITIVE_LOGIC
          PortPinOutDataSelect = PORT__OUTDT
          PortPinLevelValue = PORT__LEVEL_LOW
          PortPinSensitiveInterrupt = PORT__LEVEL_SENSITIVE
          PortPinDetectionInterrupt = PORT__ONE_EDGE
          PortPinInitialMode = DIOIO
          PortPinDirection = PORT__IN
          PortPinPullOption = PULL__ENABLE_PUEN1_BIT23
          PortPinPullControl = PULL__DOWN_PUD1_BIT23
        PortPin12:
          PortPinDirectionChangeable = false
          PortPinDioAltModeChangeable = false
          PortPinModeChangeable = false
          PortPinPolaritySelect = PORT__POSITIVE_LOGIC
          PortPinOutDataSelect = PORT__OUTDT
          PortPinLevelValue = PORT__LEVEL_LOW
          PortPinSensitiveInterrupt = PORT__LEVEL_SENSITIVE
          PortPinDetectionInterrupt = PORT__ONE_EDGE
          PortPinInitialMode = DIOIO
          PortPinDirection = PORT__IN
          PortPinPullOption = PULL__DISABLE_PUEN1_BIT24
          PortPinPullControl = PULL__DOWN_PUD1_BIT24
        PortPin13:
          PortPinDirectionChangeable = false
          PortPinDioAltModeChangeable = false
          PortPinModeChangeable = false
          PortPinPolaritySelect = PORT__POSITIVE_LOGIC
          PortPinOutDataSelect = PORT__OUTDT
          PortPinLevelValue = PORT__LEVEL_LOW
          PortPinSensitiveInterrupt = PORT__LEVEL_SENSITIVE
          PortPinDetectionInterrupt = PORT__ONE_EDGE
          PortPinInitialMode = DIOIO
          PortPinDirection = PORT__IN
          PortPinPullOption = PULL__DISABLE_PUEN1_BIT25
          PortPinPullControl = PULL__DOWN_PUD1_BIT25
    PortGeneral:
      PortDevErrorDetect = true
      PortSetPinDirectionApi = true
      PortSetPinDefaultDirectionApi = true
      PortSetPinModeApi = true
      PortSetPinDefaultModeApi = true
      PortVersionInfoApi = true
      PortVersionCheckExternalModules = true
      PortDeviceName = RCar_M3N
      PortCriticalSectionProtection = true
      PortMaxMode = 13
      PortSetToDioAltModeApi = true
      PortConfigurationRegisterCheckApi = RFSO_0
      PortWriteVerifyCheck = RFSO_2
      PortExclusiveControl = true
      PortExclusiveTimeout = 66407
      PortExclusiveSelection0 = MFISLCKR0
      PortExclusiveSelection1 = MFISLCKR1
      PortFUSEMonitoringApi = RFSO_1
      PortFUSEMONExpectedValue = 20
    PortDemEventParameterRefs:
      PORT_E_WRITE_VERIFY_FAILURE = DemEventParameter1
      PORT_E_GET_CONTROL_FAILURE = DemEventParameter0
      PORT_E_CONFIGURATION_CHECK_TRANSIENT_FAILURE = DemEventParameter2
      PORT_E_CONFIGURATION_CHECK_PERMANENT_FAILURE = DemEventParameter3
      PORT_E_FUSE_MONITORING_FAILURE = DemEventParameter4
